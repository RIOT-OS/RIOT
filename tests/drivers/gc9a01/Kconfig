## tests/drivers/gc9a01/Kconfig
```kconfig
# SPDX-FileCopyrightText: 2021 HAW Hamburg
# SPDX-License-Identifier: LGPL-2.1-only

config NO_RIOT_IMAGE
    bool
    prompt "Avoid showing the RIOT logo on the test" if !HAS_ARCH_AVR8
    # the logo does not usually fit in AVR8
    default y if HAS_ARCH_AVR8
    help
        Say y to avoid loading the RIOT logo on the test application. Useful for architectures
        storing it in a limited RAM.
```

## tests/drivers/st7796/Kconfig
```kconfig
# Copyright (c) 2021 HAW Hamburg
#
# This file is subject to the terms and conditions of the GNU Lesser
# General Public License v2.1. See the file LICENSE in the top level
# directory for more details.
#

config NO_RIOT_IMAGE
    bool
    prompt "Avoid showing the RIOT logo on the test" if !HAS_ARCH_AVR8
    # the logo does not usually fit in AVR8
    default y if HAS_ARCH_AVR8
    help
        Say y to avoid loading the RIOT logo on the test application. Useful for architectures
        storing it in a limited RAM.
```

## tests/external_board_dirs/esp-ci-boards/esp32-ci/Kconfig
```kconfig
# Copyright (c) 2020 HAW Hamburg
#
# This file is subject to the terms and conditions of the GNU Lesser
# General Public License v2.1. See the file LICENSE in the top level
# directory for more details.

config BOARD
    default "esp32-ci" if BOARD_ESP32_CI

config BOARD_ESP32_CI
    bool
    default y
    select BOARD_COMMON_ESP32
    select CPU_MODEL_ESP32_WROVER
    select HAS_ARDUINO
    select HAS_ESP_RTC_TIMER_32K
    select HAS_ESP_JTAG
    select HAS_PERIPH_ADC
    select HAS_PERIPH_I2C
    select HAS_PERIPH_PWM
    select HAS_PERIPH_SPI
    select HAS_SDCARD_SPI

    select HAVE_ILI9341

if TEST_KCONFIG

choice ESP32_I2C_IMPLEMENTATION
    default MODULE_ESP_I2C_HW
endchoice

config MODULE_ESP_HW_COUNTER
    default y
    depends on MODULE_PERIPH_TIMER

endif # TEST_KCONFIG

source "$(RIOTBOARD)/common/esp32/Kconfig"
```

## tests/external_board_dirs/netdev-ci-boards/nrf52840-ci-eth/Kconfig
```kconfig
# Copyright (c) 2022 HAW Hamburg
#
# This file is subject to the terms and conditions of the GNU Lesser
# General Public License v2.1. See the file LICENSE in the top level
# directory for more details.

config BOARD
    default "nrf52840-ci-eth" if BOARD_NRF52840DK_CI_ETH

config BOARD_NRF52840DK_CI_ETH
    bool
    default y
    select BOARDS_COMMON_NRF52XXXDK
    select CPU_MODEL_NRF52840XXAA
    select HAS_PERIPH_PWM
    select HAS_PERIPH_USBDEV
    select HAS_VDD_LC_FILTER_REG0
    select HAVE_MTD_SPI_NOR

    # bring ethernet drivers
    select HAVE_W5100
    select HAVE_ETHOS
    select HAVE_DOSE
    select HAVE_ENCX24J600
    select HAVE_ENC28J60

    select MODULE_BOARDS_COMMON_NRF52XXXDK if TEST_KCONFIG

source "$(RIOTBOARD)/common/nrf52xxxdk/Kconfig"
```

## tests/gnrc_dhcpv6_client_6lbr/Kconfig
```kconfig
if USEMODULE_ETHOS
config GNRC_DHCPV6_CLIENT_6LBR_STATIC_ROUTE
    default y
    depends on USEMODULE_GNRC_DHCPV6_CLIENT_6LBR && KCONFIG_USEMODULE_GNRC_DHCPV6
config GNRC_NETIF_IPV6_ADDRS_NUMOF
    # CONFIG_GNRC_DHCPV6_CLIENT_6LBR_STATIC_ROUTE=1 requires one more address
    # for `fe80::2`.
    default 3
    depends on KCONFIG_USEMODULE_GNRC_NETIF
endif # USEMODULE_ETHOS
```

## tests/kconfig/external_modules/external_module_1/Kconfig
```kconfig
menuconfig KCONFIG_EXTERNAL_MODULE_1
    bool "Configure external module message 1"
    default y
    help
        This will enable configuring the external module message

if KCONFIG_EXTERNAL_MODULE_1

config EXTERNAL_MODULE_1_MESSAGE
    string "External module 1 text"
    default "External Message 1 defined in Kconfig file"

endif # KCONFIG_EXTERNAL_MODULE_1
```

## tests/mbedtls_test/Kconfig
```kconfig
# Copyright (C) 2021_ML!PA Consulting GmbH

menuconfig KCONFIG_USEMODULE_MBEDTLS_TEST
    bool "Configure mbedtls flags used for this test"
    help
        Configure mbedtls flags used for this test using Kconfig

if KCONFIG_USEMODULE_MBEDTLS_TEST

config MBEDTLS_SSL_TLS_C
    bool "Enable the generic SSL/TLS code."
    default y

config MBEDTLS_CIPHER_C
    bool "Enable the generic cipher layer"
    default y

config MBEDTLS_SSL_SERVER_NAME_INDICATION
    bool "Enable server name indication"
    default y

config MBEDTLS_MD_C
    bool "Enable the generic message digets layer"
    default y

config MBEDTLS_SSL_PROTO_TLS1_2
    bool "Specify TLS V1.2"
    default y

config MBEDTLS_KEY_EXCHANGE_ECDHE_ECDSA_ENABLED
    bool "Enable ECDHE ECDSA key exchange"
    default y

config MBEDTLS_KEY_EXCHANGE_ECDHE_RSA_ENABLED
    bool "Enable ECDHE RSA key exchange"
    default y

config MBEDTLS_RSA_C
    bool "Enable RSA public key cryptosystem"
    default y

config MBEDTLS_X509_CRT_PARSE_C
    bool "Enable X.509 certificate parsing"
    default y

config MBEDTLS_X509_USE_C
    bool "Enable X.509 core for certificates usage"
    default y

config MBEDTLS_PEM_PARSE_C
    bool "Enable PEM decoding/parsing"
    default y

config MBEDTLS_BASE64_C
    bool "Enable base64 decoding"
    default y

config MBEDTLS_PKCS1_V15
    bool "Enable  support for PKCS1 v1.5 encoding"
    default y

config MBEDTLS_BIGNUM_C
    bool "Enable the multi-precision integer"
    default y

config MBEDTLS_OID_C
    bool "Enable the OID database"
    default y

config MBEDTLS_ASN1_PARSE_C
    bool "Enable the generic ASN1 parser"
    default y

config MBEDTLS_PK_PARSE_C
    bool "Enable the generic public key parser"
    default y

config MBEDTLS_PK_C
    bool "Enable the generic public key layer"
    default y

config MBEDTLS_SSL_CLI_C
    bool "Enable the SSL/TLS client"
    default y

config MBEDTLS_AES_C
    bool "Enable the AES block cipher"
    default y

config MBEDTLS_NET_C
    bool "Enable networking layer"
    default y

config MBEDTLS_CTR_DRBG_C
    bool "Enable the CTR_DRBG AES-based random generator"
    default y

config MBEDTLS_ECDH_C
    bool "Enable the elliptic curve Diffie-Hellman library"
    default y

config MBEDTLS_ECDSA_C
    bool "Enable the elliptic curve DSA library"
    default y

config MBEDTLS_ECP_C
    bool "Enable the elliptic curve over GF(p) library"
    default y

config MBEDTLS_ECP_DP_SECP521R1_ENABLED
    bool "Enable specific curves within the Elliptic Curve"
    default y

config MBEDTLS_ECP_DP_SECP192R1_ENABLED
    bool "Enable specific curves within the Elliptic Curve"
    default y

config MBEDTLS_ASN1_WRITE_C
    bool "Enable the generic ASN1 writer"
    default y

config MBEDTLS_DHM_C
    bool "Enable the Diffie-Hellman-Merkle module"
    default y

config MBEDTLS_GCM_C
    bool "Enable the Galois/Counter Mode (GCM)"
    default y

config MBEDTLS_PLATFORM_C
    bool "Enable the platform abstraction layer"
    default y

config MBEDTLS_DEBUG_C
    bool "Enable debug messages"
    default y

endif #KCONFIG_USEMODULE_MBEDTLS_TEST
```

## tests/periph/fmc/Kconfig
```kconfig
config APPLICATION
    bool
    default y
    imply MODULE_PERIPH_FMC_NOR_SRAM
    imply MODULE_PERIPH_FMC_SDRAM
    depends on TEST_KCONFIG
```

## tests/periph/pio/Kconfig
```kconfig
# Copyright (c) 2021 Otto-von-Guericke Universität Magdeburg
#
# This file is subject to the terms and conditions of the GNU Lesser
# General Public License v2.1. See the file LICENSE in the top level
# directory for more details.
#

config APPLICATION
    bool
    default y
    depends on TEST_KCONFIG
```

## tests/periph/rtt/Kconfig
```kconfig
# Copyright (C) 2021 Otto-von-Guericke-Universität Magdeburg
#
# This file is subject to the terms and conditions of the GNU Lesser
# General Public License v2.1. See the file LICENSE in the top level
# directory for more details.
#

config APPLICATION
    bool
    default y
    imply MODULE_PERIPH_RTT_SET_COUNTER
    imply MODULE_PERIPH_RTC_MEM
    depends on TEST_KCONFIG
```

## tests/periph/spi/Kconfig
```kconfig
# Copyright (c) 2020 HAW Hamburg
#
# This file is subject to the terms and conditions of the GNU Lesser
# General Public License v2.1. See the file LICENSE in the top level
# directory for more details.

config APP_CONSIDERS_BOARD_LOW_MEMORY
    bool
    help
        This disables optional features for boards that are scare on resources
    default y if BOARD_ARDUINO_DUEMILANOVE
    default y if BOARD_ARDUINO_LEONARDO
    default y if BOARD_ARDUINO_NANO
    default y if BOARD_ARDUINO_UNO
    default y if BOARD_ATMEGA328P
    default y if BOARD_ATMEGA328P_XPLAINED_MINI
    default y if BOARD_ATMEGA8
    default y if BOARD_MSB_430
    default y if BOARD_MSB_430H
    default y if BOARD_NUCLEO_L011K4
    default y if BOARD_OLIMEX_MSP430_H1611
    default y if BOARD_OLIMEX_MSP430_H2618
    default y if BOARD_SAMD10_XMINI
    default y if BOARD_STM32F030F4_DEMO
    default y if BOARD_TELOSB
    default y if BOARD_Z1

config APPLICATION
    bool
    default y
    imply MODULE_PERIPH_SPI_ON_QSPI
    depends on TEST_KCONFIG
    imply MODULE_PERIPH_SPI_RECONFIGURE if !APP_CONSIDERS_BOARD_LOW_MEMORY
    select MODULE_SCHEDSTATISTICS if !APP_CONSIDERS_BOARD_LOW_MEMORY
```

## tests/periph_backup_ram/Kconfig
```kconfig
# Copyright (c) 2020 HAW Hamburg
#
# This file is subject to the terms and conditions of the GNU Lesser
# General Public License v2.1. See the file LICENSE in the top level
# directory for more details.
#

config APPLICATION
    bool
    default y
    depends on HAS_BACKUP_RAM
    depends on TEST_KCONFIG
```

## tests/periph_flashpage/Kconfig
```kconfig
# Copyright (c) 2020 HAW Hamburg
#
# This file is subject to the terms and conditions of the GNU Lesser
# General Public License v2.1. See the file LICENSE in the top level
# directory for more details.
#

config MOD_PERIPH_FLASHPAGE_RAW
    default y
    depends on HAS_PERIPH_FLASHPAGE_RAW && MOD_PERIPH_FLASHPAGE

config MOD_PERIPH_FLASHPAGE_RWEE
    default y
    depends on HAS_PERIPH_FLASHPAGE_RWEE && MOD_PERIPH_FLASHPAGE
```

## tests/periph_i2c/Kconfig
```kconfig
# Copyright (c) 2020 HAW Hamburg
#
# This file is subject to the terms and conditions of the GNU Lesser
# General Public License v2.1. See the file LICENSE in the top level
# directory for more details.
#

config MOD_PERIPH_I2C_RECONFIGURE
    default y
    depends on HAS_PERIPH_I2C_RECONFIGURE && MOD_PERIPH_I2C
```

## tests/periph_pm/Kconfig
```kconfig
# Copyright (c) 2020 HAW Hamburg
#
# This file is subject to the terms and conditions of the GNU Lesser
# General Public License v2.1. See the file LICENSE in the top level
# directory for more details.
#

config APPLICATION
    bool
    default y
    imply MODULE_PERIPH_RTC
    imply MODULE_PERIPH_GPIO
    imply MODULE_PERIPH_GPIO_IRQ
    imply MODULE_ZTIMER_NO_PERIPH_RTT if CPU_COMMON_SAM0
    depends on TEST_KCONFIG
```

## tests/periph_qdec/boards_modded/nrf52840dk/Kconfig
```kconfig
# Copyright (c) 2020 HAW Hamburg
#
# This file is subject to the terms and conditions of the GNU Lesser
# General Public License v2.1. See the file LICENSE in the top level
# directory for more details.

config BOARD
    default "nrf52840dk" if BOARD_NRF52840DK

config BOARD_NRF52840DK
    bool
    default y
    select BOARDS_COMMON_NRF52XXXDK
    select CPU_MODEL_NRF52840XXAA
    select HAS_PERIPH_PWM
    select HAS_PERIPH_QDEC
    select HAS_PERIPH_USBDEV
    select HAS_VDD_LC_FILTER_REG0
    select HAVE_MTD_SPI_NOR

    select MODULE_BOARDS_COMMON_NRF52XXXDK if TEST_KCONFIG

source "$(RIOTBOARD)/common/nrf52xxxdk/Kconfig"
```

## tests/periph_rtc/Kconfig
```kconfig
# Copyright (c) 2021 HAW Hamburg
#
# This file is subject to the terms and conditions of the GNU Lesser
# General Public License v2.1. See the file LICENSE in the top level
# directory for more details.
#

config APPLICATION
    bool
    default y
    imply MODULE_PERIPH_RTC_MEM
    imply MODULE_PERIPH_RTC_MS
    imply MODULE_ZTIMER_NO_PERIPH_RTT
```

## tests/periph_spi/Kconfig
```kconfig
# Copyright (c) 2020 HAW Hamburg
#
# This file is subject to the terms and conditions of the GNU Lesser
# General Public License v2.1. See the file LICENSE in the top level
# directory for more details.
#

config MOD_PERIPH_SPI_RECONFIGURE
    default y
    depends on HAS_PERIPH_SPI_RECONFIGURE && MOD_PERIPH_SPI
```

## tests/periph_uart/Kconfig
```kconfig
# Copyright (c) 2020 HAW Hamburg
#
# This file is subject to the terms and conditions of the GNU Lesser
# General Public License v2.1. See the file LICENSE in the top level
# directory for more details.
#

config APPLICATION
    bool
    default y
    imply MODULE_PERIPH_UART_MODECFG
    imply MODULE_PERIPH_LPUART
    imply MODULE_PERIPH_UART_RXSTART_IRQ
    imply MODULE_PERIPH_UART_COLLISION
    depends on TEST_KCONFIG
```

## tests/pkg/libcoap/Kconfig
```kconfig
# SPDX-FileCopyrightText: 2023-2026 Jon Shallow <supjps-libcoap@jpshallow.com>
# SPDX-License-Identifier: BSD-2-Clause

menu "tests_libcoap"
    depends on USEPKG_LIBCOAP

config LIBCOAP_USE_PSK
    string "Secret to use for PSK communications"
    default "secretPSK"
    depends on USEMODULE_TINYDTLS
config LIBCOAP_USE_PSK_ID
    string "Identifier (user) to use for PSK communications"
    default "test_user"
    depends on USEMODULE_TINYDTLS

endmenu # tests_libcoap
```

## tests/pkg/semtech-loramac/Kconfig
```kconfig
config APPLICATION
    bool
    default y
    depends on TEST_KCONFIG
    imply MODULE_SEMTECH_LORAMAC_RX if !BOARD_HAS_NOT_ENOUGH_MEMORY
    select MODULE_PERIPH_EEPROM if HAS_PERIPH_EEPROM

config BOARD_HAS_NOT_ENOUGH_MEMORY
    bool
    default y
    depends on BOARD_ARDUINO-MEGA2560 || BOARD_I-NUCLEO-LRWAN1 || BOARD_STM32F0DISCOVERY || BOARD_WASPMOTE-PRO
```

## tests/pkg/tflite-micro/Kconfig
```kconfig
config MODULE_CORTEXM_FPU
    bool
    default n
    depends on TEST_KCONFIG
    depends on CPU_CORE_CORTEX_M
    depends on HAS_CORTEXM_FPU
```

## tests/pkg/tflite-micro/external_modules/mnist/Kconfig
```kconfig
# Copyright (c) 2022 Inria
#
# This file is subject to the terms and conditions of the GNU Lesser
# General Public License v2.1. See the file LICENSE in the top level
# directory for more details.
#

config MODULE_MNIST
    bool "MNIST main functions"
    depends on TEST_KCONFIG
```

## tests/pkg_qr-code-generator/Kconfig
```kconfig
config APPLICATION
    bool
    default y
    imply MODULE_DISP_DEV if BOARD_HAS_DISPLAY
    depends on TEST_KCONFIG

config BOARD_HAS_DISPLAY
    bool
    default y
    depends on BOARD_PINETIME || BOARD_ADAFRUIT_CLUE || BOARD_STM32F429I_DISC1 || BOARD_STM32F429I_DISCO || BOARD_ESP32_WROVER_KIT
```

## tests/sys/conn_can/Kconfig
```kconfig
config APPLICATION
    bool
    default y
    depends on TEST_KCONFIG
    depends on HAS_PERIPH_CAN
    depends on HAS_PERIPH_GPIO_IRQ
    select MODULE_PERIPH_CAN
    select MODULE_PERIPH_GPIO_IRQ

choice CAN_TRX_TO_BUILD
    bool "CAN TRX transceiver selection"
    default CAN_TRX_TJA1042
    depends on TEST_KCONFIG

config CAN_TRX_TJA1042
    bool "tja1042 transceiver"
    select MODULE_TJA1042

config CAN_TRX_NCV7356
    bool "ncv7356 transceiver"
    select MODULE_NCV7356

endchoice
```
