## pkg/lua/Kconfig
```kconfig
# Copyright (c) 2022 Inria
#
# This file is subject to the terms and conditions of the GNU Lesser
# General Public License v2.1. See the file LICENSE in the top level
# directory for more details.
#

config PACKAGE_LUA
    bool "LUA language package"
    depends on TEST_KCONFIG
    depends on HAS_ARCH_32BIT
    depends on !HAS_ARCH_MIPS32R2
    depends on !HAS_ARCH_RISCV
    depends on !MODULE_PICOLIBC

    select PACKAGE_TLSF
    select MODULE_PRINTF_FLOAT
    select MODULE_LUA-CONTRIB

    select MODULE_LIBC_GETTIMEOFDAY if !CPU_NATIVE

config MODULE_LUA-CONTRIB
    bool
    depends on TEST_KCONFIG
```

## pkg/lv_drivers/Kconfig
```kconfig
# Copyright (c) 2022 Inria
#
# This file is subject to the terms and conditions of the GNU Lesser
# General Public License v2.1. See the file LICENSE in the top level
# directory for more details.
#

menuconfig PACKAGE_LV_DRIVERS
    bool "LVGL Drivers Package"
    depends on TEST_KCONFIG
    depends on PACKAGE_LVGL

config MODULE_LV_DRIVERS_SDL
    bool "Monitor driver"
    depends on HAS_ARCH_NATIVE
    select PACKAGE_LV_DRIVERS

config HAVE_SDL
    bool
    select MODULE_LV_DRIVERS_SDL if PACKAGE_LVGL
    help
        Indicates a display monitor is present
```

## pkg/lz4/Kconfig
```kconfig
# Copyright (c) 2021 Inria
#
# This file is subject to the terms and conditions of the GNU Lesser
# General Public License v2.1. See the file LICENSE in the top level
# directory for more details.

config PACKAGE_LZ4
    bool "LZ4 fast compression library"
    depends on TEST_KCONFIG
```

## pkg/mbedtls/Kconfig
```kconfig
# Copyright (c) 2021 HAW Hamburg
#
# This file is subject to the terms and conditions of the GNU Lesser
# General Public License v2.1. See the file LICENSE in the top level
# directory for more details.

menu "mbed TLS"
    depends on USEPKG_MBEDTLS

config MBEDTLS_SELF_TEST
    bool "Enable the checkup functions (*_self_test)"

rsource "contrib/crypto/Kconfig"
rsource "contrib/entropy/Kconfig"
rsource "contrib/random/Kconfig"
rsource "contrib/ssl/Kconfig"
rsource "contrib/threading/Kconfig"
rsource "contrib/x509/Kconfig"

endmenu # mbed TLS
```
