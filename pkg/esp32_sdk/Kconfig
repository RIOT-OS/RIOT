## pkg/esp32_sdk/Kconfig
```kconfig
# Copyright (c) 2021 Gunar Schorcht
#
# This file is subject to the terms and conditions of the GNU Lesser
# General Public License v2.1. See the file LICENSE in the top level
# directory for more details.
#

config PACKAGE_ESP32_SDK
    bool "ESP32 SDK for the ESP32 MCU support"
    depends on TEST_KCONFIG
    depends on HAS_ARCH_ESP32
    help
        Vendor SDK without libraries for ESP32 MCU support by Espressif
```

## pkg/esp32_sdk_lib_bt_esp32c3/Kconfig
```kconfig
# Copyright (c) 2021 Gunar Schorcht
#
# This file is subject to the terms and conditions of the GNU Lesser
# General Public License v2.1. See the file LICENSE in the top level
# directory for more details.
#

config PACKAGE_ESP32_SDK_LIB_BT_ESP32C3
    bool "ESP32 SDK Bluetooth library for the ESP32-C3 SoC"
    depends on TEST_KCONFIG
    depends on HAS_ARCH_ESP32
    depends on HAS_ESP_BLE_ESP32C3
    help
        Vendor SDK Bluetooth library for ESP32-C3 SoC
```

## pkg/esp32_sdk_lib_phy/Kconfig
```kconfig
# Copyright (c) 2021 Gunar Schorcht
#
# This file is subject to the terms and conditions of the GNU Lesser
# General Public License v2.1. See the file LICENSE in the top level
# directory for more details.
#

config PACKAGE_ESP32_SDK_LIB_PHY
    bool "ESP32 SDK libraries for the ESP32 SoC support"
    depends on TEST_KCONFIG
    depends on HAS_ARCH_ESP32
    help
        Vendor SDK libraries for ESP32 SoC support by Espressif
```

## pkg/esp32_sdk_libs/Kconfig
```kconfig
# Copyright (c) 2021 Gunar Schorcht
#
# This file is subject to the terms and conditions of the GNU Lesser
# General Public License v2.1. See the file LICENSE in the top level
# directory for more details.
#

config PACKAGE_ESP32_SDK_LIBS
    bool "ESP32 SDK libraries for the ESP32 MCU support"
    depends on TEST_KCONFIG
    depends on HAS_ARCH_ESP32
    help
        Vendor SDK libraries for ESP32 MCU support by Espressif
```

## pkg/esp8266_sdk/Kconfig
```kconfig
# Copyright (c) 2021 HAW Hamburg
#
# This file is subject to the terms and conditions of the GNU Lesser
# General Public License v2.1. See the file LICENSE in the top level
# directory for more details.
#

config PACKAGE_ESP8266_SDK
    bool "Vendor library for the ESP8266 MCU RTOS support"
    depends on TEST_KCONFIG
    depends on HAS_ARCH_ESP8266
```

## pkg/etl/Kconfig
```kconfig
# Copyright (c) 2022 Jens Wetterich <jens@wetterich-net.de>
#
# This file is subject to the terms and conditions of the GNU Lesser
# General Public License v2.1. See the file LICENSE in the top level
# directory for more details.
#

config PACKAGE_ETL
    bool "Embedded Template Library"
    depends on TEST_KCONFIG
    depends on HAS_CPP
    select MODULE_CPP
    help
        This is a drop-in replacement for the C++ standard library with fixed-size containers.
        It does not rely on dynamic memory. It also provides type-traits for boards without standard library.
        See the website for more details.
```

## pkg/fff/Kconfig
```kconfig
# Copyright (c) 2021 Jens Wetterich <jens@wetterich-net.de>
#
# This file is subject to the terms and conditions of the GNU Lesser
# General Public License v2.1. See the file LICENSE in the top level
# directory for more details.
#

config PACKAGE_FFF
    bool "Fake functions framework"
    depends on TEST_KCONFIG
    help
        A header only fake functions framework for unit testing.
```

## pkg/fido2_tests/Kconfig
```kconfig
config PACKAGE_FIDO2_TESTS
    bool "FIDO2 tests"
    help
        Test suite for FIDO2, U2F, and other security key functions.
```

## pkg/flatbuffers/Kconfig
```kconfig
# Copyright (c) 2022 Inria
#
# This file is subject to the terms and conditions of the GNU Lesser
# General Public License v2.1. See the file LICENSE in the top level
# directory for more details.
#

config PACKAGE_FLATBUFFERS
    bool "Flatbuffers package"
    depends on TEST_KCONFIG
    depends on HAS_CPP
    depends on HAS_LIBSTDCPP

    select MODULE_LIBSTDCPP
    select MODULE_CPP11-COMPAT
```

## pkg/gecko_sdk/Kconfig
```kconfig
# Copyright (c) 2021 HAW Hamburg
#               2022 SSV Software Systems GmbH
#
# This file is subject to the terms and conditions of the GNU Lesser
# General Public License v2.1. See the file LICENSE in the top level
# directory for more details.
#

## Definition of Gecko SDK specific features
config HAS_GECKO_SDK_LIBRAIL_NONFPU
    bool
    help
        Indicates that the CPU offers librail support if the FPU is disabled.
        Librail is shipped as pre-compiled blobs. Thus, we have to adapt to
        their choice how to process floats.

config HAS_GECKO_SDK_LIBRAIL_FPU
    bool
    help
        Indicates that the CPU offers librail support if the FPU is enabled.
        Librail is shipped as pre-compiled blobs. Thus, we have to adapt to
        their choice how to process floats.


## Provided modules
menuconfig PACKAGE_GECKO_SDK
    bool "Vendor library for EFM/EFR/EZR32 MCUs"
    depends on TEST_KCONFIG
    help
        Vendor library for EFM/EFR/EZR32 targets by Silicon Labs.
        See: https://siliconlabs.github.io/Gecko_SDK_Doc/

if PACKAGE_GECKO_SDK

config MODULE_GECKO_SDK_EMLIB
    bool
    default y
    help
        EMLIB is a low-level peripheral support library that provides a unified
        API for all EFM32, EZR32 and EFR32 MCUs and SoCs from Silicon Labs.

config MODULE_GECKO_SDK_EMLIB_EXTRA
    bool
    default y
    help
        Extra utility methods from EMBLIB vendor library.

config MODULE_GECKO_SDK_LIBRAIL
    bool "Radio Abstraction Interface Layer (RAIL)"
    depends on (HAS_GECKO_SDK_LIBRAIL_NONFPU && !MODULE_CORTEXM_FPU) || (HAS_GECKO_SDK_LIBRAIL_FPU && MODULE_CORTEXM_FPU)
    help
        The Silicon Labs Radio Abstraction Interface Layer (RAIL) is required
        to use the integrated radio offered by the EFR32 families.

config MODULE_GECKO_SDK_LIBRAIL_PA
    bool "Power Amplifier Power Conversion Functions"
    depends on MODULE_GECKO_SDK_LIBRAIL
    help
        Helper to convert between transmission power in dBm and the
        chip- and circuit-specific raw power level.

endif # PACKAGE_GECKO_SDK
```

## pkg/gemmlowp/Kconfig
```kconfig
# Copyright (c) 2021 HAW Hamburg
#
# This file is subject to the terms and conditions of the GNU Lesser
# General Public License v2.1. See the file LICENSE in the top level
# directory for more details.
#

config PACKAGE_GEMMLOWP
    bool "General Matrix Multiplication package"
    depends on TEST_KCONFIG
    select MODULE_GEMMLOWP
    help
        A small self-contained low-precision GEMM library.

config MODULE_GEMMLOWP
    bool
    depends on TEST_KCONFIG
```

## pkg/heatshrink/Kconfig
```kconfig
# Copyright (c) 2021 HAW Hamburg
#
# This file is subject to the terms and conditions of the GNU Lesser
# General Public License v2.1. See the file LICENSE in the top level
# directory for more details.
#

config PACKAGE_HEATSHRINK
    bool "Lightweight Compression package"
    depends on TEST_KCONFIG
    help
        This package provides a compression library specifically
        developed for memory-constrained devices.
```

## pkg/jerryscript/Kconfig
```kconfig
# Copyright (c) 2022 Inria
#
# This file is subject to the terms and conditions of the GNU Lesser
# General Public License v2.1. See the file LICENSE in the top level
# directory for more details.
#

config PACKAGE_JERRYSCRIPT
    bool "Ultra-lightweight Javascript interpreter"
    depends on TEST_KCONFIG
    depends on HAS_ARCH_32BIT || HAS_ARCH_64BIT

    select MODULE_JERRYSCRIPT-PORT-DEFAULT
    select MODULE_JERRYSCRIPT-EXT

config MODULE_JERRYSCRIPT-PORT-DEFAULT
    bool

config MODULE_JERRYSCRIPT-EXT
    bool
```

## pkg/libb2/Kconfig
```kconfig
# Copyright (c) 2021 HAW Hamburg
#
# This file is subject to the terms and conditions of the GNU Lesser
# General Public License v2.1. See the file LICENSE in the top level
# directory for more details.
#

config PACKAGE_LIBB2
    bool "BLAKE2 cryptographic hash function package"
    depends on TEST_KCONFIG
    depends on !HAS_ARCH_8BIT
    help
        BLAKE2 is a cryptographic hash function specified in RFC 7693.
        It claims to be faster than MD5, SHA-1, SHA-2, and SHA-3, yet at
        least as secure as the latest standard SHA-3.
```
