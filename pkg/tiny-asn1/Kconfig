## pkg/tiny-asn1/Kconfig
```kconfig
# Copyright (c) 2021 HAW Hamburg
#
# This file is subject to the terms and conditions of the GNU Lesser
# General Public License v2.1. See the file LICENSE in the top level
# directory for more details.
#

config PACKAGE_TINY-ASN1
    bool "ASN.1 decoding/encoding package"
    depends on TEST_KCONFIG
```

## pkg/tinycbor/Kconfig
```kconfig
# Copyright (c) 2021 HAW Hamburg
#
# This file is subject to the terms and conditions of the GNU Lesser
# General Public License v2.1. See the file LICENSE in the top level
# directory for more details.
#

menuconfig PACKAGE_TINYCBOR
    bool "Tiny CBOR encode/decoder package"
    depends on TEST_KCONFIG
    depends on HAS_ARCH_32BIT
    help
        TinyCBOR is a CBOR encoder and decoder with a very small
        footprint, optimized for very fast operation.

config MODULE_TINYCBOR_FLOAT
    bool "Float support for Tiny CBOR"
    depends on TEST_KCONFIG
    depends on PACKAGE_TINYCBOR
```

## pkg/tinyusb/Kconfig
```kconfig
# Copyright (c) 2022 Gunar Schorcht
#
# This file is subject to the terms and conditions of the GNU Lesser
# General Public License v2.1. See the file LICENSE in the top level
# directory for more details.
#

if USEPKG_TINYUSB

menu "Device Classes"

    rsource "Kconfig.cdc"
    rsource "dfu/Kconfig.dfu"
    rsource "dfu/Kconfig.dfu_rt"
    rsource "Kconfig.hid"
    rsource "Kconfig.msc"

endmenu

if USEMODULE_TINYUSB_DEVICE

config TUSBD_EP0_SIZE
    int "Device control endpoint (EP0) size [byte]"
    default 64

config TUSBD_FS_EP_SIZE
    int "Device endpoint size in Full-Speed mode [byte]"
    default 64

config TUSBD_HS_EP_SIZE
    int "Device endpoint size in High-Speed mode [byte]"
    default 512

config TUSBD_USE_CUSTOM_DESC
    bool "Custom device descriptors"
    depends on USEMODULE_TINYUSB_DEVICE
    help
        Enable this option to define custom descriptors for the selected
        device classes. Otherwise, generic descriptors will be generated
        according to the selected device classes.
        At the moment, the generation of generic descriptors is only supported
        for all combinations of up to two CDC interfaces, up to two generic
        In/Out HID interfaces, up to one MSC interface and up to one vendor
        interface. In all other cases, custom descriptors must be implemented
        and handled.

endif # USEMODULE_TINYUSB_DEVICE
endif # USEPKG_TINYUSB
```

## pkg/tinyusb/cdc_acm_stdio/Kconfig
```kconfig
# Copyright (c) 2022 Gunar Schorcht
#
# This file is subject to the terms and conditions of the GNU Lesser
# General Public License v2.1. See the file LICENSE in the top level
# directory for more details.
#

# extend STDIO options

choice STDIO_IMPLEMENTATION

config MODULE_STDIO_TINYUSB_CDC_ACM
    bool "CDC ACM (tinyUSB)"
    depends on MODULE_TINYUSB_DEVICE
    depends on MODULE_TINYUSB_CLASS_CDC
    select MODULE_STDIO_AVAILABLE
    select USE_STDOUT_BUFFERED

endchoice
```

## pkg/tinyusb/dfu/Kconfig.dfu
```kconfig
# Copyright (c) 2022 Gunar Schorcht
#
# This file is subject to the terms and conditions of the GNU Lesser
# General Public License v2.1. See the file LICENSE in the top level
# directory for more details.
#

if USEMODULE_TINYUSB_CLASS_DFU

config TUSBD_DFU_NUMOF
    int
    default 1

config TUSBD_DFU_FS_XFER_SIZE
    int "DFU Full-Speed transfer size [byte]"
    default 64

config TUSBD_DFU_HS_XFER_SIZE
    int "DFU High-Speed transfer size [byte]"
    default 512

config TUSBD_DFU_ALT_NUMOF
    int
    default 2
    help
        Number of alternative DFU firmware slots.

config TUSBD_DFU_DETACH_TIMEOUT
    int "DFU detach timeout [ms]"
    default 1000

config TUSBD_DFU_POLL_TIMEOUT
    int "DFU poll timeout [ms]"
    default 1
    help
        DFU Poll Timeout is the time before the host requests the status
        from the device during a firmware download or manifestation operation.

config TUSBD_DFU_RESET_DELAY
    int "DFU reset delay [s]"
    default 2
    help
        DFU reset delay is the time before the device is restarted after
        a firmware download.

endif # USEMODULE_TINYUSB_CLASS_DFU
```

## pkg/tinyusb/netdev/Kconfig
```kconfig
# Copyright (c) 2022 Gunar Schorcht
#
# This file is subject to the terms and conditions of the GNU Lesser
# General Public License v2.1. See the file LICENSE in the top level
# directory for more details.
#

config MODULE_TINYUSB_NETDEV
    bool "TinyUSB Network Device Driver"
    depends on HAS_TINYUSB_DEVICE
    depends on TEST_KCONFIG
    select MODULE_LUID
    select MODULE_NETDEV_ETH
    select MODULE_TINYUSB_CLASS_NET
    select KCONFIG_USB
    select REQUIRES_TINYUSB_DEVICE
```

## pkg/tlsf/Kconfig
```kconfig
# Copyright (c) 2021 HAW Hamburg
#
# This file is subject to the terms and conditions of the GNU Lesser
# General Public License v2.1. See the file LICENSE in the top level
# directory for more details.
#

menuconfig PACKAGE_TLSF
    bool "TLFS malloc/realloc/free/etc package"
    depends on TEST_KCONFIG
    depends on HAS_ARCH_32BIT
    help
        TLSF provides an implementation of malloc/realloc/free/etc.

if PACKAGE_TLSF

config MODULE_TLSF_MALLOC
    bool "TLSF malloc"
    depends on MODULE_NEWLIB || BOARD_NATIVE
    select MODULE_TLSF_MALLOC_NEWLIB if MODULE_NEWLIB
    select MODULE_TLSF_MALLOC_NATIVE if BOARD_NATIVE

config MODULE_TLSF_MALLOC_NEWLIB
    bool
    depends on TEST_KCONFIG

config MODULE_TLSF_MALLOC_NATIVE
    bool
    depends on TEST_KCONFIG

endif # PACKAGE_TLSF
```

## pkg/tweetnacl/Kconfig
```kconfig
# Copyright (c) 2021 HAW Hamburg
#
# This file is subject to the terms and conditions of the GNU Lesser
# General Public License v2.1. See the file LICENSE in the top level
# directory for more details.
#

config PACKAGE_TWEETNACL
    bool "TweetNaCl cryptographic library package"
    depends on TEST_KCONFIG
    depends on MODULE_RANDOM
    depends on !HAS_ARCH_MSP430
    help
        TweetNaCl is the world's first auditable high-security
        cryptographic library. TweetNaCl fits into just 100 tweets while
        supporting all 25 of the C NaCl functions used by applications.
```

## pkg/u8g2/Kconfig
```kconfig
# Copyright (c) 2021 HAW Hamburg
#
# This file is subject to the terms and conditions of the GNU Lesser
# General Public License v2.1. See the file LICENSE in the top level
# directory for more details.
#

config PACKAGE_U8G2
    bool "U8g2 monochrome graphics library for LCDs"
    depends on TEST_KCONFIG
    depends on HAS_PERIPH_GPIO
    select MODULE_PERIPH_GPIO
    select MODULE_XTIMER
    select MODULE_U8G2_RIOT
    select MODULE_U8G2_CSRC

config MODULE_U8G2_RIOT
    bool
    depends on TEST_KCONFIG

config MODULE_U8G2_CSRC
    bool
    depends on TEST_KCONFIG
```

## pkg/ubasic/Kconfig
```kconfig
# Copyright (c) 2021 HAW Hamburg
#
# This file is subject to the terms and conditions of the GNU Lesser
# General Public License v2.1. See the file LICENSE in the top level
# directory for more details.
#

config PACKAGE_UBASIC
    bool "UBasic Basic interpreter package"
    depends on TEST_KCONFIG
    depends on !HAS_ARCH_AVR8
    depends on !HAS_ARCH_MSP430
    depends on !HAS_ARCH_MIPS32R2
    depends on !HAS_ARCH_RISCV
```

## pkg/ucglib/Kconfig
```kconfig
# Copyright (c) 2021 HAW Hamburg
#
# This file is subject to the terms and conditions of the GNU Lesser
# General Public License v2.1. See the file LICENSE in the top level
# directory for more details.
#

config PACKAGE_UCGLIB
    bool "UcgLib color graphics library for OLED and LCD displays"
    depends on TEST_KCONFIG
    depends on HAS_PERIPH_GPIO
    select MODULE_PERIPH_GPIO
    select MODULE_ZTIMER
    select MODULE_ZTIMER_USEC
    select MODULE_UCGLIB_RIOT
    select MODULE_UCGLIB_CSRC

config MODULE_UCGLIB_RIOT
    bool
    depends on TEST_KCONFIG

config MODULE_UCGLIB_CSRC
    bool
    depends on TEST_KCONFIG
```

## pkg/utensor/Kconfig
```kconfig
# Copyright (c) 2021 HAW Hamburg
#
# This file is subject to the terms and conditions of the GNU Lesser
# General Public License v2.1. See the file LICENSE in the top level
# directory for more details.
#

config PACKAGE_UTENSOR
    bool "uTensor AI inference based on TensorFlow"
    depends on TEST_KCONFIG
    depends on HAS_LIBSTDCPP
    depends on HAS_CPP
    select MODULE_UTENSOR-OPS
    select MODULE_UTENSOR-UTIL
    select MODULE_CPP
    select MODULE_LIBSTDCPP

config MODULE_UTENSOR-OPS
    bool
    depends on TEST_KCONFIG

config MODULE_UTENSOR-UTIL
    bool
    depends on TEST_KCONFIG
```

## pkg/uwb-core/Kconfig
```kconfig
# Copyright (c) 2021 INRIA
#
# This file is subject to the terms and conditions of the GNU Lesser
# General Public License v2.1. See the file LICENSE in the top level
# directory for more details.
#

menuconfig PACKAGE_UWB-CORE
    bool "Decawave uwb-core package"
    select MODULE_UWB-CORE_DPL
    select MODULE_UWB-CORE_CONTRIB
    select MODULE_FMT
    depends on HAS_PERIPH_GPIO
    select MODULE_PERIPH_GPIO
    depends on HAS_PERIPH_GPIO_IRQ
    select MODULE_PERIPH_GPIO_IRQ
    depends on HAS_PERIPH_SPI
    select MODULE_PERIPH_SPI
    depends on !HAS_ARCH_NATIVE
    depends on !HAS_ARCH_AVR8

if PACKAGE_UWB-CORE

config MODULE_AUTO_INIT_UWB-CORE
    bool "Auto-initialize the usb-core package"
    default y
    depends on MODULE_AUTO_INIT

config MODULE_UWB-CORE_CONTRIB
    bool

config MODULE_UWB-CORE_DPL
    bool
    select PACKAGE_MYNEWT-CORE
    select MODULE_MYNEWT-CORE_OS
    select MODULE_MYNEWT-CORE_NRF5X_HAL if HAS_CPU_NRF52 || HAS_CPU_NRF51

config MODULE_UWB-CORE_TWR_SS
    bool "uwb-core two-way-ranging single sided"
    select MODULE_UWB-CORE_RNG

config MODULE_UWB-CORE_TWR_SS_ACK
    bool "uwb-core two-way-ranging single sided using hardware generated ack as response"
    select MODULE_UWB-CORE_RNG

config MODULE_UWB-CORE_TWR_SS_EXT
    bool "uwb-core two-way-ranging single sided with extended frames"
    select MODULE_UWB-CORE_RNG

config MODULE_UWB-CORE_TWR_DS
    bool "uwb-core two-way-ranging double sided"
    select MODULE_UWB-CORE_RNG

config MODULE_UWB-CORE_TWR_DS_EXT
    bool "uwb-core two-way-ranging double sided with extended frames"
    select MODULE_UWB-CORE_RNG

config MODULE_UWB-CORE_RNG
    bool "uwb-core ranging module"
    select MODULE_UWB-CORE_RNG_MATH
    select MODULE_UWB-CORE_DSP
    select MODULE_UWB-CORE_UWB_JSON

config MODULE_UWB-CORE_UWB_JSON
    bool "uwb-core JSON utilities"

config MODULE_UWB-CORE_DSP
    bool "uwb-core DSP module"

config MODULE_UWB-CORE_RNG_MATH
    bool "uwb-core ranging math utilities"

config MODULE_UWB-CORE_UWBCFG
    bool "uwb-core configuration module"
    select MODULE_UWB-CORE_CONFIG

config MODULE_UWB-CORE_EVENT_THREAD
    bool "Use event-thread loop as uwb-core's event loop"
    select MODULE_UWB-CORE_CONFIG

config MODULE_UWB-CORE_CONFIG
    bool

endif # PACKAGE_UWB-CORE
```

## pkg/uwb-dw1000/Kconfig
```kconfig
# Copyright (c) 2021 INRIA
#
# This file is subject to the terms and conditions of the GNU Lesser
# General Public License v2.1. See the file LICENSE in the top level
# directory for more details.
#

menuconfig PACKAGE_UWB-DW1000
    bool "Decawave dw1000 driver package"
    select MODULE_UWB-DW1000_HAL
    depends on HAS_PERIPH_GPIO
    select MODULE_PERIPH_GPIO
    depends on HAS_PERIPH_GPIO_IRQ
    select MODULE_PERIPH_GPIO_IRQ
    depends on HAS_PERIPH_SPI
    select MODULE_PERIPH_SPI
    depends on HAS_ARCH_32BIT

if PACKAGE_UWB-DW1000

config MODULE_AUTO_INIT_UWB-DW1000
    bool "Auto-initialize the uwb-dw1000 package"
    default y
    depends on MODULE_AUTO_INIT

config MODULE_UWB-DW1000_HAL
    bool

endif # PACKAGE_UWB-DW1000
```

## pkg/uzlib/Kconfig
```kconfig
# Copyright (c) 2021 Inria
#
# This file is subject to the terms and conditions of the GNU Lesser
# General Public License v2.1. See the file LICENSE in the top level
# directory for more details.

config PACKAGE_UZLIB
    bool "uzlib - Deflate/Zlib-compatible LZ77 compression/decompression library"
    depends on TEST_KCONFIG
```

## pkg/wakaama/Kconfig
```kconfig
# Copyright (c) 2021 HAW Hamburg
#
# This file is subject to the terms and conditions of the GNU Lesser
# General Public License v2.1. See the file LICENSE in the top level
# directory for more details.
#
menu "Wakaama LwM2M"
    depends on USEPKG_WAKAAMA

menu "Remote server"

config LWM2M_STANDARD_PORT
    string "CoAP default port of a LwM2M server"
    default "5683"

config LWM2M_DTLS_PORT
    string "CoAPS default port of a LwM2M server"
    default "5684"

endmenu # Remote server

rsource "contrib/objects/Kconfig"

config LWM2M_DEVICE_TTL
    int "Lifetime of the device"
    default 300
    help
        Lifetime of the device on the LwM2M server, expressed in seconds.

config LWM2M_LOCAL_PORT
    string "Port for the local LwM2M CoAP"
    default "5683"

config LWM2M_LOCAL_DTLS_PORT
    string "Port for the local LwM2M CoAPs server"
    default "5684"

config LWM2M_ALT_PATH
    string "Alternate path to place LwM2M resources"
    default "/"

config LWM2M_WITH_LOGS
    bool "Debug logs"

config LWM2M_TLSF_BUFFER
    int "Allocation buffer size"
    default 5120

config LWM2M_CREDMAN_TAG_BASE
    int "Credential tag base"
    default 10
    help
        Number to use as base for assigning tags to @ref net_credman
        credentials.

config LWM2M_URI_MAX_SIZE
    int "Maximum length of an URI allowed"
    default 64

config LWM2M_BOOTSTRAP
    bool "Bootsrap server support"
    help
        Say y to support using a bootstrap server to get server information.

endmenu # Wakaama LwM2M
```

## pkg/wakaama/contrib/objects/Kconfig.ipso
```kconfig
menu "IPSO sensor objects"
    depends on USEMODULE_WAKAAMA_OBJECTS_IPSO_SENSOR_BASE

config LWM2M_IPSO_SENSOR_BASE_UNITS_MAX_SIZE
    int "Maximum size of strings representing units"
    default 4

menu "IPSO barometer object"
    depends on USEMODULE_WAKAAMA_OBJECTS_BAROMETER

config LWM2M_BAROMETER_INSTANCES_MAX
    int "Maximum number of barometer object instances"
    default 1

endmenu

menu "IPSO current object"
    depends on USEMODULE_WAKAAMA_OBJECTS_CURRENT

config LWM2M_CURRENT_INSTANCES_MAX
    int "Maximum number of current object instances"
    default 1

endmenu

menu "IPSO humidity object"
    depends on USEMODULE_WAKAAMA_OBJECTS_HUMIDITY

config LWM2M_HUMIDITY_INSTANCES_MAX
    int "Maximum number of humidity object instances"
    default 1

endmenu

menu "IPSO illuminance object"
    depends on USEMODULE_WAKAAMA_OBJECTS_ILLUMINANCE

config LWM2M_ILLUMINANCE_INSTANCES_MAX
    int "Maximum number of illuminance object instances"
    default 1

endmenu

menu "IPSO temperature object"
    depends on USEMODULE_WAKAAMA_OBJECTS_TEMPERATURE

config LWM2M_TEMPERATURE_INSTANCES_MAX
    int "Maximum number of temperature object instances"
    default 1

endmenu

menu "IPSO voltage object"
    depends on USEMODULE_WAKAAMA_OBJECTS_VOLTAGE

config LWM2M_VOLTAGE_INSTANCES_MAX
    int "Maximum number of voltage object instances"
    default 1

endmenu

endmenu # "IPSO objects"
```

## pkg/yxml/Kconfig
```kconfig
# Copyright (c) 2021 HAW Hamburg
#
# This file is subject to the terms and conditions of the GNU Lesser
# General Public License v2.1. See the file LICENSE in the top level
# directory for more details.
#

config PACKAGE_YXML
    bool "yXML parser library"
    depends on TEST_KCONFIG
    depends on !HAS_ARCH_16BIT
    depends on !HAS_ARCH_8BIT
```

## sys/Kconfig
```kconfig
# SPDX-FileCopyrightText: 2019 HAW Hamburg
# SPDX-License-Identifier: LGPL-2.1-only

menu "System"

rsource "auto_init/Kconfig"
rsource "can/Kconfig"
rsource "chunked_ringbuffer/Kconfig"
rsource "congure/Kconfig"
rsource "debug_irq_disable/Kconfig"
rsource "entropy_source/Kconfig"
rsource "fido2/Kconfig"
rsource "net/Kconfig"
rsource "progress_bar/Kconfig"
rsource "psa_crypto/Kconfig"
rsource "shell/Kconfig"
rsource "shell_lock/Kconfig"
rsource "usb/Kconfig"

endmenu # System
```
