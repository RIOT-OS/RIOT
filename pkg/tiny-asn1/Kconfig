## sys/Kconfig.newlib
```kconfig
# Copyright (c) 2020 HAW Hamburg
#
# This file is subject to the terms and conditions of the GNU Lesser
# General Public License v2.1. See the file LICENSE in the top level
# directory for more details.
#

if MODULE_NEWLIB

config MODULE_NEWLIB_NANO
    bool "NewLib Nano"

config MODULE_NEWLIB_GNU_SOURCE
    bool "NewLib GNU source"

config MODULE_NEWLIB_SYSCALLS_DEFAULT
    bool
    default y
    depends on !HAVE_CUSTOM_NEWLIB_SYSCALLS
    select MODULE_DIV
    help
        Default implementation of newlib system calls.

config MODULE_LIBC_GETTIMEOFDAY
    bool
    select MODULE_NEWLIB_SYSCALLS_DEFAULT if MODULE_NEWLIB
    select MODULE_XTIMER
    select MODULE_ZTIMER64_XTIMER_COMPAT if MODULE_ZTIMER_XTIMER_COMPAT
    help
        Support for gettimeofday()

endif # MODULE_NEWLIB

config HAVE_CUSTOM_NEWLIB_SYSCALLS
    bool
    help
        Indicates that a custom newlib syscalls implementation is present.
```

## sys/Kconfig.picolibc
```kconfig
# Copyright (c) 2021 HAW Hamburg
#
# This file is subject to the terms and conditions of the GNU Lesser
# General Public License v2.1. See the file LICENSE in the top level
# directory for more details.
#

if MODULE_PICOLIBC

config PICOLIBC_STDOUT_BUFFERED
    bool "Buffered standard output"
    default USE_STDOUT_BUFFERED
    help
        Say y to use buffering in the standard output, usually good for modules that benefit from
        sending out buffers in larger chunks.

config MODULE_PICOLIBC_SYSCALLS_DEFAULT
    bool
    default y
    depends on !HAVE_CUSTOM_PICOLIBC_SYSCALLS
    help
        Default implementation of picolibc system calls.

endif # MODULE_PICOLIBC

config HAVE_CUSTOM_PICOLIB_SYSCALLS
    bool
    help
        Indicates that a custom picolibc syscalls implementation is present.
```

## sys/Kconfig.stdio
```kconfig
# Copyright (c) 2020 HAW Hamburg
#
# This file is subject to the terms and conditions of the GNU Lesser
# General Public License v2.1. See the file LICENSE in the top level
# directory for more details.
#

menu "Standard Input/Output (STDIO)"
    depends on TEST_KCONFIG

config FORCE_USB_STDIO
    bool "Force a USB based STDIO"
    depends on HAS_PERIPH_USBDEV || HAS_TINYUSB_DEVICE
    select KCONFIG_USB
    select REQUIRES_USB_STDIO
    help
        To prevent a circular dependency, can force the USB modules to that
        STDIO will select some sort of USB based STDIO backend.

choice STDIO_IMPLEMENTATION
    bool "STDIO implementation"
    default MODULE_STDIO_NATIVE if CPU_ARCH_NATIVE
    default MODULE_STDIO_CDC_ACM if MODULE_USBUS && REQUIRES_USB_STDIO
    default MODULE_STDIO_TINYUSB_CDC_ACM if MODULE_TINYUSB_DEVICE && REQUIRES_USB_STDIO
    default MODULE_STDIO_UART

config MODULE_STDIO_RTT
    bool "JLink RTT"
    select MODULE_ZTIMER
    select MODULE_ZTIMER_MSEC

config MODULE_STDIO_SEMIHOSTING
    bool "ARM and RISC-V Semihosting"
    depends on HAS_ARCH_ARM || HAS_ARCH_RISCV
    select MODULE_ZTIMER
    select MODULE_ZTIMER_MSEC
    select USE_STDOUT_BUFFERED

config MODULE_SLIPDEV_STDIO
    bool "SLIP network device"
    depends on MODULE_SLIPDEV
    select USE_STDOUT_BUFFERED
    select MODULE_ISRPIPE

config MODULE_STDIO_NULL
    bool "Null"
    help
        Empty implementation.

config MODULE_STDIO_UART
    bool "UART"
    depends on HAS_PERIPH_UART
    select MODULE_PERIPH_UART

config MODULE_STDIO_UART_ONLCR
    bool "Emit DOS line endings for STDIO output via UART"
    depends on MODULE_STDIO_UART

config MODULE_STDIO_NATIVE
    bool "Native"
    depends on CPU_ARCH_NATIVE

config MODULE_STDIO_ETHOS
    bool "ETHOS"
    depends on MODULE_ETHOS
    select MODULE_STDIN
    select MODULE_ETHOS_STDIO
    select USE_STDOUT_BUFFERED

endchoice

config MODULE_STDIN
    bool "Standard Input"

config MODULE_STDIO_UART_RX
    bool
    depends on MODULE_STDIO_UART
    select MODULE_ISRPIPE
    select MODULE_STDIO_AVAILABLE
    default y if MODULE_STDIN
    help
        Reception when using UART-based STDIO needs to be enabled.

config MODULE_STDIO_USB_SERIAL_JTAG_RX
    bool
    depends on MODULE_STDIO_USB_SERIAL_JTAG
    select MODULE_ISRPIPE
    select MODULE_STDIO_AVAILABLE
    default y if MODULE_STDIN
    help
        Reception when using ESP32 USB Serial/JTAG STDIO needs to be enabled.

config MODULE_STDIO_AVAILABLE
    bool
    help
        Indicates that the implementation supports function stdio_available

config MODULE_PRINTF_FLOAT
    bool "Float support in printf"

config USE_STDOUT_BUFFERED
    bool
    help
        Select this to prefer buffered standard output if provided by the implementation.

config REQUIRES_USB_STDIO
    bool
    help
        Indicates that the STDIO requires some USB implementation to be enabled.

endmenu # Standard Input/Output (STDIO)
```

## sys/arduino/Kconfig
```kconfig
# Copyright (c) 2020 HAW Hamburg
#
# This file is subject to the terms and conditions of the GNU Lesser
# General Public License v2.1. See the file LICENSE in the top level
# directory for more details.
#

config MODULE_ARDUINO_SKETCHES
    bool

menuconfig MODULE_ARDUINO
    bool "Arduino support"
    imply MODULE_ARDUINO_PWM
    imply MODULE_PERIPH_ADC
    imply MODULE_PERIPH_I2C
    imply MODULE_PERIPH_SPI
    depends on HAS_ARDUINO
    depends on HAS_PERIPH_GPIO
    depends on HAS_CPP
    depends on TEST_KCONFIG
    select MODULE_PERIPH_GPIO
    select MODULE_CPP
    select MODULE_ARDUINO_SKETCHES
    select MODULE_FMT
    select MODULE_ZTIMER
    select MODULE_ZTIMER_MSEC
    select MODULE_ZTIMER_USEC

config MODULE_ARDUINO_PWM
    bool "PWM support for Arduino"
    depends on HAS_PERIPH_PWM
    depends on MODULE_ARDUINO
    depends on TEST_KCONFIG
    select MODULE_PERIPH_PWM
```

## sys/auto_init/Kconfig
```kconfig
# SPDX-FileCopyrightText: 2020 HAW Hamburg
# SPDX-License-Identifier: LGPL-2.1-only

if USEMODULE_AUTO_INIT

config AUTO_INIT_ENABLE_DEBUG
    bool "Print a debug message before a module is initialized"
    default n

endif # USEMODULE_AUTO_INIT
```

## sys/auto_init/can/Kconfig
```kconfig
# Copyright (c) 2023 Inria
#
# This file is subject to the terms and conditions of the GNU Lesser
# General Public License v2.1. See the file LICENSE in the top level
# directory for more details.
#

config MODULE_AUTO_INIT_CAN
    bool "Auto-initialize CAN drivers"
```
