## pkg/arduino_adafruit_lis3dh/Kconfig
```kconfig
# Copyright (c) 2021 Gunar Schorcht
#
# This file is subject to the terms and conditions of the GNU Lesser
# General Public License v2.1. See the file LICENSE in the top level
# directory for more details.
#

config PACKAGE_ARDUINO_ADAFRUIT_LIS3DH
    bool "Arduino Adafruit LIS3DH driver package"
    depends on TEST_KCONFIG
    select PACKAGE_ARDUINO_ADAFRUIT_SENSOR
    help
        Arduino driver package for the Adafruit Adafruit LIS3DH
        Triple-Axis Accelerometer breakout with ST LIS3DH sensor

choice MODULE_ARDUINO_LIS3DH
    bool "Device Interface"
    depends on PACKAGE_ARDUINO_ADAFRUIT_LIS3DH
    help
        The driver supports LIS3DH connected either via SPI or
        I2C bus.

    config MODULE_ARDUINO_ADAFRUIT_LIS3DH_I2C
        bool "I2C"
        depends on HAS_PERIPH_I2C
        select MODULE_PERIPH_I2C

    config MODULE_ARDUINO_ADAFRUIT_LIS3DH_SPI
        bool "SPI"
        depends on HAS_PERIPH_SPI
        select MODULE_PERIPH_SPI

endchoice
```

## pkg/arduino_adafruit_lsm9ds0/Kconfig
```kconfig
# Copyright (c) 2021 Gunar Schorcht
#
# This file is subject to the terms and conditions of the GNU Lesser
# General Public License v2.1. See the file LICENSE in the top level
# directory for more details.
#

config PACKAGE_ARDUINO_ADAFRUIT_LSM9DS0
    bool "Arduino Adafruit LSM9DS0 driver package"
    depends on TEST_KCONFIG
    select PACKAGE_ARDUINO_ADAFRUIT_SENSOR
    help
        Arduino driver package for the Adafruit Accelerometer + Gyro +
        Magnetometer 9-DOF breakout module with the ST LSM9DS0 sensor

choice MODULE_ARDUINO_LSM9DS0
    bool "Device Interface"
    depends on PACKAGE_ARDUINO_ADAFRUIT_LSM9DS0
    help
        The driver supports LSM9DS0 connected either via SPI or
        I2C bus.

    config MODULE_ARDUINO_ADAFRUIT_LSM9DS0_I2C
        bool "I2C"
        depends on HAS_PERIPH_I2C
        select MODULE_PERIPH_I2C

    config MODULE_ARDUINO_ADAFRUIT_LSM9DS0_SPI
        bool "SPI"
        depends on HAS_PERIPH_SPI
        select MODULE_PERIPH_SPI

endchoice
```

## pkg/arduino_adafruit_sensor/Kconfig
```kconfig
# Copyright (c) 2021 Gunar Schorcht
#
# This file is subject to the terms and conditions of the GNU Lesser
# General Public License v2.1. See the file LICENSE in the top level
# directory for more details.
#

config PACKAGE_ARDUINO_ADAFRUIT_SENSOR
    bool "Arduino Adafruit Unified Sensor Driver package"
    depends on TEST_KCONFIG
    select MODULE_ARDUINO
```

## pkg/arduino_api/Kconfig
```kconfig
config PACKAGE_ARDUINO_API
    bool "Arduino API package"
    depends on TEST_KCONFIG
    depends on MODULE_ARDUINO
```

## pkg/arduino_sdi_12/Kconfig
```kconfig
config PACKAGE_ARDUINO_SDI_12
    bool "Arduino SDI-12 package"
    depends on TEST_KCONFIG
    depends on PACKAGE_ARDUINO_API
```

## pkg/c25519/Kconfig
```kconfig
# Copyright (c) 2021 HAW Hamburg
#
# This file is subject to the terms and conditions of the GNU Lesser
# General Public License v2.1. See the file LICENSE in the top level
# directory for more details.
#

config PACKAGE_C25519
    bool "Curve255191 Diffie-Hellman function package"
    depends on TEST_KCONFIG
    help
        This package contains portable public-domain implementations of
        Daniel J. Bernstein's Curve255191 Diffie-Hellman function, and
        of the Ed25519 signature system. The memory consumption is low
        enough that they could be reasonably considered for most
        microcontroller applications. In particular, Curve25519 scalar
        multiplication uses less than half a kB of peak stack usage.
```

## pkg/c25519/psa_c25519/Kconfig
```kconfig
# Copyright (c) 2023 TU Dresden
#
# This file is subject to the terms and conditions of the GNU Lesser
# General Public License v2.1. See the file LICENSE in the top level
# directory for more details.
#

config MODULE_PSA_C25519_EDSIGN
    bool
    select MODULE_PSA_C25519

config MODULE_PSA_C25519
    bool
    depends on MODULE_PSA_CRYPTO
    depends on MODULE_RANDOM
```

## pkg/cayenne-lpp/Kconfig
```kconfig
# Copyright (c) 2021 HAW Hamburg
#
# This file is subject to the terms and conditions of the GNU Lesser
# General Public License v2.1. See the file LICENSE in the top level
# directory for more details.
#

config PACKAGE_CAYENNE-LPP
    bool "Cayenne Low Power Payload package"
    depends on TEST_KCONFIG
    help
        The Cayenne Low Power Payload (LPP) provides a convenient and
        easy way to send data over LPWAN networks such as LoRaWAN.
```

## pkg/ccn-lite/Kconfig
```kconfig
# Copyright (c) 2020 HAW Hamburg
#
# This file is subject to the terms and conditions of the GNU Lesser
# General Public License v2.1. See the file LICENSE in the top level
# directory for more details.
#

config PKG_CCN_LITE
    bool "CCN-lite"
    depends on MOD_EVTIMER
    select MOD_CCN_LITE_UTILS
    select MOD_POSIX_HEADERS
    select MOD_RANDOM
    select MOD_TIMEX

config MOD_CCN_LITE_UTILS
    bool
    help
        Enables utilities related to CCN-lite, like shell commands.
```

## pkg/cifra/Kconfig
```kconfig
# Copyright (c) 2021 HAW Hamburg
#
# This file is subject to the terms and conditions of the GNU Lesser
# General Public License v2.1. See the file LICENSE in the top level
# directory for more details.
#

config PACKAGE_CIFRA
    bool "Cifra cryptographic primitives"
    depends on TEST_KCONFIG
    depends on HAS_ARCH_32BIT
    help
        Cifra is a collection of cryptographic primitives targeted at
        embedded use.
```

## pkg/cmsis-dsp/Kconfig
```kconfig
# Copyright (c) 2021 HAW Hamburg
#
# This file is subject to the terms and conditions of the GNU Lesser
# General Public License v2.1. See the file LICENSE in the top level
# directory for more details.
#

config PACKAGE_CMSIS-DSP
    bool "DSP ARM CMSIS package"
    depends on TEST_KCONFIG
    help
        This package uses DSP ARM CMSIS header from the official ARM github repo:
        https://github.com/ARM-software/CMSIS_5.

if PACKAGE_CMSIS-DSP

config MODULE_CMSIS-DSP_BASICMATHFUNCTIONS
    bool
    default y
    help
        CMSIS DSP basic math functions.

config MODULE_CMSIS-DSP_COMMONTABLES
    bool
    default y
    help
        CMSIS DSP common tables.

config MODULE_CMSIS-DSP_COMPLEXMATHFUNCTIONS
    bool
    default y
    help
        CMSIS DSP complex math functions.

config MODULE_CMSIS-DSP_CONTROLLERFUNCTIONS
    bool
    default y
    help
        CMSIS DSP controller functions.

config MODULE_CMSIS-DSP_FASTMATHFUNCTIONS
    bool
    default y
    help
        CMSIS DSP fast math functions.

config MODULE_CMSIS-DSP_FILTERINGFUNCTIONS
    bool
    default y
    help
        CMSIS DSP filtering functions.

config MODULE_CMSIS-DSP_MATRIXFUNCTIONS
    bool
    default y
    help
        CMSIS DSP matrix functions.

config MODULE_CMSIS-DSP_STATISTICSFUNCTIONS
    bool
    default y
    help
        CMSIS DSP statistics functions.

config MODULE_CMSIS-DSP_SUPPORTFUNCTIONS
    bool
    default y
    help
        CMSIS DSP support functions.

config MODULE_CMSIS-DSP_TRANSFORMFUNCTIONS
    bool
    default y
    help
        CMSIS DSP transform functions.

endif # PACKAGE_CMSIS-DSP
```

## pkg/cmsis-nn/Kconfig
```kconfig
# Copyright (c) 2022 Inria
#
# This file is subject to the terms and conditions of the GNU Lesser
# General Public License v2.1. See the file LICENSE in the top level
# directory for more details.
#

config PACKAGE_CMSIS-NN
    bool "NN ARM CMSIS package"
    depends on TEST_KCONFIG
    depends on HAS_CPU_CORE_CORTEXM

    select MODULE_CMSIS-NN_ACTIVATIONFUNCTIONS
    select MODULE_CMSIS-NN_CONVOLUTIONFUNCTIONS
    select MODULE_CMSIS-NN_FULLYCONNECTEDFUNCTIONS
    select MODULE_CMSIS-NN_NNSUPPORTFUNCTIONS
    select MODULE_CMSIS-NN_POOLINGFUNCTIONS
    select MODULE_CMSIS-NN_SOFTMAXFUNCTIONS

config MODULE_CMSIS-NN_ACTIVATIONFUNCTIONS
    bool

config MODULE_CMSIS-NN_CONVOLUTIONFUNCTIONS
    bool

config MODULE_CMSIS-NN_FULLYCONNECTEDFUNCTIONS
    bool

config MODULE_CMSIS-NN_NNSUPPORTFUNCTIONS
    bool

config MODULE_CMSIS-NN_POOLINGFUNCTIONS
    bool

config MODULE_CMSIS-NN_SOFTMAXFUNCTIONS
    bool
```

## pkg/cmsis/Kconfig
```kconfig
# Copyright (c) 2022 Inria
#
# This file is subject to the terms and conditions of the GNU Lesser
# General Public License v2.1. See the file LICENSE in the top level
# directory for more details.
#

menuconfig PACKAGE_CMSIS
    bool "ARM CMSIS package"
    depends on TEST_KCONFIG
    depends on HAS_CPU_CORE_CORTEXM
    help
        This package uses ARM CMSIS header from the official ARM github repo:
        https://github.com/ARM-software/CMSIS_5.

if PACKAGE_CMSIS

config MODULE_CMSIS-DSP
    bool "ARM CMSIS DSP module"
    select MODULE_CMSIS-DSP_BASICMATHFUNCTIONS
    select MODULE_CMSIS-DSP_COMMONTABLES
    select MODULE_CMSIS-DSP_COMPLEXMATHFUNCTIONS
    select MODULE_CMSIS-DSP_CONTROLLERFUNCTIONS
    select MODULE_CMSIS-DSP_FASTMATHFUNCTIONS
    select MODULE_CMSIS-DSP_FILTERINGFUNCTIONS
    select MODULE_CMSIS-DSP_MATRIXFUNCTIONS
    select MODULE_CMSIS-DSP_STATISTICSFUNCTIONS
    select MODULE_CMSIS-DSP_SUPPORTFUNCTIONS
    select MODULE_CMSIS-DSP_TRANSFORMFUNCTIONS

config MODULE_CMSIS-DSP_BASICMATHFUNCTIONS
    bool

config MODULE_CMSIS-DSP_COMMONTABLES
    bool

config MODULE_CMSIS-DSP_COMPLEXMATHFUNCTIONS
    bool

config MODULE_CMSIS-DSP_CONTROLLERFUNCTIONS
    bool

config MODULE_CMSIS-DSP_FASTMATHFUNCTIONS
    bool

config MODULE_CMSIS-DSP_FILTERINGFUNCTIONS
    bool

config MODULE_CMSIS-DSP_MATRIXFUNCTIONS
    bool

config MODULE_CMSIS-DSP_STATISTICSFUNCTIONS
    bool

config MODULE_CMSIS-DSP_SUPPORTFUNCTIONS
    bool

config MODULE_CMSIS-DSP_TRANSFORMFUNCTIONS
    bool


config MODULE_CMSIS-NN
    bool "ARM CMSIS NN module"

    select MODULE_CMSIS-NN_ACTIVATIONFUNCTIONS
    select MODULE_CMSIS-NN_CONVOLUTIONFUNCTIONS
    select MODULE_CMSIS-NN_FULLYCONNECTEDFUNCTIONS
    select MODULE_CMSIS-NN_NNSUPPORTFUNCTIONS
    select MODULE_CMSIS-NN_POOLINGFUNCTIONS
    select MODULE_CMSIS-NN_SOFTMAXFUNCTIONS

config MODULE_CMSIS-NN_ACTIVATIONFUNCTIONS
    bool

config MODULE_CMSIS-NN_CONVOLUTIONFUNCTIONS
    bool

config MODULE_CMSIS-NN_FULLYCONNECTEDFUNCTIONS
    bool

config MODULE_CMSIS-NN_NNSUPPORTFUNCTIONS
    bool

config MODULE_CMSIS-NN_POOLINGFUNCTIONS
    bool

config MODULE_CMSIS-NN_SOFTMAXFUNCTIONS
    bool


endif
```

## pkg/cn-cbor/Kconfig
```kconfig
# Copyright (c) 2021 HAW Hamburg
#
# This file is subject to the terms and conditions of the GNU Lesser
# General Public License v2.1. See the file LICENSE in the top level
# directory for more details.
#

config PACKAGE_CN-CBOR
    bool "Constrained Node CBOR"
    depends on TEST_KCONFIG
    depends on HAS_ARCH_32BIT
    select MODULE_POSIX_HEADERS
    help
        A constrained node implementation of CBOR in C.
```

## pkg/cryptoauthlib/Kconfig
```kconfig
# Copyright (c) 2022 Inria
#
# This file is subject to the terms and conditions of the GNU Lesser
# General Public License v2.1. See the file LICENSE in the top level
# directory for more details.
#

menuconfig PACKAGE_CRYPTOAUTHLIB
    bool "Microchip CryptoAuthentication Library package"
    depends on TEST_KCONFIG
    depends on !HAS_ARCH_EFM32
    depends on HAS_PERIPH_I2C
    select MODULE_AUTO_INIT_SECURITY
    select MODULE_CRYPTOAUTHLIB_CONTRIB

if PACKAGE_CRYPTOAUTHLIB

config MODULE_CRYPTOAUTHLIB_CONTRIB
    bool
    select ZTIMER_USEC
    select MODULE_PERIPH_I2C
    select MODULE_PERIPH_I2C_RECONFIGURE if HAS_PERIPH_I2C_RECONFIGURE

config MODULE_PSA_ATCA_DRIVER
    bool
    depends on PACKAGE_CRYPTOAUTHLIB
    default y if MODULE_PSA_CRYPTO
    select PSA_KEY_MANAGEMENT

config MODULE_CRYPTOAUTHLIB_TEST
    bool "Module for cryptoauthlib tests"
    depends on TEST_KCONFIG
    select MODULE_CRYPTOAUTHLIB_TEST_THIRD_PARTY_UNITY
    select MODULE_CRYPTOAUTHLIB_TEST_API_ATCAB
    select MODULE_CRYPTOAUTHLIB_TEST_API_CALIB
    select MODULE_CRYPTOAUTHLIB_TEST_API_CRYPTO
    select MODULE_CRYPTOAUTHLIB_TEST_VECTORS
    select MODULE_CRYPTOAUTHLIB_TEST_JWT
    select MODULE_CRYPTOAUTHLIB_TEST_TNG
    select MODULE_CRYPTOAUTHLIB_TEST_ATCACERT

config MODULE_CRYPTOAUTHLIB_TEST_JWT
    bool

config MODULE_CRYPTOAUTHLIB_TEST_TNG
    bool

config MODULE_CRYPTOAUTHLIB_TEST_ATCACERT
    bool

config MODULE_CRYPTOAUTHLIB_TEST_THIRD_PARTY_UNITY
    bool

config MODULE_CRYPTOAUTHLIB_TEST_API_ATCAB
    bool

config MODULE_CRYPTOAUTHLIB_TEST_API_CALIB
    bool

config MODULE_CRYPTOAUTHLIB_TEST_API_CRYPTO
    bool

config MODULE_CRYPTOAUTHLIB_TEST_VECTORS
    bool

endif # PACKAGE_CRYPTOAUTHLIB
```

## pkg/driver_atwinc15x0/Kconfig
```kconfig
# Copyright (c) 2021 HAW Hamburg
#
# This file is subject to the terms and conditions of the GNU Lesser
# General Public License v2.1. See the file LICENSE in the top level
# directory for more details.
#

config PACKAGE_DRIVER_ATWINC15X0
    bool "ATWINC15x0 WiFi driver package"
    depends on TEST_KCONFIG
    depends on HAS_PERIPH_SPI
    depends on HAS_PERIPH_GPIO
    depends on HAS_PERIPH_GPIO_IRQ
    select MODULE_PERIPH_SPI
    select MODULE_PERIPH_GPIO
    select MODULE_PERIPH_GPIO_IRQ
    select MODULE_DRIVER_ATWINC15X0
    select MODULE_DRIVER_ATWINC15X0_COMMON
    select MODULE_DRIVER_ATWINC15X0_SPI_FLASH
    help
        ATWINC15x0 WiFi vendor driver from the Arduino WiFi101 library.

config MODULE_DRIVER_ATWINC15X0
    bool
    depends on TEST_KCONFIG

config MODULE_DRIVER_ATWINC15X0_COMMON
    bool
    depends on TEST_KCONFIG

config MODULE_DRIVER_ATWINC15X0_SPI_FLASH
    bool
```

## pkg/driver_bme680/Kconfig
```kconfig
# Copyright (c) 2020 HAW Hamburg
#
# This file is subject to the terms and conditions of the GNU Lesser
# General Public License v2.1. See the file LICENSE in the top level
# directory for more details.
#

config PACKAGE_DRIVER_BME680
    bool
    depends on TEST_KCONFIG
    depends on MODULE_BME680
    select MODULE_DRIVER_BME680_CONTRIB
    select MODULE_ZTIMER
    select MODULE_ZTIMER_MSEC
    help
      BME680 sensor library, written and maintained by Bosch Sensortec. This is
      needed by RIOT BME680 driver.

config MODULE_DRIVER_BME680_CONTRIB
    bool
    depends on TEST_KCONFIG
    help
        RIOT integration code for the BME680 package.
```

## pkg/driver_cryptocell/Kconfig
```kconfig
# Copyright (c) 2020 HAW Hamburg
#
# This file is subject to the terms and conditions of the GNU Lesser
# General Public License v2.1. See the file LICENSE in the top level
# directory for more details.
#

config PACKAGE_DRIVER_CRYPTOCELL
    bool "CryptoCell Library Package"
    depends on CPU_MODEL_NRF52840XXAA
    depends on TEST_KCONFIG
    select MODULE_DRIVER_CRYPTOCELL_CONTRIB

config MODULE_DRIVER_CRYPTOCELL_CONTRIB
    bool

rsource "psa_cc/Kconfig"
```
