## pkg/driver_cryptocell/psa_cc/Kconfig
```kconfig
# Copyright (c) 2021 HAW Hamburg
#
# This file is subject to the terms and conditions of the GNU Lesser
# General Public License v2.1. See the file LICENSE in the top level
# directory for more details.
#

# Hashes

config MODULE_PSA_CC_HASHES_SHA1
    bool
    depends on MODULE_PSA_CRYPTO
    select MODULE_PSA_CC
    select MODULE_PSA_CC_HASHES_COMMON

config MODULE_PSA_CC_HASHES_SHA224
    bool
    depends on MODULE_PSA_CRYPTO
    select MODULE_PSA_CC
    select MODULE_PSA_CC_HASHES_COMMON

config MODULE_PSA_CC_HASHES_SHA256
    bool
    depends on MODULE_PSA_CRYPTO
    select MODULE_PSA_CC
    select MODULE_PSA_CC_HASHES_COMMON

config MODULE_PSA_CC_HASHES_SHA512
    bool
    depends on MODULE_PSA_CRYPTO
    select MODULE_PSA_CC
    select MODULE_PSA_CC_HASHES_COMMON

# MAC

config MODULE_PSA_CC_HMAC
    bool
    depends on MODULE_PSA_CRYPTO
    select MODULE_PSA_CC

# AES

config MODULE_PSA_CC_AES_CBC
    bool
    depends on MODULE_PSA_CRYPTO
    select MODULE_PSA_CC
    select MODULE_PSA_CC_AES_COMMON

# ECC

config MODULE_PSA_CC_ECC_P192
    bool
    depends on MODULE_PSA_CRYPTO
    select MODULE_PSA_CC
    select MODULE_PSA_CC_ECC_COMMON

config MODULE_PSA_CC_ECC_P256
    bool
    depends on MODULE_PSA_CRYPTO
    select MODULE_PSA_CC
    select MODULE_PSA_CC_ECC_COMMON

config MODULE_PSA_CC
    bool "PSA CryptoCell Wrapper"
    select MODULE_PSA_CC_ERROR_CONVERSION

config MODULE_PSA_CC_HASHES_COMMON
    bool

config MODULE_PSA_CC_ECC_COMMON
    bool

config MODULE_PSA_CC_AES_COMMON
    bool

config MODULE_PSA_CC_ERROR_CONVERSION
    bool
```

## pkg/driver_cryptocell_310/Kconfig
```kconfig
# Copyright (c) 2020 HAW Hamburg
#
# This file is subject to the terms and conditions of the GNU Lesser
# General Public License v2.1. See the file LICENSE in the top level
# directory for more details.
#

config PACKAGE_DRIVER_CRYPTOCELL_310
    bool
    depends on CPU_MODEL_NRF52840XXAA
    depends on TEST_KCONFIG
    depends on HAS_PERIPH_CRYPTOCELL_310
    depends on MODULE_PERIPH_CRYPTOCELL_310
    select MODULE_DRIVER_CRYPTOCELL_310_CONTRIB

config MODULE_DRIVER_CRYPTOCELL_310_CONTRIB
    bool

rsource "psa_cryptocell_310/Kconfig"
```

## pkg/driver_sen5x/Kconfig
```kconfig
# Copyright (c) 2023 TU Braunschweig
#
# This file is subject to the terms and conditions of the GNU Lesser
# General Public License v2.1. See the file LICENSE in the top level
# directory for more details.
#

config PACKAGE_DRIVER_SEN5X
    bool
    depends on TEST_KCONFIG
    depends on MODULE_SEN5X
    select MODULE_PERIPH_I2C
    select MODULE_ZTIMER
    help
        SEN5X embedded i2c library, written and mantained by Sensirion AG. This add_library
        is needed by the RIOT SEN5X driver.
```

## pkg/driver_sx126x/Kconfig
```kconfig
# Copyright (c) 2021 Inria
#
# This file is subject to the terms and conditions of the GNU Lesser
# General Public License v2.1. See the file LICENSE in the top level
# directory for more details.
#

config PACKAGE_DRIVER_SX126X
    bool "LLCC68 driver package"
    depends on TEST_KCONFIG
    depends on HAS_PERIPH_SPI
    select MODULE_PERIPH_SPI
    select MODULE_ZTIMER
    select ZTIMER_USEC
    select MODULE_DRIVER_SX126X_HAL

config MODULE_DRIVER_SX126X_HAL
    bool
    help
        HAL implementation for the SX126X LoRa radio driver.
```

## pkg/driver_vl53l1x_st_api/Kconfig
```kconfig
# Copyright (c) 2020 HAW Hamburg
#
# This file is subject to the terms and conditions of the GNU Lesser
# General Public License v2.1. See the file LICENSE in the top level
# directory for more details.
#

config PACKAGE_DRIVER_VL53L1X_ST_API
    bool
    select MODULE_DRIVER_VL53L1X_ST_API_PLATFORM
    help
        Driver API package for the ST VL53L1X Time-of-Flight (ToF) ranging
        sensor

config MODULE_DRIVER_VL53L1X_ST_API_PLATFORM
    bool
    select ZTIMER_USEC
    help
        Platform implementation for the ST VL53L1X Driver API package
```

## pkg/elk/Kconfig
```kconfig
# Copyright (c) 2021 Inria
#
# This file is subject to the terms and conditions of the GNU Lesser
# General Public License v2.1. See the file LICENSE in the top level
# directory for more details.

config PACKAGE_ELK
    bool "Elk: a tiny Javascript engine"
    select MODULE_PRINTF_FLOAT
    depends on !HAS_ARCH_AVR8
    depends on TEST_KCONFIG
```

## pkg/emlearn/Kconfig
```kconfig
# Copyright (c) 2021 HAW Hamburg
#
# This file is subject to the terms and conditions of the GNU Lesser
# General Public License v2.1. See the file LICENSE in the top level
# directory for more details.
#

config PACKAGE_EMLEARN
    bool "Machine Learning inference engine package"
    depends on TEST_KCONFIG
    depends on !HAS_ARCH_MSP430
    select MODULE_EMLEARN
    help
        A header only Machine Learning inference engine package.

config MODULE_EMLEARN
    bool
    depends on TEST_KCONFIG
```
