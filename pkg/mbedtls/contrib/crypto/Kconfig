## pkg/mbedtls/contrib/threading/Kconfig
```kconfig
# Copyright (c) 2023 ML!PA Consulting Gmbh
#
# This file is subject to the terms and conditions of the GNU Lesser
# General Public License v2.1. See the file LICENSE in the top level
# directory for more details.

menu "mbed TLS threading"
    depends on USEMODULE_MBEDTLS_THREADING

config MBEDTLS_THREADING_ALT
    bool "Provide your own alternate threading implementation"
    default y if MBEDTLS_THREADING
    help
        This allows your own alternate threading implementation.

endmenu # mbed TLS threading
```

## pkg/mbedtls/contrib/x509/Kconfig
```kconfig
# Copyright (c) 2023 ML!PA Consulting Gmbh
#
# This file is subject to the terms and conditions of the GNU Lesser
# General Public License v2.1. See the file LICENSE in the top level
# directory for more details.

menu "mbed TLS X509"
    depends on USEMODULE_MBEDTLS_X509

config MBEDTLS_ASN1_PARSE
    bool "Enable the generic ASN1 parser"

config MBEDTLS_ASN1_WRITE
    bool "Enable the generic ASN1 writer"

config MBEDTLS_OID
    bool "Enable the OID database"

config MBEDTLS_PEM_PARSE
    bool "Enable PEM decoding / parsing"
    select MBEDTLS_BASE64

config MBEDTLS_PEM_WRITE
    bool "Enable PEM encoding / writing"
    select MBEDTLS_BASE64

config MBEDTLS_PK
    bool "Enable the generic public (asymetric) key layer"

if MBEDTLS_PK

choice
    bool "Enable the generic public (asymetric) key parser"
    default MBEDTLS_PK_ECP

config MBEDTLS_PK_RSA
    bool "RSA"
    select MBEDTLS_RSA

config MBEDTLS_PK_ECP
    bool "ECP"
    select MBEDTLS_ECP

endchoice

endif # MBEDTLS_PK

config MBEDTLS_PK_PARSE
    bool "Enable the generic public (asymetric) key parser"
    select MBEDTLS_PK

config MBEDTLS_PK_WRITE
    bool "Enable the generic public (asymetric) key writer"
    select MBEDTLS_PK

config MBEDTLS_PKCS5
    bool "Enable PKCS#5 functions"
    select MBEDTLS_MD

config MBEDTLS_PKCS11
    bool "Enable wrapper for PKCS#11 smartcard support via the pkcs11-helper library"
    select MBEDTLS_PK
    help
        Adds algorithms for parsing PKCS#8 encrypted private keys

config MBEDTLS_PKCS12
    bool "Enable PKCS#12 PBE functions."
    select MBEDTLS_ASN1_PARSE
    select MBEDTLS_CIPHER
    select MBEDTLC_MD

config MBEDTLS_X509_USE
    bool "Enable X.509 core for using certificates"
    select MBEDTLS_ASN1_PARSE
    select MBEDTLS_BIGNUM
    select MBEDTLS_OID
    select MBEDTLS_PK_PARSE
    help
        This module is required for the X.509 parsing modules.

config MBEDTLS_X509_CRT_PARSE
    bool "Enable X.509 certificate parsing"
    select MBEDTLS_X509_USE
    help
        This module is required for X.509 certificate parsing.

config MBEDTLS_X509_CRL_PARSE
    bool "Enable X.509 CRL parsing"
    select MBEDTLS_X509_USE
    help
        This module is required for X.509 CRL parsing.

config MBEDTLS_X509_CSR_PARSE
    bool "Enable X.509 Certificate Signing Request (CSR) parsing"
    select MBEDTLS_X509_USE
    help
        This module is used for reading X.509 certificate request

config MBEDTLS_X509_CREATE
    bool "Enable X.509 core for creating certificates"
    select MBEDTLS_BIGNUM
    select MBEDTLS_OID
    select MBEDTLS_PK_WRITE
    help
        This module is the basis for creating X.509 certificates and CSRs.

config MBEDTLS_X509_CRT_WRITE
    bool "Enable creating X.509 certificates"
    select MBEDTLS_X509_CREATE
    help
        This module is required for X.509 certificate creation.

config MBEDTLS_X509_CSR_WRITE
    bool "Enable creating X.509 Certificate Signing Requests (CSR)"
    select MBEDTLS_X509_CREATE
    help
        This module is required for X.509 certificate request writing.

endmenu # mbed TLS X509
```

## pkg/mcufont/Kconfig
```kconfig
# Copyright (c) 2023 Koen Zandberg
#
# This file is subject to the terms and conditions of the GNU Lesser
# General Public License v2.1. See the file LICENSE in the top level
# directory for more details.

config PACKAGE_MCUFONT
    bool "MCUFont"
    depends on TEST_KCONFIG
```

## pkg/micro-ecc/Kconfig
```kconfig
# Copyright (c) 2021 HAW Hamburg
#
# This file is subject to the terms and conditions of the GNU Lesser
# General Public License v2.1. See the file LICENSE in the top level
# directory for more details.
#

config PACKAGE_MICRO-ECC
    bool "Micro-ECC package"
    depends on TEST_KCONFIG
    depends on MODULE_RANDOM
    depends on !HAS_ARCH_16BIT
    help
        Micro-ECC is based on the Micro-ECC
        https://github.com/kmackay/micro-ecc and adds `hwrng_read` as
        the default RNG function if it is available on the target
        platform.

rsource "psa_uecc/Kconfig"
```

## pkg/micro-ecc/psa_uecc/Kconfig
```kconfig
# Copyright (c) 2021 HAW Hamburg
#
# This file is subject to the terms and conditions of the GNU Lesser
# General Public License v2.1. See the file LICENSE in the top level
# directory for more details.
#

config MODULE_PSA_UECC_P192
    bool
    depends on MODULE_PSA_CRYPTO
    select MODULE_PSA_UECC

config MODULE_PSA_UECC_P256
    bool
    depends on MODULE_PSA_CRYPTO
    select MODULE_PSA_UECC

config MODULE_PSA_UECC
    bool
```

## pkg/microcoap/Kconfig
```kconfig
# Copyright (c) 2021 HAW Hamburg
#
# This file is subject to the terms and conditions of the GNU Lesser
# General Public License v2.1. See the file LICENSE in the top level
# directory for more details.
#

config PACKAGE_MICRO_COAP
    bool "Micro CoAP package"
    depends on TEST_KCONFIG
    help
        A tiny CoAP server for microcontrollers
```

## pkg/micropython/Kconfig
```kconfig
# Copyright (c) 2023 Inria
#
# This file is subject to the terms and conditions of the GNU Lesser
# General Public License v2.1. See the file LICENSE in the top level
# directory for more details.
#

config PACKAGE_MICROPYTHON
    bool "MicroPython port package"
    depends on TEST_KCONFIG

    select MODULE_XTIMER
    select MODULE_ZTIMER_USEC
    select MODULE_STDIN
```

## pkg/minmea/Kconfig
```kconfig
# Copyright (c) 2021 HAW Hamburg
#
# This file is subject to the terms and conditions of the GNU Lesser
# General Public License v2.1. See the file LICENSE in the top level
# directory for more details.
#

config PACKAGE_MINMEA
    bool "Minmea GPS Parser package"
    depends on TEST_KCONFIG
```

## pkg/monocypher/Kconfig
```kconfig
# Copyright (c) 2021 HAW Hamburg
#
# This file is subject to the terms and conditions of the GNU Lesser
# General Public License v2.1. See the file LICENSE in the top level
# directory for more details.
#

config PACKAGE_MONOCYPHER
    bool "Monocypher high performance cryptographic library package"
    depends on TEST_KCONFIG
    depends on HAS_ARCH_32BIT
    select MODULE_MONOCYPHER_OPTIONAL
    help
        Provides functions for authenticated encryption, hashing,
        password key derivation, key exchange, and public key
        signatures.

config MODULE_MONOCYPHER_OPTIONAL
    bool
    depends on TEST_KCONFIG
    help
        SHA-512 & ED25519
```

## pkg/mynewt-core/Kconfig
```kconfig
# Copyright (c) 2021 INRIA
#
# This file is subject to the terms and conditions of the GNU Lesser
# General Public License v2.1. See the file LICENSE in the top level
# directory for more details.
#

menuconfig PACKAGE_MYNEWT-CORE
    bool "Apache MyNewt mynewt-core Package"
    depends on TEST_KCONFIG
    select MODULE_MYNEWT-CORE
    select MODULE_SEMA
    select MODULE_ZTIMER
    select MODULE_ZTIMER_MSEC
    select MODULE_EVENT
    select MODULE_EVENT_CALLBACK
    depends on HAS_PERIPH_GPIO
    select MODULE_PERIPH_GPIO
    depends on !HAS_ARCH_ESP


if PACKAGE_MYNEWT-CORE

config MODULE_MYNEWT-CORE
    bool

config MODULE_AUTO_INIT_MYNEWT-CORE
    bool "Auto-initialize the mynewt-core package"
    default y
    depends on MODULE_AUTO_INIT

config MODULE_MYNEWT-CORE_OS
    bool "mynewt-core kernel module"

config MODULE_MYNEWT-CORE_UTIL
    bool "mynewt-core utilities modules"

config MODULE_MYNEWT-CORE_NRF5X_HAL
    bool "mynewt-core nrf52 and nrf51 timer hal"

endif # PACKAGE_MYNEWT-CORE
```

## pkg/nanopb/Kconfig
```kconfig
# Copyright (c) 2021 HAW Hamburg
#
# This file is subject to the terms and conditions of the GNU Lesser
# General Public License v2.1. See the file LICENSE in the top level
# directory for more details.
#

config PACKAGE_NANOPB
    bool "NANOPB Protocol Buffer library package"
    depends on TEST_KCONFIG
```

## pkg/nanors/Kconfig
```kconfig
# Copyright (c) 2022
#
# This file is subject to the terms and conditions of the GNU Lesser
# General Public License v2.1. See the file LICENSE in the top level
# directory for more details.
#

config PACKAGE_NANORS
    bool "Reed-Solomon code implementation package"
    depends on TEST_KCONFIG
```

## pkg/nmsis_sdk/Kconfig
```kconfig
# Copyright (c) 2023 Gunar Schorcht
#
# This file is subject to the terms and conditions of the GNU Lesser
# General Public License v2.1. See the file LICENSE in the top level
# directory for more details.

config PACKAGE_NMSIS_SDK
    bool "NMSIS SDK for Nuclei-based MCUs"
    depends on HAS_ARCH_NUCLEI
    help
        Vendor SDK from Nuclei System Technology for Nuclei-based MCUs

config HAS_ARCH_NUCLEI
    bool
    help
        Indicates that the MCU is Nuclei-based
```

## pkg/nrfxlib/Kconfig
```kconfig
# Copyright (c) 2021-2022 Mesotic SAS
#
# This file is subject to the terms and conditions of the GNU Lesser
# General Public License v2.1. See the file LICENSE in the top level
# directory for more details.
#

config PACKAGE_SDK_NRFXLIB
    bool "Nordic sdk_nrfxlib package"
    depends on TEST_KCONFIG && CPU_FAM_NRF9160
    help
        Nordic SDK which includes various features like the
        nRF Modem library, cryptocell and more.
```

## pkg/opendsme/Kconfig
```kconfig
# Copyright (c) 2022 HAW Hamburg
#
# This file is subject to the terms and conditions of the GNU Lesser
# General Public License v2.1. See the file LICENSE in the top level
# directory for more details.
#

menu "openDSME"
    depends on USEPKG_OPENDSME

config OPENDSME_MAX_NEIGHBOURS
    int "Maximum number of DSME neighbours"
    default 20

config OPENDSME_MAX_LOST_BEACONS
    int "Maximum number of lost beacons before assuming the device desynchronized"
    default 8
    help
        Sets the maximum number of lost beacons before the MAC triggers a
        de-association procedure. Higher values are beneficial in noisy
        environments, because the MAC will keep synchronization despite losing some
        beacons. However, lower values are better for mobile nodes, because devices
        may sinchronize faster to a new coordinator.

config OPENDSME_CAP_QUEUE_SIZE
    int "DSME CAP queue size (for CSMA/CA transmissions)"
    default 8
    help
        The CAP queue stores frames to be sent during the Contention Access Period
        using CSMA-CA. Because the transmission delay of CSMA-CA is lower compared to
        GTS transmissions, small values are preferred to reduce memory requirements.

config OPENDSME_CFP_QUEUE_SIZE
    int "DSME CFP queue size (for GTS transmissions)"
    default 22
    help
        The CFP queue stores frames to be sent during the Contention Free Period
        using a dedicated GTS. In contrast to CSMA-CA transmissions, GTS transmission
        take longer as a result of slot schedules. Therefore, the GTS queue should
        have more capacity than the CAP queue (OPENDSME_CAP_QUEUE_SIZE).

endmenu # openDSME
```

## pkg/openthread/Kconfig
```kconfig
# Copyright (c) 2023 Inria
#
# This file is subject to the terms and conditions of the GNU Lesser
# General Public License v2.1. See the file LICENSE in the top level
# directory for more details.
#

menuconfig PACKAGE_OPENTHREAD
    bool "Openthread network stack"
    depends on TEST_KCONFIG

    depends on HAS_CPP
    select MODULE_CPP
    select MODULE_EVENT
    select MODULE_NETDEV
    select MODULE_OPENTHREAD_CONTRIB
    select MODULE_OPENTHREAD_CONTRIB_NETDEV
    select MODULE_L2UTIL
    select MODULE_ZTIMER
    select MODULE_ZTIMER_MSEC

if PACKAGE_OPENTHREAD

config MODULE_OPENTHREAD-FTD
    bool "Openthread Full Thread Device"

config MODULE_OPENTHREAD-MTD
    bool "Openthread Minimal Thread Device"

config MODULE_OPENTHREAD-CLI-FTD
    bool "Openthread Full Thread Device CLI"

config MODULE_OPENTHREAD-CLI-MTD
    bool "Openthread Minimal Thread Device CLI"

config MODULE_OPENTHREAD_CONTRIB
    bool

config MODULE_OPENTHREAD_CONTRIB_NETDEV
    bool

endif  # PACKAGE_OPENTHREAD
```

## pkg/qcbor/Kconfig
```kconfig
# Copyright (c) 2021 HAW Hamburg
#
# This file is subject to the terms and conditions of the GNU Lesser
# General Public License v2.1. See the file LICENSE in the top level
# directory for more details.
#

config PACKAGE_QCBOR
    bool "QCBOR CBOR encoder/decoder"
    depends on TEST_KCONFIG
    depends on HAS_ARCH_32BIT
```

## pkg/qdsa/Kconfig
```kconfig
# Copyright (c) 2021 HAW Hamburg
#
# This file is subject to the terms and conditions of the GNU Lesser
# General Public License v2.1. See the file LICENSE in the top level
# directory for more details.
#

config PACKAGE_QDSA
    bool "qDSA Digital Signatures package"
    depends on TEST_KCONFIG
    depends on !HAS_ARCH_16BIT
    help
        Small and Secure Digital Signatures with Curve-based
        Diffie-Hellman Key Pairs.

if PACKAGE_QDSA

config MODULE_QDSA_ASM
    bool
    default y if HAS_ARCH_AVR8 || CPU_CORE_CORTEX_M23
    default y if CPU_CORE_CORTEX_M0 || CPU_CORE_CORTEX_M0PLUS
    depends on TEST_KCONFIG

config MODULE_QDSA_IMPL_ARM
    bool
    default y if CPU_CORE_CORTEX_M23 || CPU_CORE_CORTEX_M0 || CPU_CORE_CORTEX_M0PLUS

config MODULE_QDSA_IMPL_AVR
    bool
    default y if HAS_ARCH_AVR8

config MODULE_QDSA_IMPL_CREF
    bool
    default y if !MODULE_QDSA_IMPL_ARM && !MODULE_QDSA_IMPL_AVR

endif # PACKAGE_QDSA
```

## pkg/qr-code-generator/Kconfig
```kconfig
# Copyright (c) 2021 Inria
#
# This file is subject to the terms and conditions of the GNU Lesser
# General Public License v2.1. See the file LICENSE in the top level
# directory for more details.

config PACKAGE_QR-CODE-GENERATOR
    bool "QR Code generator"
    depends on TEST_KCONFIG
```

## pkg/ruy/Kconfig
```kconfig
# Copyright (c) 2022 Inria
#
# This file is subject to the terms and conditions of the GNU Lesser
# General Public License v2.1. See the file LICENSE in the top level
# directory for more details.

config PACKAGE_RUY
    bool "The ruy matrix multiplication library"
    depends on TEST_KCONFIG
    depends on HAS_CPP
    depends on HAS_LIBSTDCPP

    select MODULE_CPP11-COMPAT
```

## pkg/tflite-micro/Kconfig
```kconfig
# Copyright (c) 2022 Inria
#
# This file is subject to the terms and conditions of the GNU Lesser
# General Public License v2.1. See the file LICENSE in the top level
# directory for more details.
#

config PACKAGE_TFLITE-MICRO
    bool "TFlite Micro package"
    depends on TEST_KCONFIG
    depends on HAS_CPP
    depends on HAS_LIBSTDCPP
    depends on !HAS_ARCH_MIPS32R2
    depends on !HAS_ARCH_RISCV

    select MODULE_LIBSTDCPP
    select MODULE_CPP11-COMPAT

    select PACKAGE_FLATBUFFERS
    select PACKAGE_GEMMLOWP
    select PACKAGE_RUY

    select MODULE_TFLITE-C
    select MODULE_TFLITE-CORE-API
    select MODULE_TFLITE-KERNELS
    select MODULE_TFLITE-KERNELS-INTERNAL
    select MODULE_TFLITE-KERNELS-INTERNAL-REFERENCE
    select MODULE_TFLITE-MICRO
    select MODULE_TFLITE-MICRO-KERNELS
    select MODULE_TFLITE-MICRO-MEMORY-PLANNER
    select MODULE_TFLITE-SCHEMA


config MODULE_TFLITE-C
    bool

config MODULE_TFLITE-CORE-API
    bool

config MODULE_TFLITE-KERNELS
    bool

config MODULE_TFLITE-KERNELS-INTERNAL
    bool

config MODULE_TFLITE-KERNELS-INTERNAL-REFERENCE
    bool

config MODULE_TFLITE-MICRO
    bool

config MODULE_TFLITE-MICRO-KERNELS
    bool

config MODULE_TFLITE-MICRO-MEMORY-PLANNER
    bool

config MODULE_TFLITE-SCHEMA
    bool
```
