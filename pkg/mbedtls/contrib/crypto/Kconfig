## pkg/mbedtls/contrib/ssl/Kconfig
```kconfig
# Copyright (c) 2023 ML!PA Consulting Gmbh
#
# This file is subject to the terms and conditions of the GNU Lesser
# General Public License v2.1. See the file LICENSE in the top level
# directory for more details.

menu "mbed TLS SSL"
    depends on USEMODULE_MBEDTLS_SSL

config MBEDTLS_KEY_EXCHANGE_PSK_ENABLED
    bool "Enable the PSK based ciphersuite modes in SSL / TLS"
    help
        This enables the following ciphersuites (if other requisites are enabled as well):
        MBEDTLS_TLS_PSK_WITH_AES_256_GCM_SHA384
        MBEDTLS_TLS_PSK_WITH_AES_256_CBC_SHA384
        MBEDTLS_TLS_PSK_WITH_AES_256_CBC_SHA
        MBEDTLS_TLS_PSK_WITH_CAMELLIA_256_GCM_SHA384
        MBEDTLS_TLS_PSK_WITH_CAMELLIA_256_CBC_SHA384
        MBEDTLS_TLS_PSK_WITH_AES_128_GCM_SHA256
        MBEDTLS_TLS_PSK_WITH_AES_128_CBC_SHA256
        MBEDTLS_TLS_PSK_WITH_AES_128_CBC_SHA
        MBEDTLS_TLS_PSK_WITH_CAMELLIA_128_GCM_SHA256
        MBEDTLS_TLS_PSK_WITH_CAMELLIA_128_CBC_SHA256
        MBEDTLS_TLS_PSK_WITH_3DES_EDE_CBC_SHA
        MBEDTLS_TLS_PSK_WITH_RC4_128_SHA

config MBEDTLS_KEY_EXCHANGE_DHE_PSK_ENABLED
    bool "Enable the DHE-PSK based ciphersuite modes in SSL / TLS"
    select MBEDTLS_DHM
    help
        This enables the following ciphersuites (if other requisites are enabled as well):
        MBEDTLS_TLS_DHE_PSK_WITH_AES_256_GCM_SHA384
        MBEDTLS_TLS_DHE_PSK_WITH_AES_256_CBC_SHA384
        MBEDTLS_TLS_DHE_PSK_WITH_AES_256_CBC_SHA
        MBEDTLS_TLS_DHE_PSK_WITH_CAMELLIA_256_GCM_SHA384
        MBEDTLS_TLS_DHE_PSK_WITH_CAMELLIA_256_CBC_SHA384
        MBEDTLS_TLS_DHE_PSK_WITH_AES_128_GCM_SHA256
        MBEDTLS_TLS_DHE_PSK_WITH_AES_128_CBC_SHA256
        MBEDTLS_TLS_DHE_PSK_WITH_AES_128_CBC_SHA
        MBEDTLS_TLS_DHE_PSK_WITH_CAMELLIA_128_GCM_SHA256
        MBEDTLS_TLS_DHE_PSK_WITH_CAMELLIA_128_CBC_SHA256
        MBEDTLS_TLS_DHE_PSK_WITH_3DES_EDE_CBC_SHA
        MBEDTLS_TLS_DHE_PSK_WITH_RC4_128_SHA

config MBEDTLS_KEY_EXCHANGE_ECDHE_PSK_ENABLED
    bool "Enable the ECDHE-PSK based ciphersuite modes in SSL / TLS"
    select MBEDTLS_ECDH
    help
        This enables the following ciphersuites (if other requisites are enabled as well):
        MBEDTLS_TLS_ECDHE_PSK_WITH_AES_256_CBC_SHA384
        MBEDTLS_TLS_ECDHE_PSK_WITH_AES_256_CBC_SHA
        MBEDTLS_TLS_ECDHE_PSK_WITH_CAMELLIA_256_CBC_SHA384
        MBEDTLS_TLS_ECDHE_PSK_WITH_AES_128_CBC_SHA256
        MBEDTLS_TLS_ECDHE_PSK_WITH_AES_128_CBC_SHA
        MBEDTLS_TLS_ECDHE_PSK_WITH_CAMELLIA_128_CBC_SHA256
        MBEDTLS_TLS_ECDHE_PSK_WITH_3DES_EDE_CBC_SHA
        MBEDTLS_TLS_ECDHE_PSK_WITH_RC4_128_SHA

config MBEDTLS_KEY_EXCHANGE_RSA_PSK_ENABLED
    bool "Enable the RSA-PSK based ciphersuite modes in SSL / TLS"
    select MBEDTLS_RSA
    select MBEDTLS_PKCS1_V15
    select MBEDTLS_X509_CRT_PARSE
    help
        This enables the following ciphersuites (if other requisites are enabled as well):
        MBEDTLS_TLS_RSA_PSK_WITH_AES_256_GCM_SHA384
        MBEDTLS_TLS_RSA_PSK_WITH_AES_256_CBC_SHA384
        MBEDTLS_TLS_RSA_PSK_WITH_AES_256_CBC_SHA
        MBEDTLS_TLS_RSA_PSK_WITH_CAMELLIA_256_GCM_SHA384
        MBEDTLS_TLS_RSA_PSK_WITH_CAMELLIA_256_CBC_SHA384
        MBEDTLS_TLS_RSA_PSK_WITH_AES_128_GCM_SHA256
        MBEDTLS_TLS_RSA_PSK_WITH_AES_128_CBC_SHA256
        MBEDTLS_TLS_RSA_PSK_WITH_AES_128_CBC_SHA
        MBEDTLS_TLS_RSA_PSK_WITH_CAMELLIA_128_GCM_SHA256
        MBEDTLS_TLS_RSA_PSK_WITH_CAMELLIA_128_CBC_SHA256
        MBEDTLS_TLS_RSA_PSK_WITH_3DES_EDE_CBC_SHA
        MBEDTLS_TLS_RSA_PSK_WITH_RC4_128_SHA

config MBEDTLS_KEY_EXCHANGE_RSA_ENABLED
    bool "Enable the RSA-only based ciphersuite modes in SSL / TLS"
    select MBEDTLS_RSA
    select MBEDTLS_PKCS1_V15
    select MBEDTLS_X509_CRT_PARSE
    help
        This enables the following ciphersuites (if other requisites are enabled as well):
        MBEDTLS_TLS_RSA_WITH_AES_256_GCM_SHA384
        MBEDTLS_TLS_RSA_WITH_AES_256_CBC_SHA256
        MBEDTLS_TLS_RSA_WITH_AES_256_CBC_SHA
        MBEDTLS_TLS_RSA_WITH_CAMELLIA_256_GCM_SHA384
        MBEDTLS_TLS_RSA_WITH_CAMELLIA_256_CBC_SHA256
        MBEDTLS_TLS_RSA_WITH_CAMELLIA_256_CBC_SHA
        MBEDTLS_TLS_RSA_WITH_AES_128_GCM_SHA256
        MBEDTLS_TLS_RSA_WITH_AES_128_CBC_SHA256
        MBEDTLS_TLS_RSA_WITH_AES_128_CBC_SHA
        MBEDTLS_TLS_RSA_WITH_CAMELLIA_128_GCM_SHA256
        MBEDTLS_TLS_RSA_WITH_CAMELLIA_128_CBC_SHA256
        MBEDTLS_TLS_RSA_WITH_CAMELLIA_128_CBC_SHA
        MBEDTLS_TLS_RSA_WITH_3DES_EDE_CBC_SHA
        MBEDTLS_TLS_RSA_WITH_RC4_128_SHA
        MBEDTLS_TLS_RSA_WITH_RC4_128_MD5

config MBEDTLS_KEY_EXCHANGE_DHE_RSA_ENABLED
    bool "Enable the DHE-RSA based ciphersuite modes in SSL / TLS"
    select MBEDTLS_DHM
    select MBEDTLS_RSA
    select MBEDTLS_PKCS1_V15
    select MBEDTLS_X509_CRT_PARSE
    help
        This enables the following ciphersuites (if other requisites are enabled as well):
        MBEDTLS_TLS_DHE_RSA_WITH_AES_256_GCM_SHA384
        MBEDTLS_TLS_DHE_RSA_WITH_AES_256_CBC_SHA256
        MBEDTLS_TLS_DHE_RSA_WITH_AES_256_CBC_SHA
        MBEDTLS_TLS_DHE_RSA_WITH_CAMELLIA_256_GCM_SHA384
        MBEDTLS_TLS_DHE_RSA_WITH_CAMELLIA_256_CBC_SHA256
        MBEDTLS_TLS_DHE_RSA_WITH_CAMELLIA_256_CBC_SHA
        MBEDTLS_TLS_DHE_RSA_WITH_AES_128_GCM_SHA256
        MBEDTLS_TLS_DHE_RSA_WITH_AES_128_CBC_SHA256
        MBEDTLS_TLS_DHE_RSA_WITH_AES_128_CBC_SHA
        MBEDTLS_TLS_DHE_RSA_WITH_CAMELLIA_128_GCM_SHA256
        MBEDTLS_TLS_DHE_RSA_WITH_CAMELLIA_128_CBC_SHA256
        MBEDTLS_TLS_DHE_RSA_WITH_CAMELLIA_128_CBC_SHA
        MBEDTLS_TLS_DHE_RSA_WITH_3DES_EDE_CBC_SHA

config MBEDTLS_KEY_EXCHANGE_ECDHE_RSA_ENABLED
    bool "Enable the ECDHE-RSA based ciphersuite modes in SSL / TLS"
    select MBEDTLS_ECDH
    select MBEDTLS_RSA
    select MBEDTLS_PKCS1_V15
    select MBEDTLS_X509_CRT_PARSE
    help
        This enables the following ciphersuites (if other requisites are enabled as well):
        MBEDTLS_TLS_ECDHE_RSA_WITH_AES_256_GCM_SHA384
        MBEDTLS_TLS_ECDHE_RSA_WITH_AES_256_CBC_SHA384
        MBEDTLS_TLS_ECDHE_RSA_WITH_AES_256_CBC_SHA
        MBEDTLS_TLS_ECDHE_RSA_WITH_CAMELLIA_256_GCM_SHA384
        MBEDTLS_TLS_ECDHE_RSA_WITH_CAMELLIA_256_CBC_SHA384
        MBEDTLS_TLS_ECDHE_RSA_WITH_AES_128_GCM_SHA256
        MBEDTLS_TLS_ECDHE_RSA_WITH_AES_128_CBC_SHA256
        MBEDTLS_TLS_ECDHE_RSA_WITH_AES_128_CBC_SHA
        MBEDTLS_TLS_ECDHE_RSA_WITH_CAMELLIA_128_GCM_SHA256
        MBEDTLS_TLS_ECDHE_RSA_WITH_CAMELLIA_128_CBC_SHA256
        MBEDTLS_TLS_ECDHE_RSA_WITH_3DES_EDE_CBC_SHA
        MBEDTLS_TLS_ECDHE_RSA_WITH_RC4_128_SHA

config MBEDTLS_KEY_EXCHANGE_ECDHE_ECDSA_ENABLED
    bool "Enable the ECDHE-ECDSA based ciphersuite modes in SSL / TLS"
    select MBEDTLS_ECDH
    select MBEDTLS_ECDSA
    select mbedtls_X509_CRT_PARSE
    help
        This enables the following ciphersuites (if other requisites are enabled as well):
        MBEDTLS_TLS_ECDHE_ECDSA_WITH_AES_256_GCM_SHA384
        MBEDTLS_TLS_ECDHE_ECDSA_WITH_AES_256_CBC_SHA384
        MBEDTLS_TLS_ECDHE_ECDSA_WITH_AES_256_CBC_SHA
        MBEDTLS_TLS_ECDHE_ECDSA_WITH_CAMELLIA_256_GCM_SHA384
        MBEDTLS_TLS_ECDHE_ECDSA_WITH_CAMELLIA_256_CBC_SHA384
        MBEDTLS_TLS_ECDHE_ECDSA_WITH_AES_128_GCM_SHA256
        MBEDTLS_TLS_ECDHE_ECDSA_WITH_AES_128_CBC_SHA256
        MBEDTLS_TLS_ECDHE_ECDSA_WITH_AES_128_CBC_SHA
        MBEDTLS_TLS_ECDHE_ECDSA_WITH_CAMELLIA_128_GCM_SHA256
        MBEDTLS_TLS_ECDHE_ECDSA_WITH_CAMELLIA_128_CBC_SHA256
        MBEDTLS_TLS_ECDHE_ECDSA_WITH_3DES_EDE_CBC_SHA
        MBEDTLS_TLS_ECDHE_ECDSA_WITH_RC4_128_SHA

config MBEDTLS_KEY_EXCHANGE_ECDH_ECDSA_ENABLED
    bool "Enable the ECDH-ECDSA based ciphersuite modes in SSL / TLS"
    select MBEDTLS_ECDH
    select MBEDTLS_ECDSA
    select MBEDTLS_X509_CRT_PARSE
    help
        This enables the following ciphersuites (if other requisites are enabled as well):
        MBEDTLS_TLS_ECDH_ECDSA_WITH_RC4_128_SHA
        MBEDTLS_TLS_ECDH_ECDSA_WITH_3DES_EDE_CBC_SHA
        MBEDTLS_TLS_ECDH_ECDSA_WITH_AES_128_CBC_SHA
        MBEDTLS_TLS_ECDH_ECDSA_WITH_AES_256_CBC_SHA
        MBEDTLS_TLS_ECDH_ECDSA_WITH_AES_128_CBC_SHA256
        MBEDTLS_TLS_ECDH_ECDSA_WITH_AES_256_CBC_SHA384
        MBEDTLS_TLS_ECDH_ECDSA_WITH_AES_128_GCM_SHA256
        MBEDTLS_TLS_ECDH_ECDSA_WITH_AES_256_GCM_SHA384
        MBEDTLS_TLS_ECDH_ECDSA_WITH_CAMELLIA_128_CBC_SHA256
        MBEDTLS_TLS_ECDH_ECDSA_WITH_CAMELLIA_256_CBC_SHA384
        MBEDTLS_TLS_ECDH_ECDSA_WITH_CAMELLIA_128_GCM_SHA256
        MBEDTLS_TLS_ECDH_ECDSA_WITH_CAMELLIA_256_GCM_SHA384

config MBEDTLS_KEY_EXCHANGE_ECDH_RSA_ENABLED
    bool "Enable the ECDH-RSA based ciphersuite modes in SSL / TLS"
    select MBEDTLS_ECDH
    select MBEDTLS_RSA
    select MBEDTLS_X509_CRT_PARSE
    help
        This enables the following ciphersuites (if other requisites are enabled as well):
        MBEDTLS_TLS_ECDH_RSA_WITH_RC4_128_SHA
        MBEDTLS_TLS_ECDH_RSA_WITH_3DES_EDE_CBC_SHA
        MBEDTLS_TLS_ECDH_RSA_WITH_AES_128_CBC_SHA
        MBEDTLS_TLS_ECDH_RSA_WITH_AES_256_CBC_SHA
        MBEDTLS_TLS_ECDH_RSA_WITH_AES_128_CBC_SHA256
        MBEDTLS_TLS_ECDH_RSA_WITH_AES_256_CBC_SHA384
        MBEDTLS_TLS_ECDH_RSA_WITH_AES_128_GCM_SHA256
        MBEDTLS_TLS_ECDH_RSA_WITH_AES_256_GCM_SHA384
        MBEDTLS_TLS_ECDH_RSA_WITH_CAMELLIA_128_CBC_SHA256
        MBEDTLS_TLS_ECDH_RSA_WITH_CAMELLIA_256_CBC_SHA384
        MBEDTLS_TLS_ECDH_RSA_WITH_CAMELLIA_128_GCM_SHA256
        MBEDTLS_TLS_ECDH_RSA_WITH_CAMELLIA_256_GCM_SHA384

config MBEDTLS_KEY_EXCHANGE_ECJPAKE_ENABLED
    bool "Enable the ECJPAKE based ciphersuite modes in SSL / TLS"
    select MBEDTLS_ECJPAKE
    select MBEDTLS_SHA256
    help
        This enables the following ciphersuites (if other requisites are enabled as well):
        MBEDTLS_TLS_ECJPAKE_WITH_AES_128_CCM_8

config MBEDTLS_SSL_DTLS_CONNECTION_ID
    bool "Enable support for the DTLS Connection ID extension RFC 9146"
    select MBEDTLS_SSL_PROTO_DTLS
    help
        Setting this option enables the SSL APIs `mbedtls_ssl_set_cid()`
        `mbedtls_ssl_get_peer_cid()` and `mbedtls_ssl_conf_cid()`.
        See the corresponding documentation for more information.

        Warning: The Connection ID extension is still in draft state.
        We make no stability promises for the availability
        or the shape of the API controlled by this option.

        The maximum lengths of outgoing and incoming CIDs can be configured
        through the options
        - MBEDTLS_SSL_CID_OUT_LEN_MAX
        - MBEDTLS_SSL_CID_IN_LEN_MAX.

config MBEDTLS_SSL_ENCRYPT_THEN_MAC
    bool "Enable support for Encrypt-then-MAC, RFC 7366"
    help
        This allows peers that both support it to use a more robust protection for
        ciphersuites using CBC, providing deep resistance against timing attacks
        on the padding or underlying cipher.

        This only affects CBC ciphersuites, and is useless if none is defined.

if MBEDTLS_SSL_ENCRYPT_THEN_MAC

choice
    bool "MBEDTLS_SSL_ENCRYPT_THEN_MAC requires TLS1 or TLS1_1 or TLS 1_2"
    default MBEDTLS_SSL_ENCRYPT_THEN_MAC_TLS1_2

config MBEDTLS_SSL_ENCRYPT_THEN_MAC_TLS1
    bool "TLS 1.0"
    select MBEDTLS_SSL_PROTO_TLS1

config MBEDTLS_SSL_ENCRYPT_THEN_MAC_TLS1_1
    bool "TLS 1.1"
    select MBEDTLS_SSL_PROTO_TLS1_1

config MBEDTLS_SSL_ENCRYPT_THEN_MAC_TLS1_2
    bool "TLS 1.2"
    select MBEDTLS_SSL_PROTO_TLS1_2

endchoice

endif # MBEDTLS_SSL_ENCRYPT_THEN_MAC

config MBEDTLS_SSL_EXTENDED_MASTER_SECRET
    bool "Enable support for RFC 7627: Session Hash and Extended Master Secret Extension"
    help
        This was introduced as "the proper fix" to the Triple Handshake familiy of
        attacks, but it is recommended to always use it (even if you disable
        renegotiation), since it actually fixes a more fundamental issue in the
        original SSL/TLS design, and has implications beyond Triple Handshake

if MBEDTLS_SSL_EXTENDED_MASTER_SECRET

choice
    bool "MBEDTLS_SSL_EXTENDED_MASTER_SECRET requires TLS1 or TLS1_1 or TLS1_2"
    default MBEDTLS_SSL_EXTENDED_MASTER_SECRET_TLS1_2

config MBEDTLS_SSL_EXTENDED_MASTER_SECRET_TLS1
    bool "TLS 1.0"
    select MBEDTLS_SSL_PROTO_TLS1

config MBEDTLS_SSL_EXTENDED_MASTER_SECRET_TLS1_1
    bool "TLS 1.1"
    select MBEDTLS_SSL_PROTO_TLS1_1

config MBEDTLS_SSL_EXTENDED_MASTER_SECRET_TLS1_2
    bool "TLS 1.2"
    select MBEDTLS_SSL_PROTO_TLS1_2

endchoice

endif # MBEDTLS_SSL_EXTENDED_MASTER_SECRET

config MBEDTLS_SSL_PROTO_TLS1
    bool "Enable support for TLS 1.0"
    select MBEDTLS_MD5

config MBEDTLS_SSL_PROTO_TLS1_1
    bool "Enable support for TLS 1.1 (and DTLS 1.0 if DTLS is enabled)"
    select MBEDTLS_MD5
    select MBEDTLS_SHA1

config MBEDTLS_SSL_PROTO_TLS1_2
    bool "Enable support for TLS 1.2 (and DTLS 1.2 if DTLS is enabled)"

if MBEDTLS_SSL_PROTO_TLS1_2

choice
    bool "MBEDTLS_SSL_PROTO_TLS1_2 requires SHA1 or SHA256 or SHA512"
    default MBEDTLS_SSL_PROTO_TLS1_2_SHA256

config MBEDTLS_SSL_PROTO_TLS1_2_SHA1
    bool "SHA1"
    select MBEDTLS_SHA1

config MBEDTLS_SSL_PROTO_TLS1_2_SHA256
    bool "SHA256"
    select MBEDTLS_SHA256

config MBEDTLS_SSL_PROTO_TLS1_2_SHA512
    bool "SHA512"
    select MBEDTLS_SHA512

endchoice

endif # MBEDTLS_SSL_PROTO_TLS1_2

config MBEDTLS_SSL_PROTO_DTLS
    bool "Enable support for DTLS (all available versions)"
    help
        Enable this and MBEDTLS_SSL_PROTO_TLS1_1 to enable DTLS 1.0,
        and/or this and MBEDTLS_SSL_PROTO_TLS1_2 to enable DTLS 1.2.

if MBEDTLS_SSL_PROTO_DTLS

choice
    bool "MBEDTLS_SSL_PROTO_DTLS requires TLS1_1 (DTLS 1.0) or TLS1_2 (DTLS 1.2)"
    default MBEDTLS_SSL_PROTO_DTLS_TLS1_2

config MBEDTLS_SSL_PROTO_DTLS_TLS1_1
    bool "DTLS 1.0"
    select MBEDTLS_SSL_PROTO_TLS1_1

config MBEDTLS_SSL_PROTO_DTLS_TLS1_2
    bool "DTLS 1.2"
    select MBEDTLS_SSL_PROTO_TLS1_2

endchoice

endif # MBEDTLS_SSL_PROTO_DTLS

config MBEDTLS_SSL_DTLS_ANTI_REPLAY
    bool "Enable support for the anti-replay mechanism in DTLS"
    select MBEDTLS_SSL_TLS
    select MBEDTLS_SSL_PROTO_DTLS
    help
        Warning: Disabling this is often a security risk!
        See mbedtls_ssl_conf_dtls_anti_replay() for details.

config MBEDTLS_SSL_DTLS_HELLO_VERIFY
    bool "Enable support for HelloVerifyRequest on DTLS servers"
    select MBEDTLS_SSL_PROTO_DTLS
    help
        This feature is highly recommended to prevent DTLS servers being used as
        amplifiers in DoS attacks against other hosts. It should always be enabled
        unless you know for sure amplification cannot be a problem in the
        environment in which your server operates.

config MBEDTLS_SSL_DTLS_SRTP
    bool "Enable support for negotiation of DTLS-SRTP (RFC 5764) through the use_srtp extension"
    select MBEDTLS_SSL_PROTO_DTLS
    help
        This feature provides the minimum functionality required
        to negotiate the use of DTLS-SRTP and to allow the derivation of
        the associated SRTP packet protection key material.
        In particular, the SRTP packet protection itself, as well as the
        demultiplexing of RTP and DTLS packets at the datagram layer
        (see Section 5 of RFC 5764), are not handled by this feature.
        Instead, after successful completion of a handshake negotiating
        the use of DTLS-SRTP, the extended key exporter API
        mbedtls_ssl_conf_export_keys_ext_cb() should be used to implement
        the key exporter described in Section 4.2 of RFC 5764 and RFC 5705
        (this is implemented in the SSL example programs).
        The resulting key should then be passed to an SRTP stack.

        Setting this option enables the runtime API
        mbedtls_ssl_conf_dtls_srtp_protection_profiles()
        through which the supported DTLS-SRTP protection
        profiles can be configured. You must call this API at
        runtime if you wish to negotiate the use of DTLS-SRTP.

config MBEDTLS_SSL_DTLS_CLIENT_PORT_REUSE
    bool "Enable server-side support for clients that reconnect from the same port"
    select MBEDTLS_SSL_DTLS_HELLO_VERIFY
    help
        Some clients unexpectedly close the connection and try to reconnect using the
        same source port. This needs special support from the server to handle the
        new connection securely, as described in section 4.2.8 of RFC 6347. This
        flag enables that support.

config MBEDTLS_SSL_DTLS_BADMAC_LIMIT
    bool "Enable support for a limit of records with bad MAC"
    select MBEDTLS_SSL_PROTO_DTLS


config MBEDTLS_SSL_SERVER_NAME_INDICATION
    bool "Enable support for RFC 6066 server name indication (SNI) in SSL"
    select MBEDTLS_X509_CRT_PARSE

config MBEDTLS_SSL_TRUNCATED_HMAC
    bool "Enable support for RFC 6066 truncated HMAC in SSL"

config MBEDTLS_SSL_TICKET
    bool "Enable an implementation of TLS server-side callbacks for session tickets"
    select MBEDTLS_CIPHER

config MBEDTLS_SSL_CLI
    bool "Enable the SSL/TLS client code"
    select MBEDTLS_SSL_TLS
    help
        This module is required for SSL/TLS client support.

config MBEDTLS_SSL_SRV
    bool "Enable the SSL/TLS server code"
    select MBEDTLS_SSL_TLS
    help
        This module is required for SSL/TLS server support.


config MBEDTLS_SSL_TLS
    bool "Enable the generic SSL/TLS code"
    select MBEDTLS_CIPHER
    select MBEDTLS_MD
    help
        This module is required for SSL/TLS.

endmenu # mbed TLS SSL
```
