## Kconfig
```kconfig
# Copyright (c) 2019 HAW Hamburg
#
# This file is subject to the terms and conditions of the GNU Lesser
# General Public License v2.1. See the file LICENSE in the top level
# directory for more details.
#
mainmenu "RIOT Configuration"

# Load macro definitions
rsource "kconfigs/Kconfig.consts"

# For now, get used modules as macros from this file (see kconfig.mk)
osource "$(KCONFIG_GENERATED_DEPENDENCIES)"

# Load first the application configuration, as it may declare symbols in priority
osource "$(APPDIR)/Kconfig"

# Load board configurations, which might override CPU's
orsource "$(BOARDDIR)/Kconfig"
orsource "$(RIOTCPU)/$(CPU)/Kconfig"

rsource "$(RIOTBOARD)/Kconfig"
rsource "$(RIOTCPU)/Kconfig"

rsource "core/Kconfig"
rsource "drivers/Kconfig"
rsource "sys/Kconfig"
rsource "pkg/Kconfig"

menu "External Modules"
osource "$(KCONFIG_EXTERNAL_MODULE_CONFIGS)"
endmenu # External Modules

menu "External Packages"
osource "$(KCONFIG_EXTERNAL_PKG_CONFIGS)"
endmenu # External Packages

comment "Some configuration options may not be here. Use CFLAGS instead."
comment "Ideally, make a PR to add them to the Kconfig."
```

## boards/6lowpan-clicker/Kconfig
```kconfig
# Copyright (c) 2020 HAW Hamburg
#
# This file is subject to the terms and conditions of the GNU Lesser
# General Public License v2.1. See the file LICENSE in the top level
# directory for more details.

config BOARD
    default "6lowpan-clicker" if BOARD_6LOWPAN_CLICKER

config BOARD_6LOWPAN_CLICKER
    bool
    default y
    select CPU_MODEL_P32MX470F512H
    select HAS_PERIPH_TIMER
    select HAS_PERIPH_UART
```

## boards/Kconfig
```kconfig
# SPDX-FileCopyrightText: 2020 HAW Hamburg
# SPDX-License-Identifier: LGPL-2.1-only

config BOARD
    string
    help
        Name of the currently selected board.
```

## boards/acd52832/Kconfig
```kconfig
# SPDX-FileCopyrightText: 2020 HAW Hamburg
# SPDX-License-Identifier: LGPL-2.1-only

config BOARD
    default "acd52832" if BOARD_ACD52832

config BOARD_ACD52832
    bool
    default y
    select BOARD_COMMON_NRF52
    select CPU_MODEL_NRF52832XXAA

source "$(RIOTBOARD)/common/nrf52xxxdk/Kconfig"
```

## boards/adafruit-clue/Kconfig
```kconfig
# SPDX-FileCopyrightText: 2020 HAW Hamburg
# SPDX-License-Identifier: LGPL-2.1-only

config BOARD
    default "adafruit-clue" if BOARD_ADAFRUIT_CLUE

config BOARD_ADAFRUIT_CLUE
    bool
    default y
    select BOARD_COMMON_NRF52
    select CPU_MODEL_NRF52840XXAA

source "$(RIOTBOARD)/common/nrf52/Kconfig"
```

## boards/adafruit-feather-nrf52840-express/Kconfig
```kconfig
# SPDX-FileCopyrightText: 2020 HAW Hamburg
# SPDX-License-Identifier: LGPL-2.1-only

config BOARD
    default "adafruit-feather-nrf52840-express" if BOARD_ADAFRUIT_FEATHER_NRF52840_EXPRESS

config BOARD_ADAFRUIT_FEATHER_NRF52840_EXPRESS
    bool
    default y
    select BOARD_COMMON_NRF52
    select CPU_MODEL_NRF52840XXAA

source "$(RIOTBOARD)/common/nrf52/Kconfig"
```

## boards/adafruit-feather-nrf52840-sense/Kconfig
```kconfig
# SPDX-FileCopyrightText: 2023 HAW Hamburg
# SPDX-License-Identifier: LGPL-2.1-only

config BOARD
    default "adafruit-feather-nrf52840-sense" if BOARD_ADAFRUIT_FEATHER_NRF52840_SENSE

config BOARD_ADAFRUIT_FEATHER_NRF52840_SENSE
    bool
    default y
    select BOARD_COMMON_NRF52
    select CPU_MODEL_NRF52840XXAA

source "$(RIOTBOARD)/common/nrf52/Kconfig"
```

## boards/adafruit-grand-central-m4-express/Kconfig
```kconfig
# SPDX-FileCopyrightText: 2023 Gunar Schorcht
# SPDX-License-Identifier: LGPL-2.1-only

config BOARD
    default "adafruit-grand-central-m4-express" if BOARD_ADAFRUIT_GRAND_CENTRAL_M4_EXPRESS

config BOARD_ADAFRUIT_GRAND_CENTRAL_M4_EXPRESS
    bool
    default y
    select CPU_MODEL_SAMD51P20A
```

## boards/adafruit-itsybitsy-m4/Kconfig
```kconfig
# SPDX-FileCopyrightText: 2021 ML!PA Consulting GmbH
# SPDX-License-Identifier: LGPL-2.1-only

config BOARD
    default "adafruit-itsybitsy-m4" if BOARD_ADAFRUIT_ITSYBITSY_M4

config BOARD_ADAFRUIT_ITSYBITSY_M4
    bool
    default y
    select CPU_MODEL_SAMD51G19A
```

## boards/adafruit-itsybitsy-nrf52/Kconfig
```kconfig
# SPDX-FileCopyrightText: 2020 HAW Hamburg
# SPDX-License-Identifier: LGPL-2.1-only

config BOARD
    default "adafruit-itsybitsy-nrf52" if BOARD_ADAFRUIT_ITSYBITSY_NRF52

config BOARD_ADAFRUIT_ITSYBITSY_NRF52
    bool
    default y
    select BOARD_COMMON_NRF52
    select CPU_MODEL_NRF52840XXAA

source "$(RIOTBOARD)/common/nrf52/Kconfig"
```

## boards/adafruit-metro-m4-express/Kconfig
```kconfig
# SPDX-FileCopyrightText: 2024 ML!PA Consulting GmbH
# SPDX-License-Identifier: LGPL-2.1-only

config BOARD
    default "adafruit-metro-m4-express" if BOARD_ADAFRUIT_METRO_M4_EXPRESS

config BOARD_ADAFRUIT_METRO_M4_EXPRESS
    bool
    default y
    select CPU_MODEL_SAMD51J19
```

## boards/adafruit-pybadge/Kconfig
```kconfig
# SPDX-FileCopyrightText: 2020 Inria
# SPDX-License-Identifier: LGPL-2.1-only

config BOARD
    default "adafruit-pybadge" if BOARD_ADAFRUIT_PYBADGE

config BOARD_ADAFRUIT_PYBADGE
    bool
    default y
    select CPU_MODEL_SAMD51J19A
```

## boards/airfy-beacon/Kconfig
```kconfig
# SPDX-FileCopyrightText: 2020 HAW Hamburg
# SPDX-License-Identifier: LGPL-2.1-only

config BOARD
    default "airfy-beacon" if BOARD_AIRFY_BEACON

config BOARD_AIRFY_BEACON
    bool
    default y
    select BOARD_COMMON_NRF51
    select CPU_MODEL_NRF51X22XXAA

source "$(RIOTBOARD)/common/nrf51/Kconfig"
```

## boards/alientek-pandora/Kconfig
```kconfig
# Copyright (C) 2021 Luo Jia (HUST IoT Security Lab)
#
# This file is subject to the terms and conditions of the GNU Lesser
# General Public License v2.1. See the file LICENSE in the top level
# directory for more details.
#

config BOARD
    default "alientek-pandora" if BOARD_ALIENTEK_PANDORA

config BOARD_ALIENTEK_PANDORA
    bool
    default y
    select CPU_MODEL_STM32L475VE

    # Clock configuration
    select BOARD_HAS_LSE

source "$(RIOTBOARD)/common/stm32/Kconfig"
```

## boards/arduino-due/Kconfig
```kconfig
# SPDX-FileCopyrightText: 2020 HAW Hamburg
# SPDX-License-Identifier: LGPL-2.1-only

config BOARD
    default "arduino-due" if BOARD_ARDUINO_DUE

config BOARD_ARDUINO_DUE
    bool
    default y
    select BOARD_COMMON_ARDUINO_DUE

source "$(RIOTBOARD)/common/arduino-due/Kconfig"
```

## boards/arduino-leonardo/Kconfig
```kconfig
# SPDX-FileCopyrightText: 2020 HAW Hamburg
# SPDX-License-Identifier: LGPL-2.1-only

config BOARD
    default "arduino-leonardo" if BOARD_ARDUINO_LEONARDO

config BOARD_ARDUINO_LEONARDO
    bool
    default y
    select BOARD_COMMON_ARDUINO_ATMEGA
    select CPU_MODEL_ATMEGA32U4

source "$(RIOTBOARD)/common/arduino-atmega/Kconfig"
```

## boards/arduino-mega2560/Kconfig
```kconfig
# SPDX-FileCopyrightText: 2020 HAW Hamburg
# SPDX-License-Identifier: LGPL-2.1-only

config BOARD
    default "arduino-mega2560" if BOARD_ARDUINO_MEGA2560

config BOARD_ARDUINO_MEGA2560
    bool
    default y
    select CPU_MODEL_ATMEGA2560
    select BOARD_COMMON_ARDUINO_ATMEGA

source "$(RIOTBOARD)/common/arduino-atmega/Kconfig"
```

## boards/arduino-mkr1000/Kconfig
```kconfig
# SPDX-FileCopyrightText: 2020 HAW Hamburg
# SPDX-License-Identifier: LGPL-2.1-only

config BOARD
    default "arduino-mkr1000" if BOARD_ARDUINO_MKR1000

config BOARD_ARDUINO_MKR1000
    bool
    default y
    select BOARD_COMMON_ARDUINO_MKR

source "$(RIOTBOARD)/common/arduino-mkr/Kconfig"
```

## boards/arduino-mkrfox1200/Kconfig
```kconfig
# SPDX-FileCopyrightText: 2020 HAW Hamburg
# SPDX-License-Identifier: LGPL-2.1-only

config BOARD
    default "arduino-mkrfox1200" if BOARD_ARDUINO_MKRFOX1200

config BOARD_ARDUINO_MKRFOX1200
    bool
    default y
    select BOARD_COMMON_ARDUINO_MKR

source "$(RIOTBOARD)/common/arduino-mkr/Kconfig"
```

## boards/arduino-mkrwan1300/Kconfig
```kconfig
# SPDX-FileCopyrightText: 2020 HAW Hamburg
# SPDX-License-Identifier: LGPL-2.1-only

config BOARD
    default "arduino-mkrwan1300" if BOARD_ARDUINO_MKRWAN1300

config BOARD_ARDUINO_MKRWAN1300
    bool
    default y
    select BOARD_COMMON_ARDUINO_MKR

source "$(RIOTBOARD)/common/arduino-mkr/Kconfig"
```

## boards/arduino-mkrzero/Kconfig
```kconfig
# SPDX-FileCopyrightText: 2020 HAW Hamburg
# SPDX-License-Identifier: LGPL-2.1-only

config BOARD
    default "arduino-mkrzero" if BOARD_ARDUINO_MKRZERO

config BOARD_ARDUINO_MKRZERO
    bool
    default y
    select BOARD_COMMON_ARDUINO_MKR

source "$(RIOTBOARD)/common/arduino-mkr/Kconfig"
```

## boards/arduino-nano-33-ble-sense/Kconfig
```kconfig
# SPDX-FileCopyrightText: 2024 Méwen Berthelot
# SPDX-License-Identifier: LGPL-2.1-only

config BOARD
    default "arduino-nano-33-ble-sense" if BOARD_ARDUINO_NANO_33_BLE_SENSE

config BOARD_ARDUINO_NANO_33_BLE_SENSE
    bool
    default y
    select BOARD_COMMON_NRF52
    select CPU_MODEL_NRF52840XXAA

source "$(RIOTBOARD)/common/nrf52/Kconfig"
```

## boards/arduino-nano-33-ble/Kconfig
```kconfig
# SPDX-FileCopyrightText: 2020 HAW Hamburg
# SPDX-License-Identifier: LGPL-2.1-only

config BOARD
    default "arduino-nano-33-ble" if BOARD_ARDUINO_NANO_33_BLE

config BOARD_ARDUINO_NANO_33_BLE
    bool
    default y
    select BOARD_COMMON_NRF52
    select CPU_MODEL_NRF52840XXAA

source "$(RIOTBOARD)/common/nrf52/Kconfig"
```

## boards/arduino-nano-33-iot/Kconfig
```kconfig
# SPDX-FileCopyrightText: 2020 Inria
# SPDX-License-Identifier: LGPL-2.1-only

config BOARD
    default "arduino-nano-33-iot" if BOARD_ARDUINO_NANO_33_IOT

config BOARD_ARDUINO_NANO_33_IOT
    bool
    default y
    select CPU_MODEL_SAMD21G18A
```

## boards/arduino-nano-esp32/Kconfig
```kconfig
# SPDX-FileCopyrightText: 2025 Gunar Schorcht
# SPDX-License-Identifier: LGPL-2.1-only

config BOARD
    default "arduino-nano-esp32" if BOARD_ARDUINO_NANO_ESP32

config BOARD_ARDUINO_NANO_ESP32
    bool
    default y
    select BOARD_COMMON_ESP32S3
    select CPU_MODEL_ESP32S3_R8

source "$(RIOTBOARD)/common/esp32s3/Kconfig"
```
