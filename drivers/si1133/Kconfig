## drivers/st77xx/Kconfig.st7796
```kconfig
# Copyright (c) 2020 HAW Hamburg
#
# This file is subject to the terms and conditions of the GNU Lesser
# General Public License v2.1. See the file LICENSE in the top level
# directory for more details.
#

if USEMODULE_ST77XX

if USEMODULE_ST7796

menuconfig ST7796_CUSTOM_CONFIG
    bool "ST7796 Custom Configuration"
    help
        Enable if customized configuration of voltages are needed. Otherwise
        reset default values are used.

if ST7796_CUSTOM_CONFIG

config ST7796_AVDD
    int "AVDD voltage (in millivolts)"
    default 6600
    range 6200 6800
    help
        Configure the AVDD voltage for analog circuits in millivolts.
        Valid values must be in the range of 6200 (6.2V) to 6800 (6.8V)
        in steps of 200.

config ST7796_AVCL
    int "AVDD voltage (in millivolts)"
    default -4400
    range -5000 -4400
    help
        Configure the AVCL voltage in millivolts.
        Valid values must be in the range of -5000 (-5V) to -4400 (-4.4V)
        in steps of 200.

config ST7796_VCOM
    int "VCOM voltage (in millivolts)"
    default 1000
    range 300 1875
    help
        Configure the VCOM voltage level. VCOM needs to be adjusted to match
        the capacitance and performance specifications of the TFT panel to
        maximize contrast and minimize flickering. VCOM is used to derive the
        GVDD (gamma reference positive voltage) and the GVCL (gamma reference
        negative voltage) as follows:

            GDDV = +VRH + VCOM + VCOM_OFFSET
            GVCL = -VRH + VCOM + VCOM_OFFSET

        Valid values must be in the range of 300 (0.3V) to 1875 (1.875V)
        in steps of 25.

config ST7796_VCOM_OFFSET
    int "VCOM voltage offset (in millivolts)"
    default 0
    range -800 775
    help
        Configure the VCOM voltage offset (VCOM_OFFSET). VCOM_OFFSET is used to
        derive the GVDD (gamma reference positive voltage) and the GVCL (gamma
        reference negative voltage) as follows:

            GDDV = +VRH + VCOM + VCOM_OFFSET
            GVCL = -VRH + VCOM + VCOM_OFFSET

        Valid values must be in the range of -800 (-0.8V) to 775 (0.775V)
        in steps of 25.

config ST7796_VRH
    int "VRH voltage range (in millivolts)"
    default 4500
    range 3550 5500
    help
        Configure the VRH voltage range. VRH is used to derive the GVDD (gamma
        reference positive voltage) and the GVCL (gamma reference negative
        voltage) as follows:

            GDDV = +VRH + VCOM + VCOM_OFFSET + (0.5 * VDV)
            GVCL = -VRH + VCOM + VCOM_OFFSET - (0.5 * VDV)

        Valid values must be in the range of 3350 (3.35V) to 5500 (5.5V)
        in steps of 50.

# TODO  ST7796_VGH and ST7796_VGL (non linear values)

endif # ST7796_CUSTOM_CONFIG
endif # USEMODULE_ST7796
endif # USEMODULE_ST77XX
```

## drivers/stmpe811/Kconfig
```kconfig
# Copyright (c) 2021 HAW Hamburg
#
# This file is subject to the terms and conditions of the GNU Lesser
# General Public License v2.1. See the file LICENSE in the top level
# directory for more details.
#

menuconfig MODULE_STMPE811
    bool
    prompt "STMPE811 Touchscreen Controller" if !(MODULE_TOUCH_DEV && HAVE_STMPE811)
    default (MODULE_TOUCH_DEV && HAVE_STMPE811)
    depends on HAS_PERIPH_GPIO
    depends on HAS_PERIPH_GPIO_IRQ
    depends on TEST_KCONFIG
    select MODULE_PERIPH_GPIO
    select MODULE_PERIPH_GPIO_IRQ
    select MODULE_ZTIMER
    select MODULE_ZTIMER_MSEC

if MODULE_STMPE811

choice STMPE811_VARIANT
    bool "Model"
    default MODULE_STMPE811_I2C if HAVE_STMPE811_I2C
    default MODULE_STMPE811_SPI if HAVE_STMPE811_SPI
    help
        The driver supports both stmpe811 connected either via SPI or
        I2C bus. Select one combination.

config MODULE_STMPE811_I2C
    bool "STMPE811 on I2C"
    depends on HAS_PERIPH_I2C
    select MODULE_PERIPH_I2C

config MODULE_STMPE811_SPI
    bool "STMPE811 on SPI"
    depends on HAS_PERIPH_SPI
    depends on HAS_PERIPH_GPIO
    select MODULE_PERIPH_SPI
    select MODULE_PERIPH_GPIO
endchoice

endif # MODULE_STMPE811

config HAVE_STMPE811
    bool
    help
      Indicates that an STMPE811 is present.

config HAVE_STMPE811_I2C
    bool
    select HAVE_STMPE811
    help
      Indicates that an STMPE811 over I2C touch panel is present.

config HAVE_STMPE811_SPI
    bool
    select HAVE_STMPE811
    help
      Indicates that an STMPE811 over SPI touch panel is present.
```

## drivers/sx126x/Kconfig
```kconfig
# Copyright (c) 2021 Inria
# Copyright (c) 2021 HAW Hamburg
#
# This file is subject to the terms and conditions of the GNU Lesser
# General Public License v2.1. See the file LICENSE in the top level
# directory for more details.

menuconfig MODULE_SX126X
    bool
    prompt "SX1261/2/8 and LLCC68 LoRa radio driver" if !(HAVE_SX126X && MODULE_NETDEV_DEFAULT)
    default y if (HAVE_SX126X && MODULE_NETDEV_DEFAULT)
    depends on TEST_KCONFIG
    depends on HAS_PERIPH_SPI
    depends on HAS_PERIPH_GPIO
    depends on HAS_PERIPH_GPIO_IRQ
    select MODULE_PERIPH_GPIO
    select MODULE_PERIPH_SPI
    select PACKAGE_DRIVER_SX126X
    select MODULE_IOLIST

choice
    bool "Radio variant"
    depends on MODULE_SX126X
    default MODULE_SX1261 if HAVE_SX1261
    default MODULE_SX1262 if HAVE_SX1262
    default MODULE_SX1268 if HAVE_SX1268
    default MODULE_LLCC68 if HAVE_LLCC68
    default MODULE_SX126X_STM32WL if HAVE_SX126X_STM32WL

config MODULE_SX1261
    bool "SX1261"
    select MODULE_PERIPH_GPIO_IRQ

config MODULE_SX1262
    bool "SX1262"
    select MODULE_PERIPH_GPIO_IRQ

config MODULE_SX1268
    bool "SX1268"
    select MODULE_PERIPH_GPIO_IRQ

config MODULE_LLCC68
    bool "LLCC68"
    select MODULE_PERIPH_GPIO_IRQ

config MODULE_SX126X_STM32WL
    bool "SX126X-STM32WL"

endchoice

config HAVE_SX1261
    bool
    select HAVE_SX126X
    help
      Indicates that an sx1261 transceiver is present.

config HAVE_SX1262
    bool
    select HAVE_SX126X
    help
      Indicates that an sx1262 transceiver is present.

config HAVE_SX1268
    bool
    select HAVE_SX126X
    help
      Indicates that an sx1268 transceiver is present.

config HAVE_LLCC68
    bool
    select HAVE_SX126X
    help
      Indicates that an llcc68 transceiver is present.

config HAVE_SX126X_STM32WL
    bool
    select HAVE_SX126X
    help
      Indicates that an sx126x_stm32wl transceiver is present.

config HAVE_SX126X
    bool
    help
      Indicates that an sx126x transceiver is present.
```

## drivers/sx127x/Kconfig
```kconfig
# Copyright (c) 2021 HAW Hamburg
#
# This file is subject to the terms and conditions of the GNU Lesser
# General Public License v2.1. See the file LICENSE in the top level
# directory for more details.
#

menuconfig MODULE_SX127X
    bool "Semtech SX1272 and SX1276 radios driver" if !(HAVE_SX127X && MODULE_NETDEV_DEFAULT)
    default y if (HAVE_SX127X && MODULE_NETDEV_DEFAULT)
    depends on TEST_KCONFIG
    depends on HAS_PERIPH_GPIO
    depends on HAS_PERIPH_GPIO_IRQ
    depends on HAS_PERIPH_SPI
    depends on HAS_PERIPH_TIMER
    select MODULE_PERIPH_GPIO
    select MODULE_PERIPH_GPIO_IRQ
    select MODULE_PERIPH_SPI_GPIO_MODE if HAS_PERIPH_SPI_GPIO_MODE
    select MODULE_PERIPH_SPI
    select MODULE_ZTIMER
    select MODULE_ZTIMER_MSEC
    select MODULE_IOLIST
    select MODULE_LORA
    help
        Only LoRa long range modem is supported at the moment.

choice
    bool "Radio variant"
    depends on MODULE_SX127X
    default MODULE_SX1272 if HAVE_SX1272
    default MODULE_SX1276 if HAVE_SX1276

config MODULE_SX1272
    bool "SX1272"

config MODULE_SX1276
    bool "SX1276"

endchoice

config HAVE_SX1272
    bool
    select HAVE_SX127X
    help
        Indicates that an sx1272 radio is present.

config HAVE_SX1276
    bool
    select HAVE_SX127X
    help
        Indicates that an sx1276 radio is present.

config HAVE_SX127X
    bool
    help
      Indicates that an sx127x radio is present.
```

## drivers/sx1280/Kconfig
```kconfig
# Copyright (c) 2022 Inria
#
# This file is subject to the terms and conditions of the GNU Lesser
# General Public License v2.1. See the file LICENSE in the top level
# directory for more details.

config MODULE_SX1280
    bool "LoRa 2.4Ghz SX1280 Driver" if !(HAVE_SX1280 && MODULE_NETDEV_DEFAULT)
    default y if (HAVE_SX1280 && MODULE_NETDEV_DEFAULT)
    depends on TEST_KCONFIG
    select PACKAGE_LORABASICS
    select MODULE_LORABASICS_SX1280_DRIVER

config HAVE_SX1280
    bool
    help
        Indicates that an sx1280 2.4Ghz transceiver is present.
```

## drivers/tcs37727/Kconfig
```kconfig
# SPDX-FileCopyrightText: 2020 Freie Universitaet Berlin
# SPDX-FileCopyrightText: 2021 HAW Hamburg
# SPDX-License-Identifier: LGPL-2.1-only

menu "TCS37727 driver"
    depends on USEMODULE_TCS37727

config TCS37727_ATIME_DEFAULT
    int "RGBC integration time in microseconds"
    range 2400 614000
    default 200000
    help
        RGBC integration time impacts both the resolution and the sensitivity
        of the RGBC reading. Refer to the section "RGBC Time Register" in the
        datasheet for more information.

endmenu # TCS37727 driver
```

## drivers/tmp00x/Kconfig
```kconfig
# Copyright (c) 2020 Freie Universitaet Berlin
#               2021 HAW Hamburg
#
# This file is subject to the terms and conditions of the GNU Lesser
# General Public License v2.1. See the file LICENSE in the top level
# directory for more details.
#

menu "TMP00X driver"
    depends on USEMODULE_TMP00X

config TMP00X_I2C_ADDRESS
    hex "Default I2C Address"
    range 0x40 0x47
    default 0x40
    help
        TMP006/TMP007 allows for up to 8 devices on a single bus. The address
        value depends on the state of ADR0 and ADR1 pins. Default value (0x40)
        corresponds to ADR0 and ADR1 pins tied to GND. For more information
        refer to the 'Serial Bus Address' section in the datasheet.

choice
    bool "Conversion time"
    default TMP00X_CONVERSION_TIME_1S
    help
        The duration of the analog-to-digital(A/D) conversion is determined by
        the conversion rate bits CR0, CR1 and CR2. For more information refer
        datasheet.

config TMP00X_CONVERSION_TIME_0_25S
    bool "0.25 s"

config TMP00X_CONVERSION_TIME_0_5S
    bool "0.5 s"

config TMP00X_CONVERSION_TIME_1S
    bool "1 s"

config TMP00X_CONVERSION_TIME_2S
    bool "2 s"

config TMP00X_CONVERSION_TIME_4S
    bool "4 s"

endchoice

config TMP00X_USE_LOW_POWER
    bool "Enable low power mode"
    help
        Enable this to put the device in low power mode between measurements.
        By default the device will always be on. Enabling this also adds a delay
        based on "Conversion time" to each measurement call for bringing the
        device out of standby.

config TMP00X_USE_RAW_VALUES
    bool "Enable raw ADC readings"
    help
        Enable this to return raw ADC readings. By default measurements are
        converted to Celsius.

endmenu # TMP00X driver
```

## drivers/touch_dev/Kconfig
```kconfig
# Copyright (c) 2021 HAW Hamburg
#
# This file is subject to the terms and conditions of the GNU Lesser
# General Public License v2.1. See the file LICENSE in the top level
# directory for more details.
#

config MODULE_TOUCH_DEV
    bool "Touch device generic API"
    depends on TEST_KCONFIG
    imply MODULE_AUTO_INIT_SCREEN
    help
        This API is experimental and in an early state - expect changes!
```

## drivers/touch_dev_gestures/Kconfig
```kconfig
# SPDX-FileCopyrightText: 2023 Gunar Schorcht
# SPDX-License-Identifier: LGPL-2.1-only

if USEMODULE_TOUCH_DEV_GESTURES

config TOUCH_DEV_SWIPE_TRESH
    int "Swipe threshold"
    range 0 50
    default 5
    help
        Minimum distance in one direction to recognize a swipe gesture.

config TOUCH_DEV_PRESS_TIME_MS
    int "Press time in milliseconds"
    range 0 2000
    default 600
    help
        Minimum touch time in milliseconds to detect a long press gesture.

config TOUCH_DEV_DOUBLE_TIME_MS
    int "Double tap maximum delay in milliseconds"
    range 0 1000
    default 400
    help
        Maximum time in milliseconds between two taps to detect a double tap.

endif
```

## drivers/tps6274x/Kconfig
```kconfig
# Copyright (c) 2021 HAW Hamburg
#
# This file is subject to the terms and conditions of the GNU Lesser
# General Public License v2.1. See the file LICENSE in the top level
# directory for more details.
#

config MODULE_TPS6274X
    bool "TPS6274x DC-DC converter"
    depends on HAS_PERIPH_GPIO
    depends on TEST_KCONFIG
    select MODULE_PERIPH_GPIO
```
