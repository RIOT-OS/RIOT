## drivers/si1133/Kconfig
```kconfig
# Copyright (c) 2021 HAW Hamburg
#
# This file is subject to the terms and conditions of the GNU Lesser
# General Public License v2.1. See the file LICENSE in the top level
# directory for more details.
#

config MODULE_SI1133
    bool "Si1133 UV Index/Ambient Light Sensor with I2C"
    depends on HAS_PERIPH_I2C
    depends on TEST_KCONFIG
    select MODULE_PERIPH_I2C
    select MODULE_ZTIMER
    select ZTIMER_USEC

config HAVE_SI1133
    bool
    select MODULE_SI1133 if MODULE_SAUL_DEFAULT
    help
      Indicates that a Si1133 UV Index/Ambient Light Sensor is present.
```

## drivers/si114x/Kconfig
```kconfig
# Copyright (c) 2021 HAW Hamburg
#
# This file is subject to the terms and conditions of the GNU Lesser
# General Public License v2.1. See the file LICENSE in the top level
# directory for more details.
#

menuconfig MODULE_SI114X
    bool
    prompt "Si1145/6/7 UV/Ambient light/Proximity sensors" if !(MODULE_SAUL_DEFAULT && HAVE_SI114X)
    default (MODULE_SAUL_DEFAULT && HAVE_SI114X)
    depends on TEST_KCONFIG
    depends on HAS_PERIPH_I2C
    select MODULE_PERIPH_I2C
    select MODULE_ZTIMER
    select MODULE_ZTIMER_MSEC

choice SI114X_VARIANT
    bool "variant"
    depends on MODULE_SI114X
    default MODULE_SI1145 if HAVE_SI1145
    default MODULE_SI1146 if HAVE_SI1146
    default MODULE_SI1147 if HAVE_SI1147

config MODULE_SI1145
    bool "SI1145"

config MODULE_SI1146
    bool "SI1146"

config MODULE_SI1147
    bool "SI1147"

endchoice

config HAVE_SI114X
    bool
    help
        Indicates that a Si114X UV/Ambient light/Proximity sensor is present.

config HAVE_SI1145
    bool
    select HAVE_SI114X
    help
        Indicates that a Si1145 UV/Ambient light/Proximity sensor is present.

config HAVE_SI1146
    bool
    select HAVE_SI114X
    help
        Indicates that a Si1146 UV/Ambient light/Proximity sensor is present.

config HAVE_SI1147
    bool
    select HAVE_SI114X
    help
        Indicates that a Si1147 UV/Ambient light/Proximity sensor is present.
```

## drivers/si70xx/Kconfig
```kconfig
# Copyright (c) 2021 HAW Hamburg
#
# This file is subject to the terms and conditions of the GNU Lesser
# General Public License v2.1. See the file LICENSE in the top level
# directory for more details.
#

menuconfig MODULE_SI70XX
    bool
    prompt "Si7006/13/20/21 temperature and humidity sensors" if !(MODULE_SAUL_DEFAULT && HAVE_SI70XX)
    default (MODULE_SAUL_DEFAULT && HAVE_SI70XX)
    depends on TEST_KCONFIG
    depends on HAS_PERIPH_I2C
    select MODULE_PERIPH_I2C
    select MODULE_ZTIMER
    select MODULE_ZTIMER_MSEC

choice SI70XX_VARIANT
    bool "Sensor variant"
    depends on MODULE_SI70XX
    default MODULE_SI7006 if HAVE_SI7006
    default MODULE_SI7013 if HAVE_SI7013
    default MODULE_SI7020 if HAVE_SI7020
    default MODULE_SI7021 if HAVE_SI7021

config MODULE_SI7006
    bool "SI7006"

config MODULE_SI7013
    bool "SI7013"

config MODULE_SI7020
    bool "SI7020"

config MODULE_SI7021
    bool "SI7021"

endchoice

config HAVE_SI70XX
    bool
    help
        Indicates that a si70XX sensor is present.

config HAVE_SI7006
    bool
    select HAVE_SI70XX
    help
        Indicates that a si7006 sensor is present.

config HAVE_SI7013
    bool
    select HAVE_SI70XX
    help
        Indicates that a si7013 sensor is present.

config HAVE_SI7020
    bool
    select HAVE_SI70XX
    help
        Indicates that a si7020 sensor is present.

config HAVE_SI7021
    bool
    select HAVE_SI70XX
    help
        Indicates that a si7021 sensor is present.
```

## drivers/slipdev/Kconfig
```kconfig
# SPDX-FileCopyrightText: 2020 Freie Universitaet Berlin
# SPDX-FileCopyrightText: 2021 HAW Hamburg
# SPDX-License-Identifier: LGPL-2.1-only

menu "SLIPDEV driver"
    depends on USEMODULE_SLIPDEV

config SLIPDEV_BUFSIZE_EXP
    int "Buffer size (as exponent of 2^n)"
    default 11
    range 0 31
    help
        UART buffer size used for TX and RX buffers.
        Reduce this value if your expected traffic does
        not include full IPv6 MTU.
        Value represents the exponent n of 2^n.

endmenu # SLIPDEV driver
```

## drivers/slipmux/Kconfig
```kconfig
# Copyright (c) 2020 Freie Universitaet Berlin
#               2021 HAW Hamburg
#
# This file is subject to the terms and conditions of the GNU Lesser
# General Public License v2.1. See the file LICENSE in the top level
# directory for more details.
#

menu "SLIPDEV driver"
    depends on USEMODULE_SLIPDEV

config SLIPDEV_BUFSIZE_EXP
    int "Buffer size (as exponent of 2^n)"
    default 11
    range 0 31
    help
        UART buffer size used for TX and RX buffers.
        Reduce this value if your expected traffic does
        not include full IPv6 MTU.
        Value represents the exponent n of 2^n.

endmenu # SLIPDEV driver
```

## drivers/slipmux_dev/Kconfig
```kconfig
#               2025 HAW Hamburg
#
# This file is subject to the terms and conditions of the GNU Lesser
# General Public License v2.1. See the file LICENSE in the top level
# directory for more details.
#

menu "SLIPMUX driver"
    depends on USEMODULE_SLIPMUX_DEV

    config SLIPMUX_COAP_BUFSIZE
        depends on USEMODULE_SLIPMUX_COAP
        int "CoAP TX/RX buffer size, in bytes"
        range 0 9999999
        default 512
        help
            Size of the CoAP request / response buffer

    config SLIPMUX_NET_BUFSIZE
        depends on USEMODULE_SLIPMUX_NET
        int "IP packet TX/RX buffer size, in bytes"
        range 0 9999999
        default 2048
        help
            Size of the IP network interface TX/RX buffer. Reduce this value if your expected traffic does not include full IPv6 MTU sized packets.

endmenu # SLIPMUX driver
```

## drivers/sm_pwm_01c/Kconfig
```kconfig
menu "SM_PWM_01C driver"
    depends on USEMODULE_SM_PWM_01C

config SM_PWM_01C_WINDOW_TIME
    int "Measuring Window length"
    default 10000000
    help
        Length in time of the measuring window in microseconds,
        recommended 5-30s.

config SM_PWM_01C_SAMPLE_TIME
    int "PWM occupancy sampling period"
    default 100000
    help
        Time, expressed in microseconds, at witch LPO is occupancy is
        sampled and converted into particle matter concentration

if !USEMODULE_SM_PWM_01C_MA

config SM_PWM_01C_EXP_WEIGHT
    int "Weight of the exponential"
    default 100000
    help
        Weight of the exponential average filter where:
        SM_PWM_01C_EXP_WEIGHT = 1 / (1 - alpha).

        Should be chosen wisely, it can be done my minimizing MSE
        or other algorithms as Marquardt procedure.

endif # USEMODULE_SM_PWM_01C_MA

endmenu # SM_PWM_01C driver
```

## drivers/soft_spi/Kconfig
```kconfig
# Copyright (c) 2021 HAW Hamburg
#
# This file is subject to the terms and conditions of the GNU Lesser
# General Public License v2.1. See the file LICENSE in the top level
# directory for more details.
#

config MODULE_SOFT_SPI
    bool "Software-implemented SPI"
    depends on HAS_PERIPH_GPIO
    depends on TEST_KCONFIG
    select MODULE_PERIPH_GPIO
    select MODULE_ZTIMER
    select ZTIMER_USEC

config MODULE_SOFT_SPI_AS_PERIPH_SPI
    bool "Use the software-implemented SPI to provide the peripheral SPI API"
    select MODULE_SOFT_SPI
    select HAS_PERIPH_SPI
```

## drivers/soft_uart/Kconfig
```kconfig
# Copyright (c) 2021 HAW Hamburg
#
# This file is subject to the terms and conditions of the GNU Lesser
# General Public License v2.1. See the file LICENSE in the top level
# directory for more details.
#

menuconfig MODULE_SOFT_UART
    bool "Software-implemented UART"
    depends on HAS_PERIPH_GPIO
    depends on HAS_PERIPH_GPIO_IRQ
    depends on HAS_PERIPH_TIMER
    depends on HAS_PERIPH_TIMER_PERIODIC
    depends on TEST_KCONFIG
    select MODULE_PERIPH_GPIO
    select MODULE_PERIPH_GPIO_IRQ
    select MODULE_PERIPH_TIMER
    select MODULE_PERIPH_TIMER_PERIODIC

config MODULE_SOFT_UART_MODECFG
    bool "Mode configuration support"
    depends on MODULE_SOFT_UART
```

## drivers/sps30/Kconfig
```kconfig
# SPDX-FileCopyrightText: 2020 Freie Universitaet Berlin
# SPDX-FileCopyrightText: 2021 HAW Hamburg
# SPDX-License-Identifier: LGPL-2.1-only

menu "SPS30 driver"
    depends on USEMODULE_SPS30

config SPS30_ERROR_RETRY
    int "Maximum number of error retries"
    default 500
    help
        Maximum number of automatic retries on communication errors.
        Change this to 0 if more fine-grained feedback is required.
        The value may be increased if the device is connected over
        suboptimal wiring.

endmenu # SPS30 driver
```

## drivers/srf04/Kconfig
```kconfig
# Copyright (c) 2021 HAW Hamburg
#
# This file is subject to the terms and conditions of the GNU Lesser
# General Public License v2.1. See the file LICENSE in the top level
# directory for more details.
#

config MODULE_SRF04
    bool "SRF04 ultrasonic range finder"
    depends on HAS_PERIPH_GPIO
    depends on HAS_PERIPH_GPIO_IRQ
    depends on TEST_KCONFIG
    select MODULE_PERIPH_GPIO
    select MODULE_PERIPH_GPIO_IRQ
    select MODULE_XTIMER
```

## drivers/st7735/Kconfig
```kconfig
# Copyright (c) 2020 HAW Hamburg
#
# This file is subject to the terms and conditions of the GNU Lesser
# General Public License v2.1. See the file LICENSE in the top level
# directory for more details.
#

config MODULE_ST7735
    bool "ST7735 display driver"
    depends on HAS_PERIPH_SPI
    depends on HAS_PERIPH_GPIO
    depends on TEST_KCONFIG
    select MODULE_PERIPH_SPI
    select MODULE_PERIPH_GPIO
    select MODULE_LCD
    select MODULE_ZTIMER
    select MODULE_ZTIMER_MSEC

config HAVE_ST7735
    bool
    select MODULE_ST7735 if MODULE_DISP_DEV
    help
      Indicates that an ST7735 display is present.
```

## drivers/st77xx/Kconfig
```kconfig
# SPDX-FileCopyrightText: 2020 HAW Hamburg
# SPDX-License-Identifier: LGPL-2.1-only

rsource "Kconfig.st7735"
rsource "Kconfig.st7789"
rsource "Kconfig.st7796"
```

## drivers/st77xx/Kconfig.st7735
```kconfig
# Copyright (c) 2023 Gunar Schorcht
#
# This file is subject to the terms and conditions of the GNU Lesser
# General Public License v2.1. See the file LICENSE in the top level
# directory for more details.
#

if USEMODULE_ST77XX

if USEMODULE_ST7735

menuconfig ST7735_CUSTOM_CONFIG
    bool "ST7735 Custom Configuration"
    help
        Enable if customized configuration of voltages are needed. Otherwise
        reset default values are used.

if ST7735_CUSTOM_CONFIG

config ST7735_AVDD
    int "AVDD voltage (in millivolts)"
    default 4900
    range 4500 5100
    help
        Configure the AVDD voltage for analog circuits in millivolts.
        Valid values must be in the range of 4500 (4.5V) to 5100 (5.1V)
        in steps of 100.

config ST7735_GVDD
    int "GVDD voltage (in millivolts)"
    default 4600
    range 3150 4700
    help
        Configure the GVDD voltage, the gamma reference positive voltage.
        Valid values must be in the range of 3150 (3.15V) to 4700 (4.7V)
        in steps of 50.

config ST7735_GVCL
    int "GVCL voltage (in millivolts)"
    default -4600
    range -4700 -3150
    help
        Configure the GVCL voltage, the gamma reference negative voltage.
        Valid values must be in the range of -4700 (-4.7V) to -3150 (-3.15V)
        in steps of 50.

config ST7735_VCOM
    int "VCOM voltage (in millivolts)"
    default -775
    range -2000 -425
    help
        Configure the VCOM voltage. VCOM needs to be adjusted to match the
        capacitance and performance specifications of the TFT panel to
        maximize contrast and minimize flickering.
        Valid values must be in the range of -2000 (-2.0V) to -425 (-0.425V)
        in steps of 25.

config ST7735_VGH
    int "VGH voltage (in millivolts)"
    default 14700
    range 10000 15000
    help
        Configure the high voltage for gate drivers in millivolts.
        Valid values must be in the range of 10000 (10V) to 15000 (15V) and
        in the range of (2 * AVDD + 2.1V) and (3 * AVDD + 2.4 V).

config ST7735_VGL
    int "VGL voltage (in millivolts)"
    default -10000
    range -13000 -7500
    help
        Configure the low voltage for gate drivers in millivolts.
        Valid values must be in the range of -13000 (-13V) to -7500 (-7.5V)
        in steps of 2500.

endif # ST7735_CUSTOM_CONFIG
endif # USEMODULE_ST7735
endif # USEMODULE_ST77XX
```

## drivers/st77xx/Kconfig.st7789
```kconfig
# Copyright (c) 2023 Gunar Schorcht
#
# This file is subject to the terms and conditions of the GNU Lesser
# General Public License v2.1. See the file LICENSE in the top level
# directory for more details.
#

if USEMODULE_ST77XX

if USEMODULE_ST7789

menuconfig ST7789_CUSTOM_CONFIG
    bool "ST7789 Custom Configuration"
    help
        Enable if customized configuration of voltages are needed. Otherwise
        reset default values are used.

if ST7789_CUSTOM_CONFIG

config ST7789_AVDD
    int "AVDD voltage (in millivolts)"
    default 6600
    range 6400 6800
    help
        Configure the AVDD voltage for analog circuits in millivolts.
        Valid values must be in the range of 6400 (6.4V) to 6800 (6.8V)
        in steps of 200.

config ST7789_AVCL
    int "AVDD voltage (in millivolts)"
    default -4400
    range -5000 -4400
    help
        Configure the AVCL voltage in millivolts.
        Valid values must be in the range of -5000 (-5V) to -4400 (-4.4V)
        in steps of 200.

config ST7789_VCOM
    int "VCOM voltage (in millivolts)"
    default 900
    range 100 1675
    help
        Configure the VCOM voltage level. VCOM needs to be adjusted
        to match the capacitance and performance specifications of the TFT panel
        to maximize contrast and minimize flickering. VCOM is used to derive
        the GVDD (gamma reference positive voltage) and the GVCL (gamma
        reference negative voltage) as follows:

            GDDV = +VRH + VCOM + VCOM_OFFSET + (0.5 * VDV)
            GVCL = -VRH + VCOM + VCOM_OFFSET - (0.5 * VDV)

        Valid values must be in the range of 100 (0.1V) to 1675 (1.675V)
        in steps of 25.

config ST7789_VCOM_OFFSET
    int "VCOM voltage offset (in millivolts)"
    default 0
    range -800 775
    help
        Configure the VCOM voltage offset (VCOM_OFFSET). VCOM_OFFSET is used to
        derive the GVDD (gamma reference positive voltage) and the GVCL (gamma
        reference negative voltage) as follows:

            GDDV = +VRH + VCOM + VCOM_OFFSET + (0.5 * VDV)
            GVCL = -VRH + VCOM + VCOM_OFFSET - (0.5 * VDV)

        Valid values must be in the range of -800 (-0.8V) to 775 (0.775V)
        in steps of 25.

config ST7789_VDV
    int "VDV voltage offset factor (in millivolts)"
    default 0
    range -800 775
    help
        Configure the VDV voltage offset factor. VDV is used to derive the GVDD
        (gamma reference positive voltage) and the GVCL (gamma reference
        negative voltage) as follows:

            GDDV = +VRH + VCOM + VCOM_OFFSET + (0.5 * VDV)
            GVCL = -VRH + VCOM + VCOM_OFFSET - (0.5 * VDV)

        Valid values must be in the range of -800 (-0.8V) to 775 (0.775V)
        in steps of 25.

config ST7789_VRH
    int "VRH voltage range (in millivolts)"
    default 4100
    range 3550 5500
    help
        Configure the VRH voltage range. VRH is used to derive the GVDD (gamma
        reference positive voltage) and the GVCL (gamma reference negative
        voltage) as follows:

            GDDV = +VRH + VCOM + VCOM_OFFSET + (0.5 * VDV)
            GVCL = -VRH + VCOM + VCOM_OFFSET - (0.5 * VDV)

        Valid values must be in the range of 3350 (3.35V) to 5500 (5.5V)
        in steps of 50.

# TODO  ST7789_VGH and ST7789_VGL (non linear values)

endif # ST7789_CUSTOM_CONFIG
endif # USEMODULE_ST7789
endif # USEMODULE_ST77XX
```
