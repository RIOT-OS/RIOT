/*
 * Copyright (C) 2015 Freie Universität Berlin
 *
 * This file is subject to the terms and conditions of the GNU Lesser
 * General Public License v2.1. See the file LICENSE in the top level
 * directory for more details.
 */

/**
 * @ingroup     drivers_pcd8544
 * @{
 * @file
 * @brief       Implementation of the SPI driver for the PDC8544 graphics display
 *
 * @author      Hauke Petersen <hauke.petersen@fu-berlin.de>
 * @}
 */

#include <stdint.h>
#include <stdio.h>

#include "xtimer.h"
#include "periph/spi.h"
#include "periph/gpio.h"
#include "pcd8544.h"
#include "pcd8544_internal.h"

#define ENABLE_DEBUG        (0)
#include "debug.h"

#define ASCII_MIN           0x20    /**< start of ASCII table */
#define ASCII_MAX           0x7e    /**< end of ASCII table */
#define CHAR_WIDTH          (6U)    /**< pixel width of a single character */

static const uint8_t _ascii[][5] = {
    {0x00, 0x00, 0x00, 0x00, 0x00},/* 20 SPACE*/
    {0x00, 0x00, 0x5f, 0x00, 0x00},/* 21 ! */
    {0x00, 0x07, 0x00, 0x07, 0x00},/* 22 " */
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    {0x10, 0x08, 0x08, 0x10, 0x08},/* 7e ~ */
};

static const char _riot[] = {
    0x00, 0x00, 0x00, 0x00, 0x00, 0x00, 0x00, 0x00,
    0x00, 0x00, 0x00, 0x00, 0x00, 0x00, 0x00, 0x00,
    0x00, 0x00, 0x00, 0x00, 0x00, 0x00, 0x00, 0x00,
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    0x00, 0x00, 0x00, 0x00, 0x00, 0x00, 0x00, 0x00,
};


static void _write(pcd8544_t *dev, uint8_t is_data, char data)
{
    /* set command or data mode */
    gpio_write(dev->mode, is_data);
    /* write byte to LCD */
    spi_acquire(dev->spi);
    gpio_clear(dev->cs);
    spi_transfer_byte(dev->spi, data, 0);
    gpio_set(dev->cs);
    spi_release(dev->spi);
}

static inline void _set_x(pcd8544_t *dev, uint8_t x)
{
    _write(dev, MODE_CMD, CMD_SET_X | x);
}

static inline void _set_y(pcd8544_t *dev, uint8_t y)
{
    _write(dev, MODE_CMD, CMD_SET_Y | y);
}

int pcd8544_init(pcd8544_t *dev, spi_t spi, gpio_t cs, gpio_t reset, gpio_t mode)
{
    /* save pin mapping */
    dev->spi = spi;
    dev->cs = cs;
    dev->reset = reset;
    dev->mode = mode;
    dev->inverted = 0;

    DEBUG("done setting dev members\n");

    /* initialze pins */
    gpio_init(cs, GPIO_DIR_OUT, GPIO_NOPULL);
    gpio_init(reset, GPIO_DIR_OUT, GPIO_NOPULL);
    gpio_init(mode, GPIO_DIR_OUT, GPIO_NOPULL);
    DEBUG("done with gpios\n");
    /* clear CS line */
    gpio_set(cs);
    DEBUG("done clearing CS line\n");
    /* initialize SPI */
    spi_init_master(spi, SPI_CONF_FIRST_RISING, SPI_SPEED_1MHZ);
    DEBUG("done initializing SPI master\n");
    /* reset display */
    gpio_clear(reset);
    xtimer_usleep(RESET_DELAY);
    gpio_set(reset);

    /* clear display memory */
    pcd8544_clear(dev);
    /* write initialization sequence to display */
    pcd8544_set_contrast(dev, PCD8544_DEFAULT_CONTRAST);
    pcd8544_set_bias(dev, PCD8544_DEFAULT_BIAS);
    pcd8544_set_tempcoef(dev, PCD8544_DEFAULT_TEMPCOEF);
    /* enable display */
    _write(dev, MODE_CMD, CMD_ENABLE_H);
    _write(dev, MODE_CMD, CMD_MODE_NORMAL);
    return 0;
}

void pcd8544_set_contrast(pcd8544_t *dev, uint8_t contrast)
{
    if (contrast > CONTRAST_MAX) {
        contrast = CONTRAST_MAX;
    }
    _write(dev, MODE_CMD, CMD_EXTENDED);
    _write(dev, MODE_CMD, (CMD_EXT_CONTRAST | contrast));
    _write(dev, MODE_CMD, CMD_ENABLE_H);
}

void pcd8544_set_tempcoef(pcd8544_t *dev, uint8_t coef)
{
    if (coef > TEMP_MAX) {
        coef = TEMP_MAX;
    }
    _write(dev, MODE_CMD, CMD_EXTENDED);
    _write(dev, MODE_CMD, (CMD_EXT_TEMP | coef));
    _write(dev, MODE_CMD, CMD_ENABLE_H);
}

void pcd8544_set_bias(pcd8544_t *dev, uint8_t bias)
{
    if (bias > BIAS_MAX) {
        bias = BIAS_MAX;
    }
    _write(dev, MODE_CMD, CMD_EXTENDED);
    _write(dev, MODE_CMD, (CMD_EXT_BIAS | bias));
    _write(dev, MODE_CMD, CMD_ENABLE_H);
}

void pcd8544_riot(pcd8544_t *dev)
{
    pcd8544_write_img(dev, _riot);
}

void pcd8544_write_img(pcd8544_t *dev, const char img[])
{
    /* set initial position */
    _set_x(dev, 0);
    _set_y(dev, 0);
    /* write image data to display */
    for (int i = 0; i < (PCD8544_RES_X * PCD8544_RES_Y / 8); i++) {
        _write(dev, MODE_DTA, img[i]);
    }
}

void pcd8544_write_c(pcd8544_t *dev, uint8_t x, uint8_t y, char c)
{
    /* check position */
    if (x >= PCD8544_COLS || y >= PCD8544_ROWS) {
        return ;
    }
    /* set position */
    _set_x(dev, x * CHAR_WIDTH);
    _set_y(dev, y);
    /* write char */
    for (int i = 0; i < CHAR_WIDTH - 1; i++) {
        _write(dev, MODE_DTA, _ascii[c - ASCII_MIN][i]);
    }
    _write(dev, MODE_DTA, 0x00);
}

void pcd8544_write_s(pcd8544_t *dev, uint8_t x, uint8_t y, const char *s)
{
    for (; (*s != '\0') && x < PCD8544_COLS; x++, s++) {
        pcd8544_write_c(dev, x, y, *s);
    }
}

void pcd8544_clear(pcd8544_t *dev)
{
    _set_x(dev, 0);
    _set_y(dev, 0);
    for (int i = 0; i < PCD8544_RES_X * PCD8544_ROWS; i++) {
        _write(dev, MODE_DTA, 0x00);
    }
}

void pcd8544_invert(pcd8544_t *dev)
{
    if (dev->inverted) {
        _write(dev, MODE_CMD, CMD_MODE_NORMAL);
    }
    else {
        _write(dev, MODE_CMD, CMD_MODE_INVERSE);
    }
    dev->inverted ^= 0x01;
}

int pcd8544_is_inverted(pcd8544_t *dev)
{
    return dev->inverted;
}

void pcd8544_poweron(pcd8544_t *dev)
{
    _write(dev, MODE_CMD, CMD_ENABLE_H);
}

void pcd8544_poweroff(pcd8544_t *dev)
{
    _write(dev, MODE_CMD, CMD_DISABLE);
}
