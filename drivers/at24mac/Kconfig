## drivers/at86rf2xx/Kconfig
```kconfig
# Copyright (c) 2022 HAW Hamburg
#
# This file is subject to the terms and conditions of the GNU Lesser
# General Public License v2.1. See the file LICENSE in the top level
# directory for more details.
#

menuconfig MODULE_AT86RF2XX
    bool
    prompt "AT86RF2xx series radios" if !(MODULE_NETDEV_DEFAULT && HAVE_AT86RF2XX)
    default (MODULE_NETDEV_DEFAULT && HAVE_AT86RF2XX)
    depends on TEST_KCONFIG
    select MODULE_IEEE802154
    select MODULE_NETDEV
    select MODULE_NETDEV_IEEE802154
    select MODULE_NETDEV_LEGACY_API
    select MODULE_ZTIMER
    select MODULE_ZTIMER_USEC

if MODULE_AT86RF2XX

choice AT86RF2XX_VARIANT
    bool "Variants"
    default MODULE_AT86RF212B if HAVE_AT86RF212B
    default MODULE_AT86RF231 if HAVE_AT86RF231
    default MODULE_AT86RF232 if HAVE_AT86RF232
    default MODULE_AT86RF233 if HAVE_AT86RF233
    default MODULE_AT86RFA1 if HAVE_AT86RFA1
    default MODULE_AT86RFR2 if HAVE_AT86RFR2
    help
      Select the specific part-number.

config MODULE_AT86RF231
    bool "AT86RF231"
    depends on HAS_PERIPH_GPIO
    depends on HAS_PERIPH_GPIO_IRQ
    depends on HAS_PERIPH_SPI
    select MODULE_PERIPH_GPIO
    select MODULE_PERIPH_GPIO_IRQ
    select MODULE_PERIPH_SPI

config MODULE_AT86RF212B
    bool "AT86RF212B"
    depends on HAS_PERIPH_GPIO
    depends on HAS_PERIPH_GPIO_IRQ
    depends on HAS_PERIPH_SPI
    select MODULE_PERIPH_GPIO
    select MODULE_PERIPH_GPIO_IRQ
    select MODULE_PERIPH_SPI

config MODULE_AT86RF232
    bool "AT86RF232"
    depends on HAS_PERIPH_GPIO
    depends on HAS_PERIPH_GPIO_IRQ
    depends on HAS_PERIPH_SPI
    select MODULE_PERIPH_GPIO
    select MODULE_PERIPH_GPIO_IRQ
    select MODULE_PERIPH_SPI

config MODULE_AT86RF233
    bool "AT86RF233"
    depends on HAS_PERIPH_GPIO
    depends on HAS_PERIPH_GPIO_IRQ
    depends on HAS_PERIPH_SPI
    select MODULE_PERIPH_GPIO
    select MODULE_PERIPH_GPIO_IRQ
    select MODULE_PERIPH_SPI

config MODULE_AT86RFA1
    bool "AT86RFA1"

config MODULE_AT86RFR2
    bool "AT86RFR2"

endchoice

config MODULE_AUTO_INIT_AT86RF2XX
    bool "Auto-initialize the driver"
    default y
    depends on MODULE_AUTO_INIT

config MODULE_AT86RF2XX_AES_SPI
    bool "AES security"

config AT86RF2XX_OQPSK
    bool "O-QPSK support"
    select MODULE_NETDEV_IEEE802154_OQPSK
    default y

endif # MODULE_AT86RF2XX

config HAVE_AT86RF2XX
    bool
    help
        Indicates that an AT86RF2XX radio is present.

config HAVE_AT86RF212B
    bool
    select HAVE_AT86RF2XX
    help
        Indicates that an AT86RF212B radio is present.

config HAVE_AT86RF231
    bool
    select HAVE_AT86RF2XX
    help
        Indicates that an AT86RF231 radio is present.

config HAVE_AT86RF232
    bool
    select HAVE_AT86RF2XX
    help
        Indicates that an AT86RF232 radio is present.

config HAVE_AT86RF233
    bool
    select HAVE_AT86RF2XX
    help
        Indicates that an AT86RF233 radio is present.

config HAVE_AT86RFA1
    bool
    select HAVE_AT86RF2XX
    help
        Indicates that an AT86RFA1 radio is present.

config HAVE_AT86RFR2
    bool
    select HAVE_AT86RF2XX
    help
        Indicates that an AT86RFR2 radio is present.
```

## drivers/ata8520e/Kconfig
```kconfig
# Copyright (c) 2020 HAW Hamburg
#
# This file is subject to the terms and conditions of the GNU Lesser
# General Public License v2.1. See the file LICENSE in the top level
# directory for more details.
#

config MODULE_ATA8520E
    bool "ATA8520E Sigfox compatible transceiver"
    depends on HAS_PERIPH_GPIO
    depends on HAS_PERIPH_GPIO_IRQ
    depends on HAS_PERIPH_SPI
    depends on TEST_KCONFIG
    select MODULE_PERIPH_GPIO
    select MODULE_PERIPH_GPIO_IRQ
    select MODULE_PERIPH_SPI
    select MODULE_FMT
    select MODULE_ZTIMER
    select MODULE_ZTIMER_MSEC
```

## drivers/atwinc15x0/Kconfig
```kconfig
# Copyright (c) 2020 HAW Hamburg
#
# This file is subject to the terms and conditions of the GNU Lesser
# General Public License v2.1. See the file LICENSE in the top level
# directory for more details.
#

menuconfig MODULE_ATWINC15X0
    bool
    prompt "ATWINC15x0 WiFi module" if !(MODULE_NETDEV_DEFAULT && HAVE_ATWINC15X0)
    default y if (MODULE_NETDEV_DEFAULT && HAVE_ATWINC15X0)
    depends on HAS_PERIPH_GPIO
    depends on HAS_PERIPH_GPIO_IRQ
    depends on HAS_PERIPH_SPI
    depends on TEST_KCONFIG
    select PACKAGE_DRIVER_ATWINC15X0
    select MODULE_PERIPH_GPIO
    select MODULE_PERIPH_GPIO_IRQ
    select MODULE_PERIPH_SPI
    select MODULE_NETDEV_ETH
    select MODULE_ZTIMER_MSEC
    help
        This netdev device driver is used for the Microchip ATWINC15x0
        WiFi module. The ATWINC15x0 WiFi module is widely used as WiFi
        interface on various boards and extension boards.

if MODULE_ATWINC15X0

config WIFI_SSID
    string "WiFi SSID"
    default "my_ssid"
    help
        SSID of the AP to be used.

config WIFI_PASS
    string "WiFi passphrase"
    default "my_pass"
    help
        Passphrase used for the AP as clear text (max. 64 chars).

endif # MODULE_ATWINC15X0

config HAVE_ATWINC15X0
    bool
    help
      Indicates that a ATWINC15x0 module is present.
```

## drivers/bme680/Kconfig
```kconfig
# Copyright (c) 2020 HAW Hamburg
#
# This file is subject to the terms and conditions of the GNU Lesser
# General Public License v2.1. See the file LICENSE in the top level
# directory for more details.
#

menuconfig MODULE_BME680
    bool
    prompt "BME680 Temperature/Humidity/Pressure/Gas sensor" if !(MODULE_SAUL_DEFAULT && HAVE_BME680)
    default (MODULE_SAUL_DEFAULT && HAVE_BME680)
    depends on TEST_KCONFIG
    select PACKAGE_DRIVER_BME680
    select MODULE_ZTIMER if MODULE_SAUL
    select MODULE_ZTIMER_MSEC if MODULE_SAUL

if MODULE_BME680

choice BME680_VARIANT
    bool "Device interface"
    default MODULE_BME680_I2C if HAVE_BME680_I2C
    default MODULE_BME680_SPI if HAVE_BME680_SPI
    help
        The device can be connected via different buses, select one.

config MODULE_BME680_I2C
    bool "I2C"
    depends on HAS_PERIPH_I2C
    select MODULE_PERIPH_I2C

config MODULE_BME680_SPI
    bool "SPI"
    depends on HAS_PERIPH_SPI
    depends on HAS_PERIPH_GPIO
    select MODULE_PERIPH_SPI
    select MODULE_PERIPH_GPIO

endchoice

config MODULE_BME680_FP
    bool "Enable floating point"

endif # MODULE_BME680

config HAVE_BME680
    bool
    help
        Indicates that the BME680 Temperature/Humidity/Pressure/Gas sensor is present.

config HAVE_BME680_I2C
    bool
    select HAVE_BME680
    help
        Indicates that the BME680 Temperature/Humidity/Pressure/Gas sensor is connected with i2c.

config HAVE_BME680_SPI
    bool
    select HAVE_BME680
    help
        Indicates that the BME680 Temperature/Humidity/Pressure/Gas sensor is connected with spi.
```

## drivers/bmp180/Kconfig
```kconfig
# Copyright (c) 2020 HAW Hamburg
#
# This file is subject to the terms and conditions of the GNU Lesser
# General Public License v2.1. See the file LICENSE in the top level
# directory for more details.
#

config MODULE_BMP180
    bool "BMP180 temperature and pressure sensor"
    depends on HAS_PERIPH_I2C
    depends on TEST_KCONFIG
    select MODULE_PERIPH_I2C
    select MODULE_ZTIMER
    select MODULE_ZTIMER_MSEC
```

## drivers/bmx055/Kconfig
```kconfig
# SPDX-FileCopyrightText: 2020 Freie Universitaet Berlin
# SPDX-FileCopyrightText: 2020 HAW Hamburg
# SPDX-License-Identifier: LGPL-2.1-only

menu "BMX055 driver"
    depends on USEMODULE_BMX055

config BMX055_MAG_ADDR_DEFAULT
    hex "I2C Address of magnetometer"
    range 0x10 0x13
    default 0x10
    help
        The address depends on the state of SDO1, SDO2 and CSB3 pins.
        For more information refer to the section 'Inter-Integrated
        Circuit (I²C)' in the datasheet.

config BMX055_ACC_ADDR_DEFAULT
    hex "I2C Address of accelerometer"
    range 0x18 0x19
    default 0x18
    help
        The address depends on the state of SDO1, SDO2 and CSB3 pins.
        For more information refer to the section 'Inter-Integrated
        Circuit (I²C)' in the datasheet.

config BMX055_GYRO_ADDR_DEFAULT
    hex "I2C Address of gyroscope"
    range 0x68 0x69
    default 0x68
    help
        The address depends on the state of SDO1, SDO2 and CSB3 pins.
        For more information refer to the section 'Inter-Integrated
        Circuit (I²C)' in the datasheet.

endmenu # BMX055 driver
```

## drivers/bmx280/Kconfig
```kconfig
# Copyright (c) 2020 HAW Hamburg
#
# This file is subject to the terms and conditions of the GNU Lesser
# General Public License v2.1. See the file LICENSE in the top level
# directory for more details.
#


menuconfig MODULE_BMX280
    bool
    prompt "BMx280 Temperature, pressure and humidity sensors" if !(MODULE_SAUL_DEFAULT && HAVE_BMX280)
    default (MODULE_SAUL_DEFAULT && HAVE_BMX280)
    depends on TEST_KCONFIG

if MODULE_BMX280

choice BMX280_VARIANT
    bool "Model"
    default MODULE_BME280_I2C if HAVE_BME280_I2C
    default MODULE_BME280_SPI if HAVE_BME280_SPI
    default MODULE_BMP280_I2C if HAVE_BMP280_I2C
    default MODULE_BMP280_SPI if HAVE_BMP280_SPI
    help
        The driver supports both BME280 and BMP280 connected either via SPI or
        I2C bus. Select one combination.

config MODULE_BME280_I2C
    bool "BME280 on I2C"
    depends on HAS_PERIPH_I2C
    select MODULE_PERIPH_I2C

config MODULE_BME280_SPI
    bool "BME280 on SPI"
    depends on HAS_PERIPH_SPI
    depends on HAS_PERIPH_GPIO
    select MODULE_PERIPH_SPI
    select MODULE_PERIPH_GPIO

config MODULE_BMP280_I2C
    bool "BMP280 on I2C"
    depends on HAS_PERIPH_I2C
    select MODULE_PERIPH_I2C

config MODULE_BMP280_SPI
    bool "BMP280 on SPI"
    depends on HAS_PERIPH_SPI
    depends on HAS_PERIPH_GPIO
    select MODULE_PERIPH_SPI
    select MODULE_PERIPH_GPIO

endchoice

endif # MODULE_BMX280

config HAVE_BME280_I2C
    bool
    select HAVE_BMX280
    help
      Indicates that a bme280 sensor on the I2C bus is present.

config HAVE_BME280_SPI
    bool
    select HAVE_BMX280
    help
      Indicates that a bme280 sensor on the SPI bus is present.

config HAVE_BMP280_I2C
    bool
    select HAVE_BMX280
    help
      Indicates that a bmp280 sensor on the I2C bus is present.

config HAVE_BMP280_SPI
    bool
    select HAVE_BMX280
    help
      Indicates that a bmp280 sensor on the SPI bus is present.

config HAVE_BMX280
    bool
    select MODULE_BMX280 if MODULE_SAUL_DEFAULT
    help
        Indicates that a bmx280 sensor is present.
```

## drivers/bq2429x/Kconfig
```kconfig
# Copyright (C) 2020 Locha Inc
#
# This file is subject to the terms and conditions of the GNU Lesser
# General Public License v2.1. See the file LICENSE in the top level
# directory for more details.
#

menuconfig MODULE_BQ2429X
    bool "BQ2429x single-cell USB charger"
    depends on HAS_PERIPH_I2C
    depends on HAS_PERIPH_GPIO
    depends on TEST_KCONFIG
    select MODULE_PERIPH_I2C
    select MODULE_PERIPH_GPIO
    default y if HAVE_BQ2429X
    help
        The driver can be used with Texas Instruments USB charger ICs: BQ24295,
        BQ24296, BQ24297, BQ24298, BQ24292I, BQ24296M.

config MODULE_BQ2429X_INT
    bool "Interrupt handling"
    depends on HAS_PERIPH_GPIO_IRQ
    depends on MODULE_BQ2429X
    select MODULE_PERIPH_GPIO_IRQ
    default y if HAVE_BQ2429X_INT
    help
        Say y to include interrupt handling functionality.

config HAVE_BQ2429X
    bool
    help
        Indicates that a BQ2429x charger and power management IC is present.

config HAVE_BQ2429X_INT
    bool
    help
        Indicates that a BQ2429x charger and power management IC is present,
        with interrupt functionality (the INT pin is connected).
```

## drivers/can_trx/Kconfig
```kconfig
# Copyright (c) 2020 HAW Hamburg
#
# This file is subject to the terms and conditions of the GNU Lesser
# General Public License v2.1. See the file LICENSE in the top level
# directory for more details.
#

config MODULE_CAN_TRX
    bool "Generic CAN transceiver interface"
    depends on TEST_KCONFIG
```

## drivers/cc110x/Kconfig
```kconfig
# SPDX-FileCopyrightText: 2020 Freie Universitaet Berlin
# SPDX-License-Identifier: LGPL-2.1-only

menu "CC110X driver"
    depends on USEMODULE_CC110X

config CC110X_DEFAULT_CHANNEL
    int "Configure default channel"
    range 0 7
    default 0
    help
        Set the default channel for transmission from the allowed
        maximum of 8 (0-7) Channels.
        Default channel is 0.

endmenu # CC110X driver
```

## drivers/cc2420/Kconfig
```kconfig
# Copyright (c) 2022 HAW Hamburg
#
# This file is subject to the terms and conditions of the GNU Lesser
# General Public License v2.1. See the file LICENSE in the top level
# directory for more details.
#

config MODULE_CC2420
    bool "CC2420 radio"
    depends on TEST_KCONFIG
    depends on HAS_PERIPH_GPIO
    depends on HAS_PERIPH_GPIO_IRQ
    depends on HAS_PERIPH_SPI
    select MODULE_IEEE802154
    select MODULE_NETDEV
    select MODULE_NETDEV_IEEE802154
    select MODULE_NETDEV_LEGACY_API
    select MODULE_PERIPH_GPIO
    select MODULE_PERIPH_GPIO_IRQ
    select MODULE_PERIPH_SPI
    select MODULE_XTIMER

config HAVE_CC2420
    bool
    select MODULE_CC2420 if MODULE_NETDEV_DEFAULT
    help
        Indicates that a CC2420 radio is present.
```

## drivers/ccs811/Kconfig
```kconfig
# Copyright (c) 2020 HAW Hamburg
#
# This file is subject to the terms and conditions of the GNU Lesser
# General Public License v2.1. See the file LICENSE in the top level
# directory for more details.
#

menuconfig MODULE_CCS811
    bool "CCS811 digital gas sensor"
    depends on HAS_PERIPH_GPIO
    depends on HAS_PERIPH_I2C
    depends on TEST_KCONFIG
    select MODULE_PERIPH_GPIO
    select MODULE_PERIPH_I2C
    select MODULE_ZTIMER
    select MODULE_ZTIMER_USEC
    select MODULE_ZTIMER_PERIPH_TIMER

config MODULE_CCS811_FULL
    bool "Full functionalities"
    depends on MODULE_CCS811
    depends on HAS_PERIPH_GPIO_IRQ
    select MODULE_PERIPH_GPIO_IRQ
    help
        Say n if code size is critical, otherwise using the this module is
        recommended.
        Features included by this module are:
            - data ready and threshold interrupt handling
            - compensate gas readings using an external sensor
            - manual baseline handling

config HAVE_CCS811
    bool
    select MODULE_CCS811 if MODULE_SAUL_DEFAULT
    help
        Indicates that a ccs811 sensor is present.
```

## drivers/cst816s/Kconfig
```kconfig
# Copyright (c) 2020 HAW Hamburg
#
# This file is subject to the terms and conditions of the GNU Lesser
# General Public License v2.1. See the file LICENSE in the top level
# directory for more details.
#

config MODULE_CST816S
    bool "cst816s touch screen"
    depends on HAS_PERIPH_GPIO_IRQ
    depends on HAS_PERIPH_I2C
    depends on TEST_KCONFIG
    select MODULE_PERIPH_GPIO_IRQ
    select MODULE_PERIPH_I2C
    select MODULE_ZTIMER
    select MODULE_ZTIMER_MSEC

config HAVE_CST816S
    bool
    select MODULE_CST816S if MODULE_TOUCH_DEV
    help
        Indicates that a cst816s touch screen is present.
```

## drivers/dac_dds/Kconfig
```kconfig
# Copyright (c) 2022 HAW Hamburg
#
# This file is subject to the terms and conditions of the GNU Lesser
# General Public License v2.1. See the file LICENSE in the top level
# directory for more details.
#

config MODULE_DAC_DDS
    bool "Common DAC function fallback implementations"
    depends on HAS_PERIPH_DAC
    depends on HAS_PERIPH_TIMER
    depends on HAS_PERIPH_TIMER_PERIODIC
    depends on TEST_KCONFIG
    select MODULE_PERIPH_DAC
    select MODULE_PERIPH_TIMER
    select MODULE_PERIPH_TIMER_PERIODIC
```
