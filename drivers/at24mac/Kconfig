## drivers/dali/Kconfig
```kconfig
# Copyright (c) 2021 Mesotic SAS
#
# This file is subject to the terms and conditions of the GNU Lesser
# General Public License v2.1. See the file LICENSE in the top level
# directory for more details.
#

menuconfig MODULE_DALI
    bool "Dali lowlevel protocol (part of IEC 60929)"
    depends on HAS_PERIPH_GPIO_IRQ
    select MODULE_PERIPH_GPIO_IRQ
    select MODULE_ZTIMER_USEC
```

## drivers/dfplayer/Kconfig
```kconfig
menu "DFPLAYER: MP3 Player"
    depends on USEMODULE_DFPLAYER

config DFPLAYER_NO_STRERROR
    bool
    prompt "Avoid using strerror in shell command" if !(HAS_ARCH_AVR8 || HAS_ARCH_MSP430)

    depends on USEMODULE_SHELL_CMDS
    # no strerror() on AVR and MSP430
    default y if (HAS_ARCH_AVR8 || HAS_ARCH_MSP430)
    help
        Say y to print error codes as numbers when using the shell, instead of the corresponding
        standard error string.

endmenu # DFPLAYER: MP3 Player
```

## drivers/disp_dev/Kconfig
```kconfig
# Copyright (c) 2020 HAW Hamburg
#
# This file is subject to the terms and conditions of the GNU Lesser
# General Public License v2.1. See the file LICENSE in the top level
# directory for more details.
#

config MODULE_DISP_DEV
    bool "Display device generic API"
    depends on TEST_KCONFIG
    imply MODULE_AUTO_INIT_SCREEN
```
