## drivers/at24mac/Kconfig
```kconfig
# Copyright (c) 2020 HAW Hamburg
#
# This file is subject to the terms and conditions of the GNU Lesser
# General Public License v2.1. See the file LICENSE in the top level
# directory for more details.
#

config MODULE_AT24MAC
    bool
    prompt "AT24MAC unique ID" if !(MODULE_EUI_PROVIDER && HAVE_AT24MAC)
    default (MODULE_EUI_PROVIDER && HAVE_AT24MAC)
    depends on TEST_KCONFIG
    depends on HAS_PERIPH_I2C
    select MODULE_PERIPH_I2C
# Deprecated functionality, the eeprom should be independent of the id.
# Should be removed in the 2022.07 release.
    select MODULE_AT24CXXX

choice AT24CXXX_VARIANT
    default MODULE_AT24MAC_EEPROM if HAVE_AT24MAC

config MODULE_AT24MAC_EEPROM
    bool "AT24MAC"

endchoice

config HAVE_AT24MAC
    bool
    select HAVE_AT24CXXX
    help
       Indicates that an AT24MAC unique ID chip is present.
```

## drivers/at24mac_eui/Kconfig
```kconfig
# Copyright (c) 2020 HAW Hamburg
#
# This file is subject to the terms and conditions of the GNU Lesser
# General Public License v2.1. See the file LICENSE in the top level
# directory for more details.
#

config MODULE_AT24MAC
    bool "Use both eeprom and unique ID of AT24MAC"
    depends on TEST_KCONFIG
    depends on HAS_PERIPH_I2C
    select MODULE_AT24MAC_EUI
    select MODULE_AT24CXXX
    select HAVE_AT24MAC

config MODULE_AT24MAC_EUI
    bool
    prompt "AT24MAC unique ID" if !(MODULE_EUI_PROVIDER && HAVE_AT24MAC)
    default (MODULE_EUI_PROVIDER && HAVE_AT24MAC)
    depends on TEST_KCONFIG
    depends on HAS_PERIPH_I2C
    select MODULE_PERIPH_I2C

choice AT24CXXX_VARIANT
    default MODULE_AT24MAC_EEPROM if HAVE_AT24MAC

config MODULE_AT24MAC_EEPROM
    bool "AT24MAC"

endchoice

config HAVE_AT24MAC
    bool
    select HAVE_AT24CXXX
    help
       Indicates that an AT24MAC unique ID chip is present.
```

## drivers/at24mac_id/Kconfig
```kconfig
# Copyright (c) 2020 HAW Hamburg
#
# This file is subject to the terms and conditions of the GNU Lesser
# General Public License v2.1. See the file LICENSE in the top level
# directory for more details.
#

config MODULE_AT24MAC_ID
    bool
    prompt "AT24MAC unique ID chip" if !(MODULE_EUI_PROVIDER && HAVE_AT24MAC)
    default (MODULE_EUI_PROVIDER && HAVE_AT24MAC)
    depends on HAS_PERIPH_I2C
    depends on TEST_KCONFIG
    select MODULE_PERIPH_I2C
```

## drivers/at24xxxx/Kconfig
```kconfig
# Copyright (c) 2020 HAW Hamburg
#
# This file is subject to the terms and conditions of the GNU Lesser
# General Public License v2.1. See the file LICENSE in the top level
# directory for more details.
#

menuconfig MODULE_AT24XXXX
    bool
    prompt "AT24XXXX EEPROM" if !(MODULE_MTD && HAVE_AT24XXXX)
    default MODULE_MTD && HAVE_AT24XXXX
    depends on HAS_PERIPH_I2C
    depends on TEST_KCONFIG
    select MODULE_PERIPH_I2C
    select MODULE_XTIMER

choice AT24XXXX_VARIANT
    bool "Variants"
    depends on MODULE_AT24XXXX
    optional
    default MODULE_AT24C01 if HAVE_AT24C01
    default MODULE_AT24C02 if HAVE_AT24C02
    default MODULE_AT24C04 if HAVE_AT24C04
    default MODULE_AT24C08A if HAVE_AT24C08A
    default MODULE_AT24C16A if HAVE_AT24C16A
    default MODULE_AT24C32 if HAVE_AT24C32
    default MODULE_AT24C64 if HAVE_AT24C64
    default MODULE_AT24C128 if HAVE_AT24C128
    default MODULE_AT24C256 if HAVE_AT24C256
    default MODULE_AT24C512 if HAVE_AT24C512
    default MODULE_AT24C1024 if HAVE_AT24C1024
    default MODULE_AT24MAC if HAVE_AT24MAC
    help
        This driver supports the multiple models, select one.

config MODULE_AT24C01
    bool "AT24C01"

config MODULE_AT24C02
    bool "AT24C02"

config MODULE_AT24C04
    bool "AT24C04"

config MODULE_AT24C08A
    bool "AT24C08A"

config MODULE_AT24C16A
    bool "AT24C16A"

config MODULE_AT24C32
    bool "AT24C32"

config MODULE_AT24C64
    bool "AT24C64"

config MODULE_AT24C128
    bool "AT24C128"

config MODULE_AT24C256
    bool "AT24C256"

config MODULE_AT24C512
    bool "AT24C512"

config MODULE_AT24C1024
    bool "AT24C1024"

config MODULE_AT24MAC
    bool "AT24MAC"

endchoice

config HAVE_AT24XXXX
    bool
    help
        Indicates that the AT24XXXX EEPROM is present.

config HAVE_AT24C01
    bool
    select HAVE_AT24XXXX
    help
        Indicates that the AT24C01 is present.

config HAVE_AT24C02
    bool
    select HAVE_AT24XXXX
    help
        Indicates that the AT24C02 is present.

config HAVE_AT24C04
    bool
    select HAVE_AT24XXXX
    help
        Indicates that the AT24C04 is present.

config HAVE_AT24C08A
    bool
    select HAVE_AT24XXXX
    help
        Indicates that the AT24C08A is present.

config HAVE_AT24C16A
    bool
    select HAVE_AT24XXXX
    help
        Indicates that the AT24C16A is present.

config HAVE_AT24C32
    bool
    select HAVE_AT24XXXX
    help
        Indicates that the AT24C32 is present.

config HAVE_AT24C64
    bool
    select HAVE_AT24XXXX
    help
        Indicates that the AT24C64 is present.

config HAVE_AT24C128
    bool
    select HAVE_AT24XXXX
    help
        Indicates that the  AT24C128 is present.

config HAVE_AT24C256
    bool
    select HAVE_AT24XXXX
    help
        Indicates that the  AT24C256 is present.

config HAVE_AT24C512
    bool
    select HAVE_AT24XXXX
    help
        Indicates that the  AT24C512 is present.

config HAVE_AT24C1024
    bool
    select HAVE_AT24XXXX
    help
        Indicates that the AT24C1024 is present.

config HAVE_AT24MAC
    bool
    select HAVE_AT24XXXX
    help
        Indicates that the AT24MAC is present.
```

## drivers/at25xxx/Kconfig
```kconfig
# Copyright (c) 2020 HAW Hamburg
#
# This file is subject to the terms and conditions of the GNU Lesser
# General Public License v2.1. See the file LICENSE in the top level
# directory for more details.
#

config MODULE_AT25XXX
    bool "AT25xxx SPI-EEPROMs"
    depends on HAS_PERIPH_SPI
    depends on TEST_KCONFIG
    select HAVE_MTD_AT25XXX
    select MODULE_PERIPH_SPI
    select MODULE_XTIMER
    help
        This driver also supports M95xxx, 25AAxxx, 25LCxxx, CAT25xxx & BR25Sxxx
        families.
```

## drivers/at25xxx/mtd/Kconfig
```kconfig
# Copyright (c) 2020 HAW Hamburg
#
# This file is subject to the terms and conditions of the GNU Lesser
# General Public License v2.1. See the file LICENSE in the top level
# directory for more details.
#

config MODULE_MTD_AT25XXX
    bool "MTD implementation for AT25XXX"
    depends on MODULE_AT25XXX
    depends on MODULE_MTD
    depends on TEST_KCONFIG
```

## drivers/at30tse75x/Kconfig
```kconfig
# Copyright (c) 2020 HAW Hamburg
#
# This file is subject to the terms and conditions of the GNU Lesser
# General Public License v2.1. See the file LICENSE in the top level
# directory for more details.
#

config MODULE_AT30TSE75X
    bool "AT30TSE75X temperature sensor"
    depends on HAS_PERIPH_I2C
    depends on TEST_KCONFIG
    select MODULE_PERIPH_I2C
    select MODULE_ZTIMER
    select ZTIMER_USEC
    help
        AT30TSE75x temperature sensor with serial EEPROM.

config HAVE_AT30TSE75X
    bool
    select MODULE_AT30TSE75X if MODULE_SAUL_DEFAULT
    help
        Indicates that a AT30TSE75x sensor is present on the board.
```

## drivers/at86rf215/Kconfig
```kconfig
# SPDX-FileCopyrightText: 2020 Freie Universitaet Berlin
# SPDX-FileCopyrightText: 2022 HAW Hamburg
# SPDX-License-Identifier: LGPL-2.1-only

if USEMODULE_AT86RF215

menu "Modulations"

menuconfig AT86RF215_OQPSK
    bool "O-QPSK support"
    default y

if AT86RF215_OQPSK

choice
    bool "Default (legacy) O-QPSK rate mode"
    default AT86RF215_OQPSK_RATE_LOW
    help
        The at86rf215 supports proprietary high data rates that are compatible
        with the at86rf2xx parts.
        If unsure, select low rate.

config AT86RF215_OQPSK_RATE_LOW
    bool "Low rate mode (compatible)"

config AT86RF215_OQPSK_RATE_HIGH
    bool "High rate mode (proprietary)"

endchoice

config AT86RF215_DEFAULT_OQPSK_RATE
    int
    default 0 if AT86RF215_OQPSK_RATE_LOW
    default 1 if AT86RF215_OQPSK_RATE_HIGH

endif # AT86RF215_OQPSK

menuconfig AT86RF215_MR_OQPSK
    bool "MR-O-QPSK support"
    default y

if AT86RF215_MR_OQPSK

config AT86RF215_DEFAULT_MR_OQPSK_RATE
    int "Default MR-O-QPSK rate mode"
    range 0 3
    default 2
    help
        Default Rate Mode of the MR-O-QPSK PHY. Each increment doubles the PSDU
        data rate.

choice
    prompt "Default MR-O-QPSK Chip Rate"

config AT86RF215_DEFAULT_MR_OQPSK_CHIPS_100
    bool "100 kchip/s"

config AT86RF215_DEFAULT_MR_OQPSK_CHIPS_200
    bool "200 kchip/s"

config AT86RF215_DEFAULT_MR_OQPSK_CHIPS_1000
    bool "1000 kchip/s"

config AT86RF215_DEFAULT_MR_OQPSK_CHIPS_2000
    bool "2000 kchip/s"

endchoice

endif # AT86RF215_MR_OQPSK

menuconfig AT86RF215_MR_OFDM
    bool "MR-OFDM support"
    default y

if AT86RF215_MR_OFDM

config AT86RF215_DEFAULT_MR_OFDM_OPT
    int "Default MR-OFDM option"
    range 1 4
    default 2
    help
        Default Option of the MR-OFDM PHY
        Each increment halves the PSDU data rate.

choice
    bool "Default MR-OFDM Modulation & Coding Scheme"
    default AT86RF215_MR_OFDM_MCS_QPSK_R12_FR2
    help
        Default Modulation & Coding Scheme of the MR-OFDM PHY.
        Higher schemes correspond to higher data rates and lower range.

config AT86RF215_MR_OFDM_MCS_BPSK_R12_FR4
    bool "BPSK, rate 1⁄2, 4 x frequency repetition"

config AT86RF215_MR_OFDM_MCS_BPSK_R12_FR2
    bool "BPSK, rate 1⁄2, 2 x frequency repetition"

config AT86RF215_MR_OFDM_MCS_QPSK_R12_FR2
    bool "QPSK, rate 1⁄2, 2 x frequency repetition"

config AT86RF215_MR_OFDM_MCS_QPSK_R12_FR0
    bool "QPSK, rate 1⁄2"

config AT86RF215_MR_OFDM_MCS_QPSK_R34_FR0
    bool "QPSK, rate 3⁄4"

config AT86RF215_MR_OFDM_MCS_16QAM_R12_FR0
    bool "16-QAM, rate 1⁄2"

config AT86RF215_MR_OFDM_MCS_16QAM_R34_FR0
    bool "16-QAM, rate 3⁄4"

endchoice

config AT86RF215_DEFAULT_MR_OFDM_MCS
    int
    default 0 if AT86RF215_MR_OFDM_MCS_BPSK_R12_FR4
    default 1 if AT86RF215_MR_OFDM_MCS_BPSK_R12_FR2
    default 2 if AT86RF215_MR_OFDM_MCS_QPSK_R12_FR2
    default 3 if AT86RF215_MR_OFDM_MCS_QPSK_R12_FR0
    default 4 if AT86RF215_MR_OFDM_MCS_QPSK_R34_FR0
    default 5 if AT86RF215_MR_OFDM_MCS_16QAM_R12_FR0
    default 6 if AT86RF215_MR_OFDM_MCS_16QAM_R34_FR0

endif # AT86RF215_MR_OFDM

menuconfig AT86RF215_MR_FSK
    bool "MR-FSK support"
    default y

if AT86RF215_MR_FSK

choice
    bool "Default MR-FSK Symbol Rate"
    default AT86RF215_MR_FSK_SRATE_200K
    help
        Default Symbol Rate of the MR-FSK PHY.

config AT86RF215_MR_FSK_SRATE_50K
    bool "50 KHz"

config AT86RF215_MR_FSK_SRATE_100K
    bool "100 KHz"

config AT86RF215_MR_FSK_SRATE_150K
    bool "150 KHz"

config AT86RF215_MR_FSK_SRATE_200K
    bool "200 KHz"

config AT86RF215_MR_FSK_SRATE_300K
    bool "300 KHz"

config AT86RF215_MR_FSK_SRATE_400K
    bool "400 KHz"

endchoice

config AT86RF215_DEFAULT_MR_FSK_SRATE
    int
    default 0 if AT86RF215_MR_FSK_SRATE_50K
    default 1 if AT86RF215_MR_FSK_SRATE_100K
    default 2 if AT86RF215_MR_FSK_SRATE_150K
    default 3 if AT86RF215_MR_FSK_SRATE_200K
    default 4 if AT86RF215_MR_FSK_SRATE_300K
    default 5 if AT86RF215_MR_FSK_SRATE_400K

config AT86RF215_DEFAULT_MR_FSK_MOD_IDX
    int "Default MR-FSK Modulation Index"
    range 0 128
    default 64
    help
        Default Modulation Index of the MR-FSK PHY as a fraction of 64.
        (32/64 = 0.5; 64/64 = 1 …)

choice
    bool "Default MR-FSK Modulation Order"
    default AT86RF215_MR_FSK_MORD_4

config AT86RF215_MR_FSK_MORD_4
    bool "2-FSK"

config AT86RF215_MR_FSK_MORD_4
    bool "4-FSK"

endchoice

config AT86RF215_DEFAULT_MR_FSK_MORD
    int
    default 0 if AT86RF215_MR_FSK_MORD_4
    default 1 if AT86RF215_MR_FSK_MORD_4

choice
    bool "Default MR-FSK Forward Error Correction Scheme"
    default AT86RF215_MR_FSK_FEC_NONE

config AT86RF215_MR_FSK_FEC_NONE
    bool "No forward error correction"

config AT86RF215_MR_FSK_FEC_NRNS
    bool "Non-recursive and non-systematic code"

config AT86RF215_MR_FSK_FEC_RS
    bool "Recursive and systematic code"

endchoice

config AT86RF215_DEFAULT_MR_FSK_FEC
    int
    default 0 if AT86RF215_MR_FSK_FEC_NONE
    default 1 if AT86RF215_MR_FSK_FEC_NRNS
    default 2 if AT86RF215_MR_FSK_FEC_RS

endif # AT86RF215_MR_FSK

choice
    prompt "Default Modulation"

config AT86RF215_DEFAULT_LEGACY_OQPSK
    bool "legacy O-QPSK"
    depends on AT86RF215_OQPSK
    help
        O-QPSK compatible with IEEE 802.15.4-2003 devices

config AT86RF215_DEFAULT_MR_OQPSK
    bool "MR-O-QPSK"
    depends on AT86RF215_MR_OQPSK
    help
        MR-O-QPSK according to IEEE 802.15.4g

config AT86RF215_DEFAULT_MR_OFDM
    bool "MR-OFDM"
    depends on AT86RF215_MR_OFDM
    help
        MR-O-OFDM according to IEEE 802.15.4g

config AT86RF215_DEFAULT_MR_FSK
    bool "MR-FSK"
    depends on AT86RF215_MR_FSK
    help
        MR-FSK according to IEEE 802.15.4g

endchoice

endmenu # Modulations

config AT86RF215_BATMON_THRESHOLD
    int "Treshold voltage (in mV) of the battery monitor"
    range 1700 3675
    default 1800
    depends on USEMODULE_AT86RF215_BATMON
    help
        If the supply voltage falls below the configured threshold
        a SYS_BUS_POWER_EVENT_LOW_VOLTAGE event is generated on the
        SYS_BUS_POWER bus.

        Battery Monitoring is disabled when the device is in Deep Sleep.

config AT86RF215_USE_CLOCK_OUTPUT
    bool "Enable clock output"
    help
        Enable this to enable the clock output pin of the AT86RF215 chip.
        This way it can be used as a clock source in place of a separate crystal.
        You also have to enable this if you want to measure the clock frequency
        for trimming. After proper trim value is applied this may be disabled
        if not used otherwise.
        By Default it is turned off to save energy.

menuconfig AT86RF215_TRIM_VAL_EN
    bool "Enable crystal oscillator trimming"
    help
        Enable crystal oscillator trimming.

config AT86RF215_TRIM_VAL
    int "Trim value for the crystal oscillator"
    range 0 15
    default 0
    depends on AT86RF215_TRIM_VAL_EN
    help
        Each increment adds 300nF capacitance between the crystal oscillator pins
        TCXO and XTAL2.Tweak the value until the measured clock output matches
        26 MHz the best.
        For more information Refer Table 6-25 TRIM in Datasheet

config AT86RF215_RPC_EN
    bool "Enable Reduced Power Consumption"
    help
        Reduce Power Consumption in RX IDLE by duty-cycling the RF circuitry.

config AT86RF215_MULTIMODE
    bool "Allow multiple physical layer modes"
    default y

config AT86RF215_RESET_PULSE_WIDTH_US
    int "Width of the reset pulse (µs)"
    range 16 1000
    default 16
    help
        If your board design includes a filtering capacitor on the reset line, this raises
        the rise time of the reset pulse.
        To accommodate for this, select a larger reset pulse width here.

        If unsure, leave this at the default value of 16 µs.

endif # USEMODULE_AT86RF215
```
