## drivers/sdp3x/Kconfig
```kconfig
# Copyright (c) 2021 HAW Hamburg
#
# This file is subject to the terms and conditions of the GNU Lesser
# General Public License v2.1. See the file LICENSE in the top level
# directory for more details.
#

menuconfig MODULE_SDP3X
    bool
    prompt "SDP3X temperature and differential pressure sensor" if !(MODULE_SAUL_DEFAULT && HAVE_SDP3X)
    default (MODULE_SAUL_DEFAULT && HAVE_SDP3X)
    depends on HAS_PERIPH_I2C
    depends on TEST_KCONFIG
    select MODULE_PERIPH_I2C
    select MODULE_CHECKSUM
    select MODULE_XTIMER

config MODULE_SDP3X_IRQ
    bool "GPIO interrupt support"
    default HAVE_SDP3X_IRQ
    depends on HAS_PERIPH_GPIO
    depends on HAS_PERIPH_GPIO_IRQ
    depends on MODULE_SDP3X
    select MODULE_PERIPH_GPIO
    select MODULE_PERIPH_GPIO_IRQ

config HAVE_SDP3X
    bool
    help
      Indicates that a SDP3X temperature and differential pressure sensor is present.

config HAVE_SDP3X_IRQ
    bool
    select HAVE_SDP3X
    help
      Indicates that a SDP3X temperature and differential pressure sensor is
      present with the interrupt pin wired.
```

## drivers/sds011/Kconfig
```kconfig
# Copyright (c) 2021 HAW Hamburg
#
# This file is subject to the terms and conditions of the GNU Lesser
# General Public License v2.1. See the file LICENSE in the top level
# directory for more details.
#

config MODULE_SDS011
    bool "SDS011 Laser Dust Sensor"
    depends on HAS_PERIPH_UART
    depends on TEST_KCONFIG
    select MODULE_PERIPH_UART
```

## drivers/seesaw_soil/Kconfig
```kconfig
# SPDX-FileCopyrightText: 2020 Viktor Gal
# SPDX-FileCopyrightText: 2021 HAW Hamburg
# SPDX-License-Identifier: LGPL-2.1-only

menu "SEESAW_SOIL driver"
    depends on USEMODULE_SEESAW_SOIL

config SEESAW_SOIL_I2C_ADDRESS
    hex "I2C default address"
    range 0x36 0x39
    default 0x36
    help
        SEESAW_SOIL allows for up to 4 devices on single bus. The value depends on
        the state of AD1 and AD0 pins.

endmenu # SEESAW_SOIL driver
```

## drivers/sen5x/Kconfig
```kconfig
# Copyright (c) 2023 TU Braunschweig Institut für Betriebssysteme und Rechnerverbund
#
# This file is subject to the terms and conditions of the GNU Lesser
# General Public License v2.1. See the file LICENSE in the top level
# directory for more details.

config MODULE_SEN5X
    bool "Sensirion Embedded I2C SEN5x Driver"
    depends on TEST_KCONFIG
    select PACKAGE_DRIVER_SEN5X
    select MODULE_PERIPH_I2C
    select MODULE_ZTIMER
```

## drivers/servo/Kconfig
```kconfig
# Copyright (c) 2021 HAW Hamburg
#
# This file is subject to the terms and conditions of the GNU Lesser
# General Public License v2.1. See the file LICENSE in the top level
# directory for more details.
#

config MODULE_SERVO
    bool "Servo motor driver"
    depends on TEST_KCONFIG
    select MODULE_SERVO_SAUL if MODULE_SAUL_DEFAULT

config MODULE_SERVO_SAUL
    bool "SAUL integration of the servo motor driver"
    depends on TEST_KCONFIG

choice SERVO_DRIVER_BACKEND
    bool "Servo motor driver backend"
    depends on MODULE_SERVO
    default MODULE_SERVO_PWM if HAS_PERIPH_PWM
    default MODULE_SERVO_TIMER if !HAS_PERIPH_PWM && HAS_PERIPH_TIMER_PERIODIC

config MODULE_SERVO_PWM
    bool "periph_pwm based Servo Motor driver backend (preferred)"
    depends on HAS_PERIPH_PWM
    # PWM prescaler on nRF5x MCUs cannot generate a 50 Hz signal
    depends on !HAS_CPU_NRF51
    depends on !HAS_CPU_NRF52
    depends on !HAS_CPU_NRF53
    depends on !HAS_CPU_NRF9160
    select MODULE_PERIPH_PWM
    select SERVO_DRIVER_BACKEND

config MODULE_SERVO_TIMER
    bool "periph_timer based Servo Motor driver backend"
    depends on HAS_PERIPH_TIMER
    depends on HAS_PERIPH_TIMER_PERIODIC
    select MODULE_PERIPH_TIMER
    select MODULE_PERIPH_TIMER_PERIODIC
    select SERVO_DRIVER_BACKEND
endchoice
```

## drivers/sgp30/Kconfig
```kconfig
# Copyright (c) 2021 Inria
#
# This file is subject to the terms and conditions of the GNU Lesser
# General Public License v2.1. See the file LICENSE in the top level
# directory for more details.
#

config MODULE_SGP30
    bool "SGP30 Particulate Matter Sensor"
    depends on HAS_PERIPH_I2C
    depends on TEST_KCONFIG
    select MODULE_CHECKSUM
    select MODULE_PERIPH_I2C
    select MODULE_ZTIMER
    select MODULE_ZTIMER_PERIPH_TIMER
    select ZTIMER_USEC

config MODULE_SGP30_STRICT
    bool "Strict reading period"
    depends on MODULE_SGP30
    default y
    help
        If this module is enabled regular measurements will be performed
        every second and no values will be returned before the 15s warmup
        period, see the datasheet for more.
```

## drivers/sht1x/Kconfig
```kconfig
# Copyright (c) 2021 HAW Hamburg
#
# This file is subject to the terms and conditions of the GNU Lesser
# General Public License v2.1. See the file LICENSE in the top level
# directory for more details.
#

menuconfig MODULE_SHT1X
    bool
    prompt "SHT10/SHT11/SHT15 Humidity and Temperature Sensor" if !(HAVE_SHT1X && MODULE_SAUL_DEFAULT)
    default y if HAVE_SHT1X && MODULE_SAUL_DEFAULT
    depends on HAS_PERIPH_GPIO
    depends on TEST_KCONFIG
    select MODULE_PERIPH_GPIO
    select MODULE_XTIMER

choice
    bool "Select sensor variant"
    depends on MODULE_SHT1X
    default MODULE_SHT10 if HAVE_SHT10
    default MODULE_SHT11 if HAVE_SHT11
    default MODULE_SHT15 if HAVE_SHT15

config MODULE_SHT10
    bool "SHT10"

config MODULE_SHT11
    bool "SHT11"

config MODULE_SHT15
    bool "SHT15"

endchoice

config HAVE_SHT10
    bool
    select HAVE_SHT1X
    help
      Indicates that an sht10 humidity and temperature sensor is present.

config HAVE_SHT11
    bool
    select HAVE_SHT1X
    help
      Indicates that an sht11 humidity and temperature sensor is present.

config HAVE_SHT15
    bool
    select HAVE_SHT1X
    help
      Indicates that an sht15 humidity and temperature sensor is present.

config HAVE_SHT1X
    bool
    help
      Indicates that an sht1x humidity and temperature sensor is present.
```

## drivers/sht2x/Kconfig
```kconfig
# Copyright (c) 2021 HAW Hamburg
#
# This file is subject to the terms and conditions of the GNU Lesser
# General Public License v2.1. See the file LICENSE in the top level
# directory for more details.
#

if USEMODULE_SHT2X

choice
    bool "Measurement Resolution"
    default SHT2X_RES_12_14BIT

    config SHT2X_RES_12_14BIT
        bool "Humidity with 12 bit, Temperature with 14 bit"
    config SHT2X_RES_11_11BIT
        bool "Humidity with 11 bit, Temperature with 11 bit"
    config SHT2X_RES_10_13BIT
        bool "Humidity with 10 bit, Temperature with 13 bit"
    config SHT2X_RES_8_12BIT
        bool "Humidity with 8 bit, Temperature with 12 bit"
    help
        Measurement resolution
endchoice

choice
    bool "Measurement Mode"
    default SHT2X_MEASURE_MODE_NO_HOLD

    config SHT2X_MEASURE_MODE_NO_HOLD
        bool "No Hold"
        help
            In Hold mode the measurement is started and the sensor blocks the
            master by clock stretching until the measurement is finished. Thus,
            in this mode, both the I2C bus and the processor are blocked for the
            entire measurement duration, which can be up to 85 ms for temperature
            measurement and up to 29 ms for humidity measurement, depending on the
            resolution. Therefore, the no-hold mode should be used, where the
            measurement is started and a timer is used to fetch the results.
            This way neither the I2C bus nor the processor are blocked for the
            duration of the measurement. Furthermore, the hold mode requires that
            the MCU supports clock stretching.
    config SHT2X_MEASURE_MODE_HOLD
        bool "Hold"
        help
            In no-hold mode the measurement is started and a timer is used to
            fetch the results. This way neither the I2C bus nor the processor
            are blocked for the duration of the measurement.
endchoice

config SHT2X_CRC_MODE
    bool "CRC check"
    help
        Enable to check the CRC of measurement data.

endif # USEMODULE_SHT2X
```

## drivers/sht3x/Kconfig
```kconfig
# Copyright (c) 2021 HAW Hamburg
#
# This file is subject to the terms and conditions of the GNU Lesser
# General Public License v2.1. See the file LICENSE in the top level
# directory for more details.
#

config MODULE_SHT3X
    bool "Sensirion SHT30/SHT31/SHT35 Humidity and Temperature Sensors"
    depends on HAS_PERIPH_I2C
    depends on TEST_KCONFIG
    select MODULE_PERIPH_I2C
    select MODULE_CHECKSUM
    select MODULE_XTIMER
```

## drivers/shtcx/Kconfig
```kconfig
# Copyright (c) 2021 HAW Hamburg
#
# This file is subject to the terms and conditions of the GNU Lesser
# General Public License v2.1. See the file LICENSE in the top level
# directory for more details.
#

menuconfig MODULE_SHTCX
    bool
    prompt "SHTCX Temperature and humidity sensors" if !(MODULE_SAUL_DEFAULT && HAVE_SHTCX)
    default y if (MODULE_SAUL_DEFAULT && HAVE_SHTCX)
    depends on HAS_PERIPH_I2C
    depends on TEST_KCONFIG
    select MODULE_PERIPH_I2C
    select MODULE_CHECKSUM
    help
        Device driver for the Sensirion SHTCX Temperature and Humidity sensor family
        (SHTC1/SHTC3). Select a model.

if MODULE_SHTCX

choice
    bool "sensor variant"
    default MODULE_SHTC1 if HAVE_SHTC1
    default MODULE_SHTC3 if HAVE_SHTC3
    help
        Device driver for the SHTCX pressure sensor family
        (SHTC1/SHTC3). Select a model.

config MODULE_SHTC1
    bool "SHTC1"

config MODULE_SHTC3
    bool "SHTC3"

endchoice

endif # MODULE_SHTCX

menuconfig KCONFIG_USEMODULE_SHTCX
    bool "Configure SHTCX driver"
    depends on USEMODULE_SHTCX
    help
        Configure the SHTCX driver using Kconfig.

config HAVE_SHTCX
    bool

config HAVE_SHTC1
    bool
    select HAVE_SHTCX
    help
        Indicates that an SHTC1 sensor is present.

config HAVE_SHTC3
    bool
    select HAVE_SHTCX
    help
        Indicates that an SHTC3 sensor is present.
```
