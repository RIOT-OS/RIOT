## drivers/periph_common/Kconfig.vbat
```kconfig
# SPDX-FileCopyrightText: 2022 Otto-von-Guericke-Universität Magdeburg
# SPDX-License-Identifier: LGPL-2.1-only

menu "PERIPH_VBAT backup battery monitoring peripheral driver"
    depends on USEMODULE_PERIPH_VBAT

config VBAT_ADC_VREF_MV
    int "ADC reference voltage in mV"
    default 3300
    help
        This is the reference voltage (VREF) of the ADC.
        Often VREF is connected with VDDA, which is equal to VDD.

endmenu # PERIPH_VBAT backup battery monitoring peripheral driver
```

## drivers/periph_common/Kconfig.wdt
```kconfig
# SPDX-FileCopyrightText: 2020 HAW Hamburg
# SPDX-License-Identifier: LGPL-2.1-only

config WDT_WARNING_PERIOD
    int "Warning period (in ms)"
    depends on USEMODULE_PERIPH_WDT_WARNING_PERIOD
    help
        Period in ms before reboot where wdt_cb() is executed.
```

## drivers/ph_oem/Kconfig
```kconfig
# Copyright (c) 2021 HAW Hamburg
#
# This file is subject to the terms and conditions of the GNU Lesser
# General Public License v2.1. See the file LICENSE in the top level
# directory for more details.
#

config MODULE_PH_OEM
    bool "Atlas Scientific pH OEM sensor"
    depends on HAS_PERIPH_GPIO
    depends on HAS_PERIPH_GPIO_IRQ
    depends on HAS_PERIPH_I2C
    depends on TEST_KCONFIG
    select MODULE_PERIPH_GPIO
    select MODULE_PERIPH_GPIO_IRQ
    select MODULE_PERIPH_I2C
    select MODULE_XTIMER
```

## drivers/pir/Kconfig
```kconfig
# Copyright (c) 2021 HAW Hamburg
#
# This file is subject to the terms and conditions of the GNU Lesser
# General Public License v2.1. See the file LICENSE in the top level
# directory for more details.
#

config MODULE_PIR
    bool "PIR Motion Sensor"
    depends on HAS_PERIPH_GPIO
    depends on HAS_PERIPH_GPIO_IRQ
    depends on TEST_KCONFIG
    select MODULE_PERIPH_GPIO
    select MODULE_PERIPH_GPIO_IRQ
    select MODULE_XTIMER

config HAVE_PIR
    bool
    select MODULE_PIR if MODULE_SAUL_DEFAULT
    help
        Indicates that a pir motion sensor is present.
```

## drivers/pms5003/Kconfig
```kconfig
# Copyright (c) 2021 Inria
#
# This file is subject to the terms and conditions of the GNU Lesser
# General Public License v2.1. See the file LICENSE in the top level
# directory for more details.
#

config MODULE_PMS5003
    bool "PMS5003 Particulate Matter Sensor"
    depends on HAS_PERIPH_UART
    depends on HAS_PERIPH_GPIO
    depends on TEST_KCONFIG
    select MODULE_CHECKSUM
    select MODULE_PERIPH_UART
    select MODULE_PERIPH_GPIO
    select MODULE_ZTIMER
    select MODULE_ZTIMER_PERIPH_TIMER
    select MODULE_ZTIMER_USEC

menuconfig KCONFIG_USEMODULE_PMS5003
    bool "Configure PMS5003 driver"
    depends on USEMODULE_PMS5003
    help
        Configure the PMS5003 driver using Kconfig.

if KCONFIG_USEMODULE_PMS5003

config PMS5003_INDOOR_ENVIRONMENT
    bool "Indoor environment calibration"
    default 500
    help
        The PMS5003 sensor outputs two set of PM* values, one calibrated for indoor
        environment and another one for atmospheric environment, set this value
        according to your deployment.
endif # KCONFIG_USEMODULE_PMS5003
```

## drivers/pn532/Kconfig
```kconfig
# SPDX-FileCopyrightText: 2020 Freie Universitaet Berlin
# SPDX-FileCopyrightText: 2021 HAW Hamburg
# SPDX-License-Identifier: LGPL-2.1-only

menu "PN532 driver"
    depends on USEMODULE_PN532

config PN532_BUFFER_LEN
    int "Internal buffer size"
    default 64
    help
        The internal buffer is used while reading and writing to PN532 Device.
        For large NDEF files, the buffer size may be increased.
        Otherwise the files may be written in chunks.

endmenu # PN532 driver
```

## drivers/qma6100p/Kconfig
```kconfig
# SPDX-FileCopyrightText: 2026 Baptiste Le Duc <baptiste.leduc@etik.com>
# SPDX-FileCopyrightText: 2026 Léandre Le Duc <leandre.leduc38@gmail.com>
# SPDX-License-Identifier: LGPL-2.1-only

menu "QMA6100P driver"
    depends on USEMODULE_QMA6100P

config QMA6100P_I2C_ADDR
    hex "Default I2C address"
    range 0x12 0x13
    default 0x12
    help
        QMA6100P I2C address depends on the state of the AD0 pin.
        Default value (0x12) corresponds to AD0 connected to GND.
        Use 0x13 when AD0 is connected to VDD.

choice
    bool "Output data rate"
    default QMA6100P_ODR_100HZ
    help
        Select the output data rate (ODR).
config QMA6100P_ODR_100HZ
    bool "100 Hz"
config QMA6100P_ODR_200HZ
    bool "200 Hz"
config QMA6100P_ODR_400HZ
    bool "400 Hz"
config QMA6100P_ODR_800HZ
    bool "800 Hz"
config QMA6100P_ODR_1600HZ
    bool "1600 Hz"
config QMA6100P_ODR_50HZ
    bool "50 Hz"
config QMA6100P_ODR_25HZ
    bool "25 Hz"
config QMA6100P_ODR_12HZ5
    bool "12.5 Hz"
endchoice

choice
    bool "Full-scale range"
    default QMA6100P_RANGE_2G
    help
        Select the full-scale measurement range. Higher range reduces
        sensitivity (LSB/g).
config QMA6100P_RANGE_2G
    bool "±2g (4096 LSB/g)"
config QMA6100P_RANGE_4G
    bool "±4g (2048 LSB/g)"
config QMA6100P_RANGE_8G
    bool "±8g (1024 LSB/g)"
config QMA6100P_RANGE_16G
    bool "±16g (512 LSB/g)"
config QMA6100P_RANGE_32G
    bool "±32g (256 LSB/g)"
endchoice

choice
    bool "Master clock frequency"
    default QMA6100P_PM_MCLK_51K2
    help
        Select the internal master clock frequency. Affects the achievable
        output data rates. Assumes MCLK=51.2kHz (default
        after init sequence).
config QMA6100P_PM_MCLK_51K2
    bool "51.2 kHz (default)"
config QMA6100P_PM_MCLK_25K6
    bool "25.6 kHz"
config QMA6100P_PM_MCLK_12K8
    bool "12.8 kHz"
config QMA6100P_PM_MCLK_6K4
    bool "6.4 kHz"
endchoice

choice
    bool "Operating mode"
    default QMA6100P_MODE_ACTIVE
    help
        Select the default operating mode after initialization.
config QMA6100P_MODE_ACTIVE
    bool "Active"
config QMA6100P_MODE_ULPS
    bool "Ultra-Low Power State (ULPS)"
endchoice

choice
    bool "Interrupt pin active level"
    default QMA6100P_INTPIN_ACTIVE_HIGH
    help
        Select the active level of the INT pin (INTPIN_CONF register).
config QMA6100P_INTPIN_ACTIVE_HIGH
    bool "Active high"
config QMA6100P_INTPIN_ACTIVE_LOW
    bool "Active low"
endchoice

choice
    bool "Interrupt pin output mode"
    default QMA6100P_INTPIN_PUSH_PULL
    help
        Select the output driver mode of the INT pin.
config QMA6100P_INTPIN_PUSH_PULL
    bool "Push-pull"
config QMA6100P_INTPIN_OPEN_DRAIN
    bool "Open-drain"
endchoice

choice
    bool "Interrupt latch mode"
    default QMA6100P_INT_CFG_NON_LATCH
    help
        Non-latching: INT pulse clears automatically.
        Latching: INT is held until acknowledged via qma6100p_ack_int().
config QMA6100P_INT_CFG_NON_LATCH
    bool "Non-latching (auto-cleared)"
config QMA6100P_INT_CFG_LATCH
    bool "Latching (held until acknowledged)"
endchoice

choice
    bool "Interrupt clear behavior"
    default QMA6100P_INT_CFG_CLR_ON_ANY_READ
    help
        Select when INT_STATUS bits are cleared.
config QMA6100P_INT_CFG_CLR_ON_ANY_READ
    bool "Clear on any register read"
config QMA6100P_INT_CFG_CLR_ON_LATCH
    bool "Clear only when latched"
endchoice

choice
    bool "Acceleration data shadow mode"
    default QMA6100P_INT_CFG_SHADOW_DIS
    help
        When enabled, high and low bytes of each axis are frozen together
        until both are read, preventing torn reads.
config QMA6100P_INT_CFG_SHADOW_DIS
    bool "Shadow disabled"
config QMA6100P_INT_CFG_SHADOW_EN
    bool "Shadow enabled"
endchoice

choice
    bool "QMA6100P interrupt output pin"
    default QMA6100P_INT1
    help
        Select which QMA6100P interrupt output pin is routed to the MCU GPIO.
config QMA6100P_INT1
    bool "INT1"
config QMA6100P_INT2
    bool "INT2"
endchoice

endmenu # QMA6100P driver
```

## drivers/qmc5883l/Kconfig
```kconfig
# Copyright (c) 2021 HAW Hamburg
#
# This file is subject to the terms and conditions of the GNU Lesser
# General Public License v2.1. See the file LICENSE in the top level
# directory for more details.
#

menuconfig MODULE_QMC5883L
    bool
    prompt "QMC5883L 3-Axis Digital Magnetic sensor" if !(MODULE_SAUL_DEFAULT && HAVE_QMC5883L)
    default (MODULE_SAUL_DEFAULT && HAVE_QMC5883L)
    depends on HAS_PERIPH_I2C
    depends on TEST_KCONFIG
    select MODULE_PERIPH_I2C

config MODULE_QMC5883L_INT
    bool "Interrupt support"
    default HAVE_QMC5883L_INT
    depends on HAS_PERIPH_GPIO
    depends on HAS_PERIPH_GPIO_IRQ
    depends on MODULE_QMC5883L
    select MODULE_PERIPH_GPIO
    select MODULE_PERIPH_GPIO_IRQ

config HAVE_QMC5883L
    bool
    help
      Indicates that a QMC5883L 3-Axis Digital Magnetic sensor is present.

config HAVE_QMC5883L_INT
    bool
    select HAVE_QMC5883L
    help
      Indicates that a QMC5883L 3-Axis Digital Magnetic sensor is present with
      the interrupt wired.
```

## drivers/qmi8658/Kconfig
```kconfig
# SPDX-FileCopyrightText: 2026 Technische Universität Hamburg
# SPDX-License-Identifier: LGPL-2.1-only

menu "QMI8658 driver"
    depends on USEMODULE_QMI8658

config QMI8658_PARAM_I2C
    hex "Default I2C address"
    range 0x6A 0x6B
    default 0x6B
    help
        The address value depends on the state of SDO/SA0 pin.
        SDO/SA0 low: 0x6B
        SDO/SA0 high: 0x6A

endmenu # QMI8658 driver
```

## drivers/rn2xx3/Kconfig
```kconfig
# SPDX-FileCopyrightText: 2020 Freie Universitaet Berlin
# SPDX-License-Identifier: LGPL-2.1-only

if USEMODULE_RN2XX3

menu "RN2XX3 driver configuration"

config RN2XX3_DEFAULT_SLEEP
    int "Sleep duration in milliseconds [ms]"
    range 100 $(UINT32_MAX)
    default 5000
    help
        Set the sleep duration (in ms).
        The value should be greater than RN2XX3_SLEEP_MIN (100 ms)

config RN2XX3_DEFAULT_AR
    bool "Enable automatic reply"
    help
        Enable/disable Automatic Reply (AR) for rn2xx3 module. By enabling the
        automatic reply, the module will transmit a packet without a payload
        immediately after a confirmed downlink is received, or when the
        Frame Pending bit has been set by the server. Refer RN2483 LoRa™
        Technology Module Command Reference User’s Guide for more information.

endmenu # RN2XX3 driver configuration

endif # USEMODULE_RN2XX3
```

## drivers/rtt_rtc/Kconfig
```kconfig
# Copyright (c) 2021 HAW Hamburg
#
# This file is subject to the terms and conditions of the GNU Lesser
# General Public License v2.1. See the file LICENSE in the top level
# directory for more details.
#

menuconfig MODULE_RTT_RTC
    bool "RTC-based RTT"
    depends on HAS_PERIPH_RTT
    depends on TEST_KCONFIG
    select MODULE_PERIPH_RTT
    select MODULE_RTC_UTILS
    help
        Basic RTC implementation based on a RTT.

config RTT_RTC_NO_RETAIN
    bool "Don't try to retain time across reboots"
    depends on MODULE_RTT_RTC
    help
        Don't try to keep the time across reboots but start from 0 again.
```

## drivers/saul/Kconfig
```kconfig
# Copyright (c) 2020 HAW Hamburg
#
# This file is subject to the terms and conditions of the GNU Lesser
# General Public License v2.1. See the file LICENSE in the top level
# directory for more details.
#

menuconfig MODULE_SAUL
    bool "[S]ensor [A]ctuator [U]ber [L]ayer"
    select MODULE_PHYDAT
    depends on TEST_KCONFIG
    help
        SAUL is a generic actuator/sensor interface in RIOT. Its purpose is to
        enable unified interaction with a wide range of sensors and actuators
        through a set of defined access functions and a common data structure.

if MODULE_SAUL

config MODULE_SAUL_DEFAULT
    bool "Enable the default sensors and actuators of the platform"
    depends on MODULE_SAUL_REG

config MODULE_SAUL_ADC
    bool "SAUL wrapper for direct access to analog pins"
    depends on HAS_PERIPH_ADC
    select MODULE_PERIPH_ADC

config MODULE_SAUL_GPIO
    bool "SAUL wrapper for direct access to GPIO pins"
    depends on HAS_PERIPH_GPIO
    select MODULE_PERIPH_GPIO

config MODULE_SAUL_PWM
    bool "SAUL wrapper PWM enabled GPIO pins"
    depends on HAS_PERIPH_PWM
    select MODULE_PERIPH_PWM

config MODULE_SAUL_NRF_TEMPERATURE
    bool "SAUL wrapper for direct access to the temperature peripheral"
    depends on HAS_PERIPH_TEMPERATURE
    select MODULE_PERIPH_TEMPERATURE

config MODULE_AUTO_INIT_SAUL
    bool "Auto initialize the SAUL subsystem"
    depends on MODULE_AUTO_INIT
    select MODULE_SAUL_INIT_DEVS
    default y

config MODULE_SAUL_INIT_DEVS
    bool

endif # MODULE_SAUL

config HAVE_SAUL_ADC
    bool
    select MODULE_SAUL_ADC if MODULE_SAUL_DEFAULT
    help
        Indicates that configuration for ADC access via SAUL is available.

config HAVE_SAUL_GPIO
    bool
    select MODULE_SAUL_GPIO if MODULE_SAUL_DEFAULT
    help
        Indicates that configuration for GPIO access via SAUL is available.

config HAVE_SAUL_PWM
    bool
    select MODULE_SAUL_PWM if MODULE_SAUL_DEFAULT
    help
        Indicates that configuration for PWM access via SAUL is available.
```

## drivers/scd30/Kconfig
```kconfig
# Copyright (c) 2021 HAW Hamburg
#
# This file is subject to the terms and conditions of the GNU Lesser
# General Public License v2.1. See the file LICENSE in the top level
# directory for more details.
#

config MODULE_SCD30
    bool "SCD30 CO2, temperature and humidity sensor"
    depends on HAS_PERIPH_I2C
    depends on TEST_KCONFIG
    select MODULE_PERIPH_I2C
    select MODULE_CHECKSUM
    select MODULE_XTIMER

config HAVE_SCD30
    bool
    select MODULE_SCD30 if MODULE_SAUL_DEFAULT
    help
      Indicates that a SCD30 CO2, temperature and humidity sensor is present.
```

## drivers/sdcard_spi/Kconfig
```kconfig
# Copyright (c) 2020 HAW Hamburg
#
# This file is subject to the terms and conditions of the GNU Lesser
# General Public License v2.1. See the file LICENSE in the top level
# directory for more details.
#

config MODULE_SDCARD_SPI
    bool "SPI SD-Card"
    depends on HAS_PERIPH_GPIO
    depends on HAS_PERIPH_SPI
    depends on TEST_KCONFIG
    select MODULE_PERIPH_GPIO
    select MODULE_PERIPH_SPI
    select MODULE_PERIPH_SPI_RECONFIGURE if HAS_PERIPH_SPI_RECONFIGURE
    select MODULE_CHECKSUM
    select ZTIMER_USEC
```

## drivers/sdmmc/Kconfig
```kconfig
# Copyright (c) 2020 HAW Hamburg
#
# This file is subject to the terms and conditions of the GNU Lesser
# General Public License v2.1. See the file LICENSE in the top level
# directory for more details.
#

config MODULE_SDMMC
    bool "SDIO/SD/MMC interface"
    depends on HAS_PERIPH_SDMMC
    select MODULE_PERIPH_SDMMC
    select MODULE_ZTIMER_MSEC if !ZTIMER_USEC

if MODULE_SDMMC

config MODULE_SDMMC_MMC
    bool "MMC support"
    depends on HAS_PERIPH_SDMMC_MMC
    help
        Say y to support MMCs/eMMCs.

config MODULE_SDMMC_SDHC
    bool
    depends on HAS_PERIPH_SDMMC_SDHC
    default y
    help
        SDHC driver is used as low-level SDIO/SD/MMC implementation for
        peripherals that are compliant with SD Host Controller Simplified
        Specification, Version 3.00.

endif # MODULE_SDMMC
```
