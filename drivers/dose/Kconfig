## drivers/dose/Kconfig
```kconfig
# SPDX-FileCopyrightText: 2020 Freie Universitaet Berlin
# SPDX-License-Identifier: LGPL-2.1-only

menu "DOSE driver"
    depends on USEMODULE_DOSE

config DOSE_TIMEOUT_BYTES
    int "Transaction timeout in bytes"
    default 50
    help
        Timeout, in bytes at the set baudrate, to bring the driver back into idle state if
        the remote side died within a transaction.

endmenu # DOSE driver
```

## drivers/ds18/Kconfig
```kconfig
# Copyright (c) 2020 HAW Hamburg
#
# This file is subject to the terms and conditions of the GNU Lesser
# General Public License v2.1. See the file LICENSE in the top level
# directory for more details.
#

menuconfig MODULE_DS18
    bool "DS18 temperature sensors"
    depends on HAS_PERIPH_GPIO
    depends on TEST_KCONFIG
    select MODULE_PERIPH_GPIO
    select MODULE_XTIMER

config MODULE_DS18_OPTIMIZED
    bool "Optimized mode"
    depends on MODULE_DS18
    help
        Say y to use the optimized mode if the board can handle ~3us resolution
        with the xtimer.
```

## drivers/ds3234/Kconfig
```kconfig
# Copyright (c) 2020 HAW Hamburg
#
# This file is subject to the terms and conditions of the GNU Lesser
# General Public License v2.1. See the file LICENSE in the top level
# directory for more details.
#

config MODULE_DS3234
    bool "DS3234 Extremely Accurate SPI RTC"
    depends on HAS_PERIPH_SPI
    depends on TEST_KCONFIG
    select MODULE_PERIPH_SPI
```

## drivers/ds75lx/Kconfig
```kconfig
# Copyright (c) 2020 HAW Hamburg
#
# This file is subject to the terms and conditions of the GNU Lesser
# General Public License v2.1. See the file LICENSE in the top level
# directory for more details.
#

config MODULE_DS75LX
    bool "Maxim DS75LX temperature sensor"
    depends on HAS_PERIPH_I2C
    depends on TEST_KCONFIG
    select MODULE_PERIPH_I2C
    select MODULE_XTIMER
```

## drivers/dsp0401/Kconfig
```kconfig
# Copyright (c) 2020 HAW Hamburg
#
# This file is subject to the terms and conditions of the GNU Lesser
# General Public License v2.1. See the file LICENSE in the top level
# directory for more details.
#

config MODULE_DSP0401
    bool "DSP0401 alphanumeric display"
    depends on HAS_PERIPH_GPIO
    depends on HAS_PERIPH_PWM
    depends on TEST_KCONFIG
    select MODULE_PERIPH_GPIO
    select MODULE_PERIPH_PWM
    select MODULE_ZTIMER
    select ZTIMER_USEC
```

## drivers/dwax509m183x0/Kconfig
```kconfig
# Copyright (c) 2024 HAW Hamburg
#
# This file is subject to the terms and conditions of the GNU Lesser
# General Public License v2.1. See the file LICENSE in the top level
# directory for more details.

config MODULE_DWAX509M183X0
    bool "dwax509m183x0"
    depends on TEST_KCONFIG
    depends on HAS_PERIPH_ADC
    select MODULE_PERIPH_ADC
```

## drivers/edbg_eui/Kconfig
```kconfig
# Copyright (c) 2020 HAW Hamburg
#
# This file is subject to the terms and conditions of the GNU Lesser
# General Public License v2.1. See the file LICENSE in the top level
# directory for more details.
#

config MODULE_EDBG_EUI
    bool "Atmel Embedded Debugger EUI"
    depends on HAS_PERIPH_I2C
    depends on TEST_KCONFIG
    select MODULE_PERIPH_I2C
    default y if MODULE_EUI_PROVIDER && HAVE_EDBG_EUI
    help
        Driver for getting a unique ID from the Atmel Embedded Debugger.

config HAVE_EDBG_EUI
    bool
    help
        Indicates that the Atmel Embedded Debugeger EUI is available on the
        platform.
```

## drivers/enc28j60/Kconfig
```kconfig
# Copyright (c) 2022 HAW Hamburg
#
# This file is subject to the terms and conditions of the GNU Lesser
# General Public License v2.1. See the file LICENSE in the top level
# directory for more details.
#

config MODULE_ENC28J60
    bool "ENC28J60 Ethernet Adapter"
    depends on TEST_KCONFIG
    depends on HAS_PERIPH_GPIO
    depends on HAS_PERIPH_GPIO_IRQ
    depends on HAS_PERIPH_SPI
    select MODULE_NETDEV_ETH
    select MODULE_NETDEV_LEGACY_API
    select MODULE_PERIPH_EUI_PROVIDER
    select MODULE_PERIPH_GPIO
    select MODULE_PERIPH_GPIO_IRQ
    select MODULE_PERIPH_SPI
    select MODULE_XTIMER

config HAVE_ENC28J60
    bool
    select MODULE_ENC28J60 if MODULE_NETDEV_DEFAULT
    help
        Indicates that a ENC28J60 ethernet adapter is present.
```

## drivers/encx24j600/Kconfig
```kconfig
# Copyright (c) 2022 HAW Hamburg
#
# This file is subject to the terms and conditions of the GNU Lesser
# General Public License v2.1. See the file LICENSE in the top level
# directory for more details.
#

config MODULE_ENCX24J600
    bool "ENCX24J600 Ethernet Adapter"
    depends on TEST_KCONFIG
    depends on HAS_PERIPH_GPIO
    depends on HAS_PERIPH_GPIO_IRQ
    depends on HAS_PERIPH_SPI
    select MODULE_NETDEV_ETH
    select MODULE_NETDEV_LEGACY_API
    select MODULE_PERIPH_GPIO
    select MODULE_PERIPH_GPIO_IRQ
    select MODULE_PERIPH_SPI
    select MODULE_XTIMER

config HAVE_ENCX24J600
    bool
    select MODULE_ENCX24J600 if MODULE_NETDEV_DEFAULT
    help
        Indicates that a ENCX24J600 ethernet adapter is present.
```

## drivers/ethos/Kconfig
```kconfig
# Copyright (c) 2022 HAW Hamburg
#
# This file is subject to the terms and conditions of the GNU Lesser
# General Public License v2.1. See the file LICENSE in the top level
# directory for more details.
#

config MODULE_ETHOS
    bool "Ethernet-over-serial (ETHOS)"
    depends on TEST_KCONFIG
    depends on HAS_PERIPH_UART
    select MODULE_IOLIST
    select MODULE_NETDEV_ETH
    select MODULE_NETDEV_LEGACY_API
    select MODULE_PERIPH_UART
    select MODULE_RANDOM
    select MODULE_TSRB

config MODULE_ETHOS_STDIO
    bool
    select MODULE_ISRPIPE
    depends on MODULE_ETHOS
```

## drivers/ft5x06/Kconfig
```kconfig
# Copyright (c) 2021 Inria
#
# This file is subject to the terms and conditions of the GNU Lesser
# General Public License v2.1. See the file LICENSE in the top level
# directory for more details.

config MODULE_FT5X06
    bool "FT5X06 touch panel driver"
    depends on TEST_KCONFIG
    depends on HAS_PERIPH_GPIO_IRQ
    depends on HAS_PERIPH_I2C
    select MODULE_PERIPH_GPIO_IRQ
    select MODULE_PERIPH_I2C
    select MODULE_ZTIMER
    select MODULE_ZTIMER_MSEC
    help
      This driver is compatible with the following controllers: ft5x06, ft5606, ft5x16, ft6x06,
      ft6x36, ft5x06i, ft5336, ft3316, ft5436i, ft5336i and ft5x46.

config HAVE_FT5X06
    bool
    select MODULE_FT5X06 if MODULE_TOUCH_DEV
    help
      Indicates that an FT5X06 touch panel is present.
```

## drivers/fxos8700/Kconfig
```kconfig
# SPDX-FileCopyrightText: 2020 Freie Universitaet Berlin
# SPDX-FileCopyrightText: 2020 HAW Hamburg
# SPDX-License-Identifier: LGPL-2.1-only

menu "FXOS8700 driver"
    depends on USEMODULE_FXOS8700

config FXOS8700_USE_ACC_RAW_VALUES
    bool "Enable raw ADC readings"
    help
        Enable this to return raw ADC readings.
        By default measurements are converted to mg.

endmenu # FXOS8700 driver
```

## drivers/gc9a01/Kconfig
```kconfig
# SPDX-FileCopyrightText: 2026 Technische Universität Hamburg
# SPDX-License-Identifier: LGPL-2.1-only

menu "GC9A01 driver"
    depends on USEMODULE_GC9A01

config GC9A01_VREG1A
    int "VREG1A voltage level (in millivolts)"
    default 5340
    range 4800 7340
    help
        Configure VREG1A level, which is the highest positive grayscale reference voltage.
        VREG1A should be between 4.8 V and 7.34 V .

config GC9A01_VREG2A
    int "VREG2A voltage level (in millivolts)"
    default -3980
    range -4200 -1660
    help
        Configure VREG2A level, which is the lowest negative grayscale reference voltage.
        VREG2A should be between -4.2 V and -1.66 V .

endmenu # GC9A01 driver
```

## drivers/gp2y10xx/Kconfig
```kconfig
# SPDX-FileCopyrightText: 2020 Locha Inc
# SPDX-License-Identifier: LGPL-2.1-only

menu "GP2Y10xx driver"
    depends on USEMODULE_GP2Y10XX

config GP2Y10XX_MAX_READINGS
    int "Numbers of readings to use for average ADC value"
    default 10
    help
        This configures the maximum number of ADC readings to calculate
        the average ADC value.

endmenu # GP2Y10xx driver
```

## drivers/grove_ledbar/Kconfig
```kconfig
# Copyright (c) 2020 HAW Hamburg
#
# This file is subject to the terms and conditions of the GNU Lesser
# General Public License v2.1. See the file LICENSE in the top level
# directory for more details.
#

config MODULE_GROVE_LEDBAR
    bool "Grove ledbar"
    depends on HAS_PERIPH_GPIO
    depends on TEST_KCONFIG
    select MODULE_PERIPH_GPIO
    select MODULE_MY9221

config HAVE_GROVE_LEDBAR
    bool
    select MODULE_GROVE_LEDBAR if MODULE_SAUL_DEFAULT
    help
        Indicates that a Grove ledbar is present.
```

## drivers/hall_effect/Kconfig
```kconfig
# SPDX-FileCopyrightText: 2025 TU Dresden
# SPDX-License-Identifier: LGPL-2.1-only

config MODULE_HALL_EFFECT
    bool "Hall Effect RPM Sensor"
    depends on TEST_KCONFIG


menu "Hall Effect RPM Driver"
    depends on USEMODULE_HALL_EFFECT

    config HALL_EFFECT_GEAR_RED_RATIO
        int "gear reduction ratio (in tenths)"
        default 204
        help
            Defines the gear reduction ratio. For example a gear reduction ratio
            of 1:20.4 would result in a value of 204.

    config HALL_EFFECT_PPR
        int "Pulses per revolution"
        default 13
        help
            Number of high flanks per revolution.

endmenu # Hall Effect Driver
```

## drivers/hcsr04/Kconfig
```kconfig
# Copyright (c) 2021 AUTH
#
# This file is subject to the terms and conditions of the GNU Lesser
# General Public License v2.1. See the file LICENSE in the top level
# directory for more details.

config MODULE_HCSR04
    bool "HC-SR04"
    depends on TEST_KCONFIG
```

## drivers/hd44780/Kconfig
```kconfig
# Copyright (c) 2020 HAW Hamburg
#
# This file is subject to the terms and conditions of the GNU Lesser
# General Public License v2.1. See the file LICENSE in the top level
# directory for more details.
#

config MODULE_HD44780
    bool "HD44780 LCD"
    depends on HAS_PERIPH_GPIO
    depends on TEST_KCONFIG
    select MODULE_PERIPH_GPIO
    select MODULE_XTIMER
    help
        The display is also known as LCM1602C from Arduino kits.
```

## drivers/hdc1000/Kconfig
```kconfig
# SPDX-FileCopyrightText: 2020 Freie Universitaet Berlin
# SPDX-License-Identifier: LGPL-2.1-only

menu "HDC1000 driver"
    depends on USEMODULE_HDC1000

config HDC1000_I2C_ADDRESS
    hex "I2C default address"
    range 0x40 0x43
    default 0x43
    help
        HDC1000 allows for up to 4 devices on single bus. The value depends on
        the state of ADR1 and ADR0 pins.
        For more information refer to the section 8.5.1 in the Datasheet (SNAS643C).

config HDC1000_CONVERSION_TIME
    int "Conversion time in microseconds [us]"
    default 26000
    help
        This time value is chosen twice as large as needed for two 14-bit
        conversions (worst case) to allow for timer imprecision:
        (convert temp + convert hum) * 2 -> (6.5ms + 6.5ms) * 2 := 26ms.

endmenu # HDC1000 driver
```

## drivers/hdc2010/Kconfig
```kconfig
# Copyright (c) 2020 Viktor Gal
#
# This file is subject to the terms and conditions of the GNU Lesser
# General Public License v2.1. See the file LICENSE in the top level
# directory for more details.
#
menuconfig KCONFIG_MODULE_HDC2010
    bool "Configure HDC2010 driver"
    depends on MODULE_HDC2010
    help
        Configure the HDC2010 driver using Kconfig.

if KCONFIG_MODULE_HDC2010

config HDC2010_I2C_ADDRESS
    hex "I2C default address"
    range 0x40 0x41
    default 0x40
    help
        HDC2010 allows for up to 2 devices on single bus. The value depends on
        the state of ADDR pin.
        For more information refer to the section 7.5.1 in the Datasheet.

config HDC2010_CONVERSION_TIME
    int "Conversion time in microseconds [us]"
    default 26000
    help
        This time value is chosen twice as large as needed for two 14-bit
        conversions (worst case) to allow for timer imprecision:
        (convert temp + convert hum) * 2 -> (610us + 660us) * 2 := 2540us.

endif # KCONFIG_MODULE_HDC2010
```

## drivers/hih6130/Kconfig
```kconfig
# Copyright (c) 2020 HAW Hamburg
#
# This file is subject to the terms and conditions of the GNU Lesser
# General Public License v2.1. See the file LICENSE in the top level
# directory for more details.
#

config MODULE_HIH6130
    bool "HIH6130 humidity and temperature sensor"
    depends on HAS_PERIPH_I2C
    depends on TEST_KCONFIG
    select MODULE_PERIPH_I2C
    select MODULE_XTIMER
    help
        Device driver for Honeywell HumidIcon Digital Humidity/Temperature
        Sensors: HIH-6130/6131 Series.
```

## drivers/hm3301/Kconfig
```kconfig
# Copyright (c) 2021 Inria
#
# This file is subject to the terms and conditions of the GNU Lesser
# General Public License v2.1. See the file LICENSE in the top level
# directory for more details.
#

config MODULE_HM3301
    bool "HM3301 Particulate Matter Sensor"
    depends on HAS_PERIPH_I2C
    depends on HAS_PERIPH_GPIO
    depends on TEST_KCONFIG
    select MODULE_PERIPH_I2C
    select MODULE_PERIPH_GPIO

menuconfig KCONFIG_USEMODULE_HM3301
    bool "Configure HM3301 driver"
    depends on USEMODULE_HM3301
    help
        Configure the HM3301 driver using Kconfig.

if KCONFIG_USEMODULE_HM3301

config HM3301_INDOOR_ENVIRONMENT
    bool "Indoor environment calibration"
    default 500
    help
        The HM3301 sensor outputs two set of PM* values, one calibrated for indoor
        environment and another one for atmospheric environment, set this value
        according to your deployment.
endif # KCONFIG_USEMODULE_HM3301
```

## drivers/hm330x/Kconfig
```kconfig
# SPDX-FileCopyrightText: 2021 Inria
# SPDX-License-Identifier: LGPL-2.1-only

menu "HM330X driver"
    depends on USEMODULE_HM330X

config HM330X_INDOOR_ENVIRONMENT
    bool "Indoor environment calibration"
    default 500
    help
        The HM330X sensor outputs two set of PM* values, one calibrated for indoor
        environment and another one for atmospheric environment, set this value
        according to your deployment.

endmenu # HM330X driver
```

## drivers/hmc5883l/Kconfig
```kconfig
# Copyright (c) 2020 HAW Hamburg
#
# This file is subject to the terms and conditions of the GNU Lesser
# General Public License v2.1. See the file LICENSE in the top level
# directory for more details.
#

menuconfig MODULE_HMC5883L
    bool
    prompt "HMC5883L 3-axis digital compass" if !(MODULE_SAUL_DEFAULT && HAVE_HMC5883L)
    default (MODULE_SAUL_DEFAULT && HAVE_HMC5883L)
    depends on HAS_PERIPH_I2C
    depends on TEST_KCONFIG
    select MODULE_PERIPH_I2C

config MODULE_HMC5883L_INT
    bool "Data-ready interrupt"
    depends on MODULE_HMC5883L
    depends on HAS_PERIPH_GPIO
    depends on HAS_PERIPH_GPIO_IRQ
    select MODULE_PERIPH_GPIO
    select MODULE_PERIPH_GPIO_IRQ
    default y if HAVE_HMC5883L_INT
    help
        Allows to configure an interrupt pin to get an event on data ready.

config HAVE_HMC5883L
    bool
    help
        Indicates that a HMC5883L 3-axis digital compass is present.

config HAVE_HMC5883L_INT
    bool
    select HAVE_HMC5883L
    help
        Indicates that a HMC5883L 3-axis digital compass is present with
        data-ready interrupt pin connected.
```
