## examples/lwm2m/Kconfig
```kconfig
# Copyright (c) 2021 HAW Hamburg
#
# This file is subject to the terms and conditions of the GNU Lesser
# General Public License v2.1. See the file LICENSE in the top level
# directory for more details.
#

menu "Application configuration"

config LWM2M_SERVER_URI
    string "LwM2M Server URI to register/bootstrap with"
    default "coaps://[fd00:dead:beef::1]:5684"
    help
        The host part of the URI MUST be a valid IPv6 address.

config LWM2M_SERVER_SHORT_ID
    int "Server Short ID"
    default 1
    range 1 65534

choice
    bool "Credential type"

menuconfig LWM2M_CRED_PSK
    bool "PSK (Pre-shared keys)"
    select DTLS_PSK

if LWM2M_CRED_PSK
    config LWM2M_PSK_ID
        string "PSK Identity"
        default "Client_Identity"

    config LWM2M_PSK_KEY
        string "PSK Key"
        default "ThisIsRIOT!"
endif # LWM2M_CRED_PSK

config LWM2M_CRED_RPK
    bool "RPK (Raw public keys)"
    select DTLS_ECC

endchoice

endmenu # Application configuration
```

## examples/networking/libcoap/libcoap_client/Kconfig
```kconfig
# SPDX-FileCopyrightText: 2023-2026 Jon Shallow <supjps-libcoap@jpshallow.com>
# SPDX-License-Identifier: BSD-2-Clause

menu "libcoap_client"
    depends on USEPKG_LIBCOAP

config LIBCOAP_CLIENT_URI
    string "CoAP URI to connect to"
    default "coap://[fe80::405:5aff:fe15:9b7f]/.well-known/core"
config LIBCOAP_USE_PSK
    string "Secret to use for PSK communications"
    default "secretPSK"
    depends on USEMODULE_TINYDTLS
config LIBCOAP_USE_PSK_ID
    string "User ID to use for PSK communications"
    default "user_abc"
    depends on USEMODULE_TINYDTLS

endmenu # libcoap_client
```

## examples/networking/libcoap/libcoap_server/Kconfig
```kconfig
# This file is subject to the terms and conditions of the GNU Lesser
# General Public License v2.1. See the file LICENSE in the top level
# directory for more details.
#
menu "libcoap_server"
    depends on USEPKG_LIBCOAP

config LIBCOAP_USE_PSK
    string "Secret to use for PSK communications"
    default "secretPSK"
    depends on USEMODULE_TINYDTLS
config LIBCOAP_CLIENT_SUPPORT
    bool "Set to y if ongoing proxy support is required"
    default n
if LIBCOAP_CLIENT_SUPPORT
config LIBCOAP_USE_PSK_ID
    string "User ID to use for ongoing PSK communications"
    default "user_abc"
    depends on USEMODULE_TINYDTLS
endif # LIBCOAP_CLIENT_SUPPORT

endmenu # libcoap_server
```

## examples/networking/misc/lwm2m/Kconfig
```kconfig
# SPDX-FileCopyrightText: 2021 HAW Hamburg
# SPDX-License-Identifier: LGPL-2.1-only

menu "Application configuration"

config LWM2M_SERVER_URI
    string "LwM2M Server URI to register/bootstrap with"
    default "coaps://[fd00:dead:beef::1]:5684"
    help
        The host part of the URI MUST be a valid IPv6 address.

config LWM2M_SERVER_SHORT_ID
    int "Server Short ID"
    default 1
    range 1 65534

choice
    bool "Credential type"

menuconfig LWM2M_CRED_PSK
    bool "PSK (Pre-shared keys)"
    select DTLS_PSK

if LWM2M_CRED_PSK
    config LWM2M_PSK_ID
        string "PSK Identity"
        default "Client_Identity"

    config LWM2M_PSK_KEY
        string "PSK Key"
        default "ThisIsRIOT!"
endif # LWM2M_CRED_PSK

config LWM2M_CRED_RPK
    bool "RPK (Raw public keys)"
    select DTLS_ECC

endchoice

endmenu # Application configuration
```

## examples/usbus_minimal/Kconfig
```kconfig
config USB_VID
    default 0x$(DEFAULT_VID) if KCONFIG_USB

config USB_PID
    default 0x$(DEFAULT_PID) if KCONFIG_USB
```

## examples/wakaama/Kconfig
```kconfig
# Copyright (c) 2021 HAW Hamburg
#
# This file is subject to the terms and conditions of the GNU Lesser
# General Public License v2.1. See the file LICENSE in the top level
# directory for more details.
#

menu "Application configuration"

config LWM2M_SERVER_URI
    string "LwM2M Server URI to register/bootstrap with"
    default "coap://[fd00:dead:beef::1]"
    help
        The host part of the URI MUST be a valid IPv6 address.

config LWM2M_SERVER_SHORT_ID
    int "Server Short ID"
    default 1
    range 1 65534

config PSK_ID
    string "PSK Identity"
    default "Client_Identity"

config PSK_KEY
    string "PSK Key"
    default "ThisIsRIOT!"

endmenu # Application configuration
```

## kconfigs/Kconfig.errors
```kconfig
# Copyright (c) 2020 HAW Hamburg
#
# This file is subject to the terms and conditions of the GNU Lesser
# General Public License v2.1. See the file LICENSE in the top level
# directory for more details.
#

# Definition of common error symbols. To indicate an error set the default value
# to the correspondent symbol guarded with the error condition. e.g.:
#
# config ERROR_MODULES_CONFLICT
#     default "On SAM0 platforms RTT and RTC cannot be set at the same time"
#     depends on MODULE_PERIPH_RTC && MODULE_PERIPH_RTT && CPU_COMMON_SAM0
#

config ERROR_MODULES_CONFLICT
    string
    help
        Used to indicate that conflicting modules (i.e. modules that can't be
        active at the same time) are being used together.
```

## kconfigs/Kconfig.features
```kconfig
# Copyright (c) 2020 HAW Hamburg
#
# This file is subject to the terms and conditions of the GNU Lesser
# General Public License v2.1. See the file LICENSE in the top level
# directory for more details.
#

# Declaration of generic features that CPUs and boards may provide

config HAS_ARCH_8BIT
    bool
    help
        Indicates that the CPU has a 8-bits architecture.

config HAS_ARCH_16BIT
    bool
    help
        Indicates that the CPU has a 16-bits architecture.

config HAS_ARCH_32BIT
    bool
    help
        Indicates that the CPU has a 32-bits architecture.

config HAS_ARCH_ARM
    bool
    help
        Indicates that the current architecture is ARM.

config HAS_ARDUINO
    bool
    help
        Indicates that Arduino pins compatibility is supported.

config HAS_ARDUINO_PWM
    bool
    help
        Indicates that Arduino PWM compatibility is supported.

config HAS_BACKUP_RAM
    bool
    help
        Indicates that Backup RAM is supported.

config HAS_CPP
    bool
    help
        Indicates that C++ is supported.

config HAS_CPU_CHECK_ADDRESS
    bool
    help
        Indicates that address validity check is supported.

config HAS_DBGPIN
    bool
    help
        Indicates that a platform provides the neccessary initialization hooks
        for the dbgpin module.

config HAS_EMULATOR_RENODE
    bool
    help
        Indicates that the platform is compatible with the Renode emulator.

config HAS_ETHERNET
    bool
    help
        Indicates that Ethernet connectivity is present.

config HAS_HIGHLEVEL_STDIO
    bool
    help
        Indicates that a high-level stdio method (such as CDC ACM) is used.
        This requires a running thread and set-up and will not print during
        a crash.

config HAS_LIBSTDCPP
    bool
    help
        Indicates that in addition to C++ support an libstdc++ is available.

config HAS_NO_IDLE_THREAD
    bool
    help
        Indicates that this MCU doesn't need the idle thread

config HAS_MOTOR_DRIVER
    bool
    help
        Indicates that a motor_driver configuration is present.

config HAS_PERIPH_ADC
    bool
    help
        Indicates that an ADC peripheral is present.

config HAS_PERIPH_CAN
    bool
    help
        Indicates that a CAN peripheral is present.

config HAS_PERIPH_CORETIMER
    bool
    help
        Indicates that the CLINT timer can be used as timer peripheral

config HAS_PERIPH_CPUID
    bool
    help
        Indicates that a CPU ID peripheral is present.

config HAS_PERIPH_DAC
    bool
    help
        Indicates that a DAC peripheral is present.

config HAS_PERIPH_DMA
    bool
    help
        Indicates that a DMA peripheral is present.

config HAS_PERIPH_EEPROM
    bool
    help
        Indicates that a EEPROM peripheral is present.

config HAS_PERIPH_ETH
    bool
    help
        Indicates that an Ethernet peripheral is present.

config HAS_PERIPH_FLASHPAGE
    bool
    help
        Indicates that a Flashpage peripheral is present.

config HAS_PERIPH_FLASHPAGE_PAGEWISE
    bool
    help
        Indicates that the Flashpage peripheral supports pagewise writing.

config HAS_PERIPH_FLASHPAGE_RWEE
    bool
    help
        Indicates that the Flashpage peripheral is of the Read While Write.

config HAS_PERIPH_GPIO
    bool
    help
        Indicates that a GPIO peripheral is present.

config HAS_PERIPH_GPIO_IRQ
    bool
    help
        Indicates that the GPIO peripheral supports external interrupts is
        present.

config HAS_PERIPH_GPIO_FAST_READ
    bool
    help
	Indicates that the GPIO peripheral supports a mode in which pin read
	operations are faster, usually with a tradeoff against a different
	property.

config HAS_PERIPH_GPIO_TAMPER_WAKE
    bool
    help
        Indicates that Tamper Detection can be used to wake the CPU from
        Deep Sleep.

config HAS_PERIPH_HWRNG
    bool
    help
        Indicates that a Hardware Random Number Generator (HWRNG) peripheral is
        present.

config HAS_PERIPH_I2C
    bool
    help
        Indicates that an I2C peripheral is present.

config HAS_PERIPH_I2C_RECONFIGURE
    bool
    help
        Indicates that the I2C peripheral allows pin reconfiguration peripheral
        is present.

config HAS_PERIPH_ICS
    bool
    help
        Indicates that an ICS peripheral is present.

config HAS_PERIPH_IR
    bool
    help
        Indicates that an IR peripheral is present.

config HAS_PERIPH_LPUART
    bool
    help
        Indicates that a low-power UART peripheral is present.

config HAS_PERIPH_MCG
    bool
    help
        Indicates that an MCG peripheral is present.

config HAS_PERIPH_PLIC
    bool
    help
        Indicates that a RISC-V Platform-local Interrupt Controller (PLIC) peripheral is present.

config HAS_PERIPH_PM
    bool
    help
        Indicates that a Power Management (PM) peripheral is present.

config HAS_PERIPH_PTP
    bool
    help
        Indicates that a PTP clock is present.

config HAS_PERIPH_PTP_SPEED_ADJUSTMENT
    bool
    help
        Indicates that the PTP clock speed can be adjust. This can be used for clock drift correction and synchronization.

config HAS_PERIPH_PTP_TIMER
    bool
    help
        Indicates that the PTP clock can be used as timer.

config HAS_PERIPH_PTP_TXRX_TIMESTAMPS
    bool
    help
        Indicates that the PTP clock can provide exact time stamps of the
        reception and transmission of frames.

config HAS_PERIPH_PWM
    bool
    help
        Indicates that a PWM peripheral is present.

config HAS_PERIPH_QDEC
    bool
    help
        Indicates that a QDEC peripheral is present.

config HAS_PERIPH_RTC
    bool
    help
        Indicates that an RTC peripheral is present.

config HAS_PERIPH_RTT
    bool
    help
        Indicates that an RTT peripheral is present.

config HAS_PERIPH_RTT_SET_COUNTER
    bool
    help
        Indicates that the RTT peripheral implements rtt_set_counter().

config HAS_PERIPH_RTT_OVERFLOW
    bool
    help
        Indicates that the RTT provides an overflow callback.

config HAS_PERIPH_SPI
    bool
    help
        Indicates that an SPI peripheral is present.

config HAS_PERIPH_SPI_ON_QSPI
    bool
    help
        Indicates that the QSPI peripheral can be used in SPI mode.

config HAS_PERIPH_SPI_RECONFIGURE
    bool
    help
        Indicates that the SPI peripheral allows pin reconfiguration.

config HAS_PERIPH_SPI_GPIO_MODE
    bool
    help
        Indicates that the SPI peripheral supports configuring the GPIOs modes.

config HAS_PERIPH_TEMPERATURE
    bool
    help
        Indicates that a Temperature peripheral is present.

config HAS_PERIPH_TIMER
    bool
    help
        Indicates that a Timer peripheral is present.

config HAS_PERIPH_TIMER_PERIODIC
    bool
    help
        Indicates that the Timer peripheral provides the periodic timeout
        functionality.

config HAS_PERIPH_UART
    bool
    help
        Indicates that an UART peripheral is present.

config HAS_PERIPH_UART_HW_FC
    bool
    help
        Indicates that the UART peripheral supports hardware flow control.

config HAS_PERIPH_UART_MODECFG
    bool
    help
        Indicates that the UART peripheral allows mode configuration.

config HAS_PERIPH_UART_NONBLOCKING
    bool
    help
        Indicates that the UART peripheral allows non-blocking operations.

config HAS_PERIPH_UART_RECONFIGURE
    bool
    help
        Indicates that the UART pins can be re-configured as GPIOs.

config HAS_PERIPH_USBDEV
    bool
    help
        Indicates that an USBDEV peripheral is present.

config HAS_PERIPH_WDT
    bool
    help
        Indicates that a Watchdog Timer (WDT) peripheral is present.

config HAS_PERIPH_WDT_CB
    bool
    help
        Indicates that the WDT peripheral allows setting a callback.

config HAS_PICOLIBC
    bool
    help
        Indicates that the picolibc C library is available for the platform.

config HAS_NEWLIB
    bool
    help
        Indicates that the newlib C library is available for the platform.

config HAS_PUF_SRAM
    bool
    help
        Indicates that the PUF-SRAM module has been tested on the platform.

config HAS_RIOTBOOT
    bool
    help
        Indicates that the riotboot booloader is supported.

config HAS_SDCARD_SPI
    bool
    help
        Indicates that an SD-Card SPI configuration is provided.

config HAS_SSP
    bool
    help
        Indicates that Stack Smashing Protection is supported.
```

## kconfigs/Kconfig.ztimer_only
```kconfig
# Include this for boards whose timer periph cannot generate a clock frequency
# suitable for xtimer with the available clock sources and dividers.
# This will use ztimer to perform the required frequency conversion.
# By default, xtimer is still used with ztimer as backed, unless
# ztimer_xtimer_compat is used.

config HAVE_ZTIMER_ONLY
    bool
    default y
    select MODULE_ZTIMER if MODULE_XTIMER
    select MODULE_ZTIMER_PERIPH_TIMER if MODULE_XTIMER
    help
        Indicates that the board cannot generate a clock frequency suitable for
        xtimer and requires ztimer for conversion. ztimer is used as backend.
```
