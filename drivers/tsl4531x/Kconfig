## drivers/tsl4531x/Kconfig
```kconfig
# Copyright (c) 2021 HAW Hamburg
#
# This file is subject to the terms and conditions of the GNU Lesser
# General Public License v2.1. See the file LICENSE in the top level
# directory for more details.
#

config MODULE_TSL4531X
    bool "TSL4531x Illuminance sensor"
    depends on HAS_PERIPH_I2C
    depends on TEST_KCONFIG
    select MODULE_PERIPH_I2C
    select MODULE_XTIMER
```

## drivers/uart_half_duplex/Kconfig
```kconfig
# Copyright (c) 2020 HAW Hamburg
#
# This file is subject to the terms and conditions of the GNU Lesser
# General Public License v2.1. See the file LICENSE in the top level
# directory for more details.
#

config MODULE_UART_HALF_DUPLEX
    bool "half-duplex UART Driver"
    depends on HAS_PERIPH_GPIO
    depends on HAS_PERIPH_UART
    depends on TEST_KCONFIG
    select MODULE_PERIPH_GPIO
    select MODULE_PERIPH_UART
    select MODULE_XTIMER
    help
        This module contains drivers for UART half-duplex communication bus. It
        needs to manage the communication direction by enabling or disabling TX.
```

## drivers/uc8151d/Kconfig
```kconfig
# Copyright (c) 2023 Koen Zandberg
#
# This file is subject to the terms and conditions of the GNU Lesser
# General Public License v2.1. See the file LICENSE in the top level
# directory for more details.

config MODULE_UC8151D
    bool "uc8151d"
    depends on TEST_KCONFIG
    depends on HAS_PERIPH_SPI PERIPH_GPIO
    select MODULE_PERIPH_SPI PERIPH_GPIO
```

## drivers/usbdev_mock/Kconfig
```kconfig
# Copyright (c) 2021 HAW Hamburg
#
# This file is subject to the terms and conditions of the GNU Lesser
# General Public License v2.1. See the file LICENSE in the top level
# directory for more details.
#

config MODULE_USBDEV_MOCK
    bool "USBdev mockup device (for testing)"
    depends on TEST_KCONFIG
```

## drivers/usbdev_synopsys_dwc2/Kconfig
```kconfig
# Copyright (c) 2021 HAW Hamburg
#
# This file is subject to the terms and conditions of the GNU Lesser
# General Public License v2.1. See the file LICENSE in the top level
# directory for more details.
#

config MODULE_USBDEV_SYNOPSYS_DWC2
    bool
    depends on TEST_KCONFIG
    depends on HAS_PERIPH_USBDEV
    select MODULE_ZTIMER_MSEC
    help
         USBDEV low-level driver for MCUs with Synopsys DWC2 USB OTG FS/HS IP core"
```

## drivers/vcnl40x0/Kconfig
```kconfig
# Copyright (c) 2021 HAW Hamburg
#
# This file is subject to the terms and conditions of the GNU Lesser
# General Public License v2.1. See the file LICENSE in the top level
# directory for more details.
#

menuconfig MODULE_VCNL40X0
    bool
    prompt "VCNL4010/VCNL4020/VCNL4040 Proximity and Ambient Light sensors" if !(MODULE_SAUL_DEFAULT && HAVE_VCNL40X0)
    default (MODULE_SAUL_DEFAULT && HAVE_VCNL40X0)
    depends on TEST_KCONFIG
    depends on HAS_PERIPH_I2C
    select MODULE_PERIPH_I2C

choice VCNL40X0_VARIANT
    bool "variant"
    depends on MODULE_VCNL40X0
    default MODULE_VCNL4010 if HAVE_VCNL4010
    default MODULE_VCNL4020 if HAVE_VCNL4020
    default MODULE_VCNL4040 if HAVE_VCNL4040

config MODULE_VCNL4010
    bool "VCNL4010"

config MODULE_VCNL4020
    bool "VCNL4020"

config MODULE_VCNL4040
    bool "VCNL4040"

endchoice

config HAVE_VCNL40X0
    bool
    help
      Indicates that a VCNL40X0 Proximity and Ambient Light sensor is present.

config HAVE_VCNL4010
    bool
    select HAVE_VCNL40X0
    help
      Indicates that a VCNL4010 Proximity and Ambient Light sensor is present.

config HAVE_VCNL4020
    bool
    select HAVE_VCNL40X0
    help
      Indicates that a VCNL4020 Proximity and Ambient Light sensor is present.

config HAVE_VCNL4040
    bool
    select HAVE_VCNL40X0
    help
      Indicates that a VCNL4040 Proximity and Ambient Light sensor is present.
```

## drivers/vl53l1x/Kconfig
```kconfig
# SPDX-FileCopyrightText: 2025 Gunar Schorcht
# SPDX-License-Identifier: LGPL-2.1-only

if !USEMODULE_VL53L1X_BASIC

menu "VL53L1X Time-of-Flight (ToF) ranging sensor"

choice
    bool "Distance mode"
    default VL53L1X_DIST_LONG
    config VL53L1X_DIST_SHORT
        bool "Short - up to 1.3 m"
    config VL53L1X_DIST_LONG
        bool "Long - up to 4 m"
endchoice

choice
    bool "Timing budget"
    default VL53L1X_PARAM_TIMING_BUDGET_50
    config VL53L1X_PARAM_TIMING_BUDGET_15
        bool "15 ms"
    config VL53L1X_PARAM_TIMING_BUDGET_20
        bool "20 ms"
    config VL53L1X_PARAM_TIMING_BUDGET_33
        bool "33 ms"
    config VL53L1X_PARAM_TIMING_BUDGET_50
        bool "50 ms"
    config VL53L1X_PARAM_TIMING_BUDGET_100
        bool "100 ms"
    config VL53L1X_PARAM_TIMING_BUDGET_200
        bool "200 ms"
    config VL53L1X_PARAM_TIMING_BUDGET_500
        bool "500 ms"
endchoice

config VL53L1X_PARAM_PERIOD
    int "Inter-measurement period [ms]"
    default 100
    range 20 1000

endmenu

endif # !USEMODULE_VL53L1X_BASIC
```

## drivers/vl6180x/Kconfig
```kconfig
# Copyright (c) 2021 Gunar Schorcht
#
# This file is subject to the terms and conditions of the GNU Lesser
# General Public License v2.1. See the file LICENSE in the top level
# directory for more details.
#

if USEMODULE_VL6180X

config VL6180X_RNG_MAX_TIME
    int "Ranging maximum convergence time [ms]"
    range 1 63
    default 50
    depends on USEMODULE_VL6180X_RNG

if USEMODULE_VL6180X_ALS

config VL6180X_ALS_INT_TIME
    int "ALS integration time [ms]"
    range 0 511
    default 100

choice VL6180X_ALS_GAIN
    bool "ALS analogue light channel gain"
    default VL6180X_ALS_GAIN_1

config VL6180X_ALS_GAIN_1
    bool "ALS gain setting 1 (actual analogue gain of 1.01)"
config VL6180X_ALS_GAIN_1_25
    bool "ALS gain setting 1.25 (actual analogue gain of 1.28)"
config VL6180X_ALS_GAIN_1_67
    bool "ALS gain setting 1.67 (actual analogue gain of 1.72)"
config VL6180X_ALS_GAIN_2_5
    bool "ALS gain setting 2.5 (actual analogue gain of 2.60)"
config VL6180X_ALS_GAIN_5
    bool "ALS gain setting 5 (actual analogue gain of 5.21)"
config VL6180X_ALS_GAIN_10
    bool "ALS gain setting 10 (actual analogue gain of 10.32)"
config VL6180X_ALS_GAIN_20
    bool "ALS gain setting 20 (actual analogue gain of 20)"
config VL6180X_ALS_GAIN_40
    bool "ALS gain setting 40 (actual analogue gain of 40)"

endchoice

config VL6180X_ALS_LUX_RES
    int "ALS lux resolution [lux/count*1000]"
    range 1 320
    default 320
    help
        ALS lux resolution is used to convert count values from ambient
        light sensing to lux values. It is specified as lux/count*1000.
        The factory calibrated lux resolution is 0.32 lux/count.

endif # USEMODULE_VL6180X_ALS

config VL6180X_MEAS_PERIOD
    int "Measurement period in continuous mode [10 ms]"
    range 0 255
    default 20
    help
        The measurement period is defined as multiple of 10 ms. It is used for
        both range measurements and ambient light sensing (ALS) in
        continuous mode.
        The measurement period also controls the measurement mode used after
        sensor initialization. If the measurement period is 0, the single-shot
        mode is used for both the range and ALS measurements, and functions
        vl6180x_rng_start_single and vl6180x_als_start_single have to be used
        to start a single measurement. Otherwise the continuous mode is
        used for both measurements which are started immediatly after sensor
        initialization.

if USEMODULE_VL6180X_IRQ

choice
    bool "Ranging interrupt mode"
    depends on USEMODULE_VL6180X_RNG
    default VL6180X_RNG_INT_DRDY
    help
        Interrupt defines the interrupt that is enabled for ranging.

config VL6180X_RNG_INT_DRDY
    bool "Data Ready"
    help
        Interrupt is triggered when new ranging data are ready to be read

config VL6180X_RNG_INT_LOW
    bool "Level Low"
    help
        Interrupt is triggered when ranging values are below lower threshold

config VL6180X_RNG_INT_HIGH
    bool "Level High"
    help
        Interrupt is triggered when ranging values are above upper threshold

config VL6180X_RNG_INT_OUT
    bool "Out of Window"
    help
        Interrupt is triggered when ranging values are below the lower
        threshold or above the upper threshold (out of threshold window)

endchoice

config VL6180X_RNG_THRESH_LOW
    int "Ranging lower threshold [mm]"
    depends on VL6180X_RNG_INT_LOW || VL6180X_RNG_INT_OUT
    range 0 255
    default 20
    help
        Interrupt is triggered when ranging values are below this threshold

config VL6180X_RNG_THRESH_HIGH
    int "Ranging upper threshold [mm]"
    depends on VL6180X_RNG_INT_HIGH || VL6180X_RNG_INT_OUT
    range 0 255
    default 90
    help
        Interrupt is triggered when ranging values are above this threshold

choice
    bool "ALS interrupt mode"
    depends on USEMODULE_VL6180X_ALS
    default VL6180X_ALS_INT_DRDY
    help
        Interrupt defines the interrupt that is enabled for ALS.

config VL6180X_ALS_INT_DRDY
    bool "Data Ready"
    help
        Interrupt is triggered when new ALS data are ready to be read

config VL6180X_ALS_INT_LOW
    bool "Level Low"
    help
        Interrupt is triggered when ALS values are below lower threshold

config VL6180X_ALS_INT_HIGH
    bool "Level High"
    help
        Interrupt is triggered when ALS values are above upper threshold

config VL6180X_ALS_INT_OUT
    bool "Out of Window"
    help
        Interrupt is triggered when ALS values are below the lower
        threshold or above the upper threshold (out of threshold window)

endchoice

config VL6180X_ALS_THRESH_LOW
    int "ALS lower threshold [counts]"
    depends on VL6180X_ALS_INT_LOW || VL6180X_ALS_INT_OUT
    range 0 65535
    default 50
    help
        Interrupt is triggered when ALS values are below this threshold

config VL6180X_ALS_THRESH_HIGH
    int "ALS upper threshold [counts]"
    depends on VL6180X_ALS_INT_HIGH || VL6180X_ALS_INT_OUT
    range 0 65535
    default 2000
    help
        Interrupt is triggered when ALS values are above this threshold

endif # USEMODULE_VL6180X_IRQ

endif # USEMODULE_VL6180X
```

## drivers/w5100/Kconfig
```kconfig
# Copyright (c) 2022 HAW Hamburg
#
# This file is subject to the terms and conditions of the GNU Lesser
# General Public License v2.1. See the file LICENSE in the top level
# directory for more details.
#

config MODULE_W5100
    bool "W5100 Ethernet Adapter"
    depends on TEST_KCONFIG
    depends on HAS_PERIPH_GPIO
    depends on HAS_PERIPH_GPIO_IRQ
    depends on HAS_PERIPH_SPI
    select MODULE_LUID
    select MODULE_NETDEV_ETH
    select MODULE_NETDEV_LEGACY_API
    select MODULE_PERIPH_GPIO
    select MODULE_PERIPH_GPIO_IRQ
    select MODULE_PERIPH_SPI

config HAVE_W5100
    bool
    select MODULE_W5100 if MODULE_NETDEV_DEFAULT
    help
        Indicates that a w5100 ethernet adapter is present.
```

## drivers/w5500/Kconfig
```kconfig
# Copyright (C) 2023 Stefan Schmidt
#
# This file is subject to the terms and conditions of the GNU Lesser
# General Public License v2.1. See the file LICENSE in the top level
# directory for more details.
#

menuconfig MODULE_W5500
    bool "W5500 Ethernet Adapter"
    depends on HAS_PERIPH_GPIO
    depends on HAS_PERIPH_GPIO_IRQ
    depends on HAS_PERIPH_SPI
    depends on TEST_KCONFIG
    select MODULE_LUID
    select MODULE_NETDEV_ETH
    select MODULE_PERIPH_GPIO
    select MODULE_PERIPH_GPIO_IRQ
    select MODULE_PERIPH_SPI

config HAVE_W5500
    bool
    select MODULE_W5500 if MODULE_NETDEV_DEFAULT
    help
        Indicates that a w5500 ethernet adapter is present.

if MODULE_W5500

config W5500_USE_POLLING
    bool "Use driver in polling mode"
    default y

if W5500_USE_POLLING

config W5500_POLLING_INTERVAL
    int "Polling interval in ms"
    default 100

#endif # W5500_USE_POLLING

config W5500_MAC_FILTER
    bool "Enable hardware MAC filter"
    default n

config W5500_BROADCAST_FILTER
    bool "Enable hardware broadcast filter"
    default n

config W5500_MULTICAST_FILTER
    bool "Enable hardware multicast filter"
    default n

endif # MODULE_W5500
```

## drivers/ws281x/Kconfig
```kconfig
# Copyright (c) 2021 HAW Hamburg
#
# This file is subject to the terms and conditions of the GNU Lesser
# General Public License v2.1. See the file LICENSE in the top level
# directory for more details.
#

config MODULE_WS281X
    bool "WS2812/SK6812 RGB LED (NeoPixel)"
    depends on HAS_CPU_CORE_ATMEGA || HAS_ARCH_ESP32 || HAS_ARCH_NATIVE
    depends on TEST_KCONFIG
    select MODULE_XTIMER
    select MODULE_WS281X_ATMEGA if HAS_CPU_CORE_ATMEGA
    select MODULE_WS281X_VT100 if HAS_ARCH_NATIVE
    select MODULE_WS281X_ESP32 if HAS_ARCH_ESP32

config MODULE_WS281X_ATMEGA
    bool
    depends on HAS_CPU_CORE_ATMEGA

config MODULE_WS281X_VT100
    bool
    depends on HAS_ARCH_NATIVE

config MODULE_WS281X_ESP32
    bool
    depends on HAS_ARCH_ESP32

config MODULE_WS281X_ESP32_HW
    bool "WS2812/SK6812 RGB LED uses ESP32x RMT"
    depends on MODULE_WS281X_ESP32 && HAS_ESP_RMT
    default y
    help
        The driver can use on ESP32x SoCs either the Remote Control (RMT)
        peripheral or a bit-banging software implementation to generate the
        RGB LED signal. Using the RMT peripheral requires more ROM and RAM but
        does not use the CPU to generate the RGB LED signal. Disable this
        option if saving ROM and RAM is required.

config MODULE_WS281X_ESP32_SW
    bool
    depends on MODULE_WS281X_ESP32
    default y if !MODULE_WS281X_ESP32_HW
    help
        Use the bit-banging software implementation to generate the RGB LED
        signal.

config HAVE_WS281X
    bool
    help
      Indicates that a WS2812/SK6812 RGB LED sensor is present.
```

## examples/gnrc_border_router/Kconfig
```kconfig
if MODULE_ETHOS
config GNRC_DHCPV6_CLIENT_6LBR_STATIC_ROUTE
    default y
    depends on MODULE_GNRC_DHCPV6_CLIENT_6LBR && KCONFIG_MODULE_GNRC_DHCPV6
config GNRC_NETIF_IPV6_ADDRS_NUMOF
    # CONFIG_GNRC_DHCPV6_CLIENT_6LBR_STATIC_ROUTE=1 requires one more address
    # for `fe80::2`.
    default 3
    depends on KCONFIG_MODULE_GNRC_NETIF
endif # MODULE_ETHOS
```

## examples/libcoap-client/Kconfig
```kconfig
if USEMODULE_LIBCOAP
config LIBCOAP_CLIENT_URI
    string "CoAP URI to connect to"
    default "coap://[fe80::405:5aff:fe15:9b7f]/.well-known/core"
config LIBCOAP_USE_PSK
    string "Secret to use for PSK communications"
    default "secretPSK"
    depends on USEMODULE_TINYDTLS
config LIBCOAP_USE_PSK_ID
    string "User ID to use for PSK communications"
    default "user_abc"
    depends on USEMODULE_TINYDTLS
endif # USEMODULE_LIBCOAP
```

## examples/libcoap-server/Kconfig
```kconfig
if USEMODULE_LIBCOAP
config LIBCOAP_USE_PSK
    string "Secret to use for PSK communications"
    default "secretPSK"
    depends on USEMODULE_TINYDTLS
config LIBCOAP_CLIENT_SUPPORT
    bool "Set to y if ongoing proxy support is required"
    default n
if LIBCOAP_CLIENT_SUPPORT
config LIBCOAP_USE_PSK_ID
    string "User ID to use for ongoing PSK communications"
    default "user_abc"
    depends on USEMODULE_TINYDTLS
endif # LIBCOAP_CLIENT_SUPPORT
endif # USEMODULE_LIBCOAP
```

## examples/lorawan/Kconfig
```kconfig
config APPLICATION
    bool
    default y
    imply MODULE_PERIPH_RTC if TEST_KCONFIG

choice ZTIMER_MSEC_BACKEND
    default ZTIMER_MSEC_BACKEND_TIMER
endchoice
```
