## drivers/mtd_mapper/Kconfig
```kconfig
# Copyright (c) 2020 HAW Hamburg
#
# This file is subject to the terms and conditions of the GNU Lesser
# General Public License v2.1. See the file LICENSE in the top level
# directory for more details.
#

config MODULE_MTD_MAPPER
    bool "MTD address mapper"
    depends on TEST_KCONFIG
    select MODULE_MTD
    help
        Driver for address remap for flash devices.

        This MTD module allows for remapping multiple different regions on a single
        MTD device and present them as separate MTD devices. This is similar to
        partitions on a hard drive, although this system only allows hardcoded
        partitions and lacks a partition table.
```

## drivers/mtd_sdcard/Kconfig
```kconfig
# SPDX-FileCopyrightText: 2020 Freie Universitaet Berlin
# SPDX-FileCopyrightText: 2020 HAW Hamburg
# SPDX-License-Identifier: LGPL-2.1-only

menu "MTD_SDCARD driver"
    depends on USEMODULE_MTD_SDCARD

config SDCARD_GENERIC_MTD_OFFSET
    depends on USEMODULE_MTD_SDCARD_DEFAULT
    int "Index of first auto-configured MTD SDcard device"
    default 1
    help
        If you have other MTD devices defined, set this number so that
        the auto-configured SD Card(s) from mtd_sdcard_default will come after them.

config MTD_SDCARD_ERASE
    bool "Enable SD card erase"
    help
        Enable this to erase sector before a data write operation.
        SDCards handle sector erase internally so its
        possible to directly write to the card without erasing
        the sector first hence this feature is disabled by default.

endmenu # MTD_SDCARD driver
```

## drivers/mtd_sdmmc/Kconfig
```kconfig
# SPDX-FileCopyrightText: 2020 Freie Universitaet Berlin
# SPDX-FileCopyrightText: 2020 HAW Hamburg
# SPDX-FileCopyrightText: 2023 Gunar Schorcht
# SPDX-License-Identifier: LGPL-2.1-only

menu "MTD_SDMMC driver"
    depends on USEMODULE_MTD_SDMMC

config SDMMC_GENERIC_MTD_OFFSET
    depends on USEMODULE_MTD_SDMMC_DEFAULT
    int "Index of first auto-configured MTD SD/MMC device"
    default 0
    help
        If you have other MTD devices defined, set this number so that
        the auto-configured SD Memory Card(s) or MMCs/eMMCs from
        mtd_sdmmc_default will come after them.

endmenu # MTD_SDMMC driver
```

## drivers/mtd_spi_nor/Kconfig
```kconfig
# Copyright (c) 2020 HAW Hamburg
#
# This file is subject to the terms and conditions of the GNU Lesser
# General Public License v2.1. See the file LICENSE in the top level
# directory for more details.
#

config MODULE_MTD_SPI_NOR
    bool "MTD interface for SPI NOR Flash"
    depends on HAS_PERIPH_SPI
    depends on TEST_KCONFIG
    select MODULE_PERIPH_SPI
    select MODULE_MTD
```

## drivers/ncv7356/Kconfig
```kconfig
# Copyright (c) 2020 HAW Hamburg
#
# This file is subject to the terms and conditions of the GNU Lesser
# General Public License v2.1. See the file LICENSE in the top level
# directory for more details.
#

config MODULE_NCV7356
    bool "NCV7356 Single Wire CAN Transceiver"
    depends on HAS_PERIPH_GPIO
    depends on TEST_KCONFIG
    select MODULE_PERIPH_GPIO
    select MODULE_CAN_TRX
```

## drivers/netdev/Kconfig
```kconfig
# SPDX-FileCopyrightText: 2022 Otto-von-Guericke-Universität Magdeburg
# SPDX-FileCopyrightText: 2022 HAW Hamburg
# SPDX-License-Identifier: LGPL-2.1-only

if USEMODULE_NETDEV

config NETDEV_REGISTER_SIGNAL
    bool "Signal when a network device is registered"

endif # USEMODULE_NETDEV
```

## drivers/netdev_eth/Kconfig
```kconfig
# Copyright (c) 2020 HAW Hamburg
#
# This file is subject to the terms and conditions of the GNU Lesser
# General Public License v2.1. See the file LICENSE in the top level
# directory for more details.
#

config MOD_NETDEV_ETH
    bool "Netdev Ethernet"
    default y if HAVE_NETDEV_ETHERNET && MOD_NETDEV_DEFAULT
    help
        "Common netdev ethernet driver functionalities"

config HAVE_NETDEV_ETHERNET
    bool
    help
        Indicates that an Ethernet compatible device is present.
```
