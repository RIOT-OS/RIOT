## drivers/lsm6dsxx/Kconfig
```kconfig
# Copyright (c) 2020 HAW Hamburg
#
# This file is subject to the terms and conditions of the GNU Lesser
# General Public License v2.1. See the file LICENSE in the top level
# directory for more details.
#

config MODULE_LSM6DSL
    bool
    prompt "LSM6DSL 3D accelerometer/gyroscope" if !(MODULE_SAUL_DEFAULT && HAVE_LSM6DSL)
    default y if (MODULE_SAUL_DEFAULT && HAVE_LSM6DSL)
    depends on HAS_PERIPH_I2C
    depends on TEST_KCONFIG
    select MODULE_PERIPH_I2C
    select MODULE_ZTIMER
    select MODULE_ZTIMER_MSEC

config HAVE_LSM6DSL
    bool
    help
        Indicates that a lsm6dsl sensor is present.
```

## drivers/ltc4150/Kconfig
```kconfig
# Copyright (c) 2020 HAW Hamburg
#
# This file is subject to the terms and conditions of the GNU Lesser
# General Public License v2.1. See the file LICENSE in the top level
# directory for more details.
#

config MODULE_LTC4150
    bool "LTC4150 coulomb counter"
    depends on HAS_PERIPH_GPIO
    depends on HAS_PERIPH_GPIO_IRQ
    depends on TEST_KCONFIG
    select MODULE_PERIPH_GPIO
    select MODULE_PERIPH_GPIO_IRQ
    select MODULE_XTIMER
    help
        Driver for the Linear Tech LTC4150 Coulomb Counter (a.k.a. battery
        gauge sensor or power consumption sensor).
```

## drivers/mag3110/Kconfig
```kconfig
# SPDX-FileCopyrightText: 2020 Freie Universitaet Berlin
# SPDX-FileCopyrightText: 2020 HAW Hamburg
# SPDX-License-Identifier: LGPL-2.1-only

menu "MAG3110 driver"
    depends on USEMODULE_MAG3110

config MAG3110_I2C_ADDRESS
    hex "I2C default address"
    range 0x0E 0x0F
    default 0x0E
    help
        The address depends on part number of MAG3110.
        For more information refer to the datasheet.

endmenu # MAG3110 driver
```

## drivers/matrix_keypad/Kconfig
```kconfig
# SPDX-FileCopyrightText: 2021 Koen Zandberg
# SPDX-License-Identifier: LGPL-2.1-only

if USEMODULE_MATRIX_KEYPAD

config MATRIX_KEYPAD_NUM_ROWS
    int "Number of rows on the matrix keypad"
    default 2

config MATRIX_KEYPAD_NUM_COLUMS
    int "Number of columns on the matrix keypad"
    default 2

config MATRIX_KEYPAD_DEBOUNCE_PATTERN_BEGIN
    hex "Bitmask pattern used for initial state of the switch"
    default 0xC0
    range 0x00 0xFF

config MATRIX_KEYPAD_DEBOUNCE_PATTERN_END
    hex "Bitmask pattern used for next state of the switch"
    default 0x07
    range 0x00 0xFF

config MATRIX_KEYPAD_ROWS_USE_OPEN_DRAIN
    bool "Use open drain output mode for the row GPIOs"
    default n
    help
	This switches the row GPIO mode from plain output mode to output mode
	with open drain. This helps to prevent shorts between GPIO pins when
	using matrix keypad modules without diodes in the switches. When diodes
	are installed with the switches this can safely be set off.

endif # USEMODULE_MATRIX_KEYPAD
```

## drivers/mcp23x17/Kconfig
```kconfig
# Copyright (c) 2021 Gunar Schorcht
#
# This file is subject to the terms and conditions of the GNU Lesser
# General Public License v2.1. See the file LICENSE in the top level
# directory for more details.
#

menuconfig MODULE_MCP23X17
    bool "MCP23017/MCP23S17 I/O Expander"
    depends on HAS_PERIPH_GPIO
    depends on TEST_KCONFIG
    select MODULE_PERIPH_GPIO
    help
        Driver for Microchip Microchip MCP23x17 I/O expanders.
        The driver supports the MCP23017 and MC23S17 variants.

if MODULE_MCP23X17

config MODULE_MCP23X17_I2C
    bool "MCP23017 with I2C interface is used"
    depends on HAS_PERIPH_I2C
    select MODULE_PERIPH_I2C

config MODULE_MCP23X17_SPI
    bool "MCP23S17 with SPI interface is used"
    depends on HAS_PERIPH_SPI
    select MODULE_PERIPH_SPI

config MODULE_MCP23X17_IRQ
    bool "Interrupt support for MCP23x17 I/O Expander pins"
    depends on HAS_PERIPH_GPIO_IRQ
    select MODULE_PERIPH_GPIO_IRQ
    select MODULE_EVENT
    select MODULE_EVENT_THREAD
    help
        To use the IRQs the MODULE_EVENT_THREAD symbol should be set.

choice
    bool "Thread priority"
    depends on MODULE_MCP23X17_IRQ
    default MODULE_MCP23X17_IRQ_MEDIUM
    help
        To process IRQs an event thread is used. The MODULE_EVENT_THREAD
        symbol should be set. Choose a priority for the thread that
        processes the IRQs. The default is medium priority.

config MODULE_MCP23X17_IRQ_MEDIUM
    bool "Medium"
    select MODULE_EVENT_THREAD_MEDIUM
    help
        Use event thread with medium priority for interrupt handling.

config MODULE_MCP23X17_IRQ_HIGHEST
    bool "Highest"
    select MODULE_EVENT_THREAD_HIGHEST
    help
        Use event thread with highest priority for interrupt handling.

endchoice

config MODULE_MCP23X17_RESET
    bool "RESET pin used"
    help
        If the RESET pin is used, a hardware reset is executed when the
        expander device is initialized. The RESET pin of the MCP23x17 I/O
        Expanderhas to be connected to a MCU pin that has to be defined
        by hardware configuration parameters.

endif # MODULE_MCP23X17
```

## drivers/mcp47xx/Kconfig
```kconfig
# Copyright (c) 2021 Gunar Schorcht
#
# This file is subject to the terms and conditions of the GNU Lesser
# General Public License v2.1. See the file LICENSE in the top level
# directory for more details.
#

menuconfig MODULE_MCP47XX
    bool "MCP47xx DAC with I2C interface"
    depends on HAS_PERIPH_I2C
    select MODULE_PERIPH_I2C
    help
        Driver for Microchip MCP47xx DAC devices with I2C interfaces. The
        driver supports MCP4706, MCP4716, MCP4725, MCP4726 and MCP4728.
```

## drivers/mfrc522/Kconfig
```kconfig
# Copyright (c) 2022 Freie Universität Berlin
#
# This file is subject to the terms and conditions of the GNU Lesser
# General Public License v2.1. See the file LICENSE in the top level
# directory for more details.
#

config MODULE_MFRC522
    bool "MFRC522 RFID controller"
    depends on HAS_PERIPH_GPIO
    depends on HAS_PERIPH_SPI
    depends on TEST_KCONFIG
    select MODULE_PERIPH_GPIO
    select MODULE_PERIPH_SPI
    select MODULE_ZTIMER
    select MODULE_ZTIMER_USEC
    select MODULE_ZTIMER_MSEC
    help
        Device driver for the NXP MFRC522 RFID controller
```

## drivers/mhz19/Kconfig
```kconfig
# Copyright (c) 2020 HAW Hamburg
#
# This file is subject to the terms and conditions of the GNU Lesser
# General Public License v2.1. See the file LICENSE in the top level
# directory for more details.
#

menuconfig MODULE_MHZ19
    bool
    prompt "MH-Z19 CO2 sensor" if !(MODULE_SAUL_DEFAULT && HAVE_MHZ19)
    default (MODULE_SAUL_DEFAULT && HAVE_MHZ19)
    depends on TEST_KCONFIG
    select MODULE_ZTIMER
    select MODULE_ZTIMER_MSEC

if MODULE_MHZ19

config MODULE_MHZ19_PWM
    bool "MH-Z19 over PWM"
    default HAVE_MHZ19_PWM
    depends on HAS_PERIPH_GPIO
    select MODULE_PERIPH_GPIO

config MODULE_MHZ19_UART
    bool "MH-Z19 over UART"
    default HAVE_MHZ19_UART
    depends on HAS_PERIPH_UART
    select MODULE_PERIPH_UART

endif # MODULE_MHZ19

config HAVE_MHZ19
    bool
    help
        Indicates that a MH-Z19 CO2 sensor is present.

config HAVE_MHZ19_PWM
    bool
    help
        Indicates that a MH-Z19 CO2 sensor is present on the pwm.

config HAVE_MHZ19_UART
    bool
    help
        Indicates that a MH-Z19 CO2 sensor is present on the uart.
```

## drivers/mma7660/Kconfig
```kconfig
# Copyright (c) 2020 HAW Hamburg
#
# This file is subject to the terms and conditions of the GNU Lesser
# General Public License v2.1. See the file LICENSE in the top level
# directory for more details.
#

config MODULE_MMA7660
    bool "MMA7660 Accelerometer"
    depends on HAS_PERIPH_I2C
    depends on TEST_KCONFIG
    select MODULE_PERIPH_I2C

config HAVE_MMA7660
    bool
    select MODULE_MMA7660 if MODULE_SAUL_DEFAULT
    help
      Indicates that a MMA7660 Accelerometer is present.
```

## drivers/mma8x5x/Kconfig
```kconfig
# SPDX-FileCopyrightText: 2020 Freie Universitaet Berlin
# SPDX-FileCopyrightText: 2020 HAW Hamburg
# SPDX-License-Identifier: LGPL-2.1-only

menu "MMA8X5X driver"
    depends on USEMODULE_MMA8X5X

config MMA8X5X_I2C_ADDRESS
    hex "Default I2C address"
    range 0x1C 0x1D
    default 0x1D
    help
        The address value depends on the state of SA0 Address Pin
        in the case of MMA845x series sensors.
        For more details refer Table 1 in datasheet
        (MMA8451Q/MMA8452Q/MMA8453Q)
        Default value corresponds to SA0 connected to VCC.

endmenu # MMA8X5X driver
```

## drivers/modbus/Kconfig
```kconfig
# Copyright (c) 2023-2024 Bas Stottelaar <basstottelaar@gmail.com>
#
# This file is subject to the terms and conditions of the GNU Lesser
# General Public License v2.1. See the file LICENSE in the top level
# directory for more details.
#

config MODULE_MODBUS
    bool "Modbus"

if MODULE_MODBUS

config MODULE_MODBUS_RTU
    bool "Modbus RTU"
    depends on HAS_PERIPH_GPIO
    depends on HAS_PERIPH_UART
    depends on TEST_KCONFIG
    select MODULE_PERIPH_GPIO
    select MODULE_PERIPH_UART
    select MODULE_CHECKSUM
    select MODULE_ZTIMER
    select MODULE_ZTIMER_MSEC

endif # MODULE_MODBUS

config HAVE_MODBUS
    bool
    help
        Indicates that support for Modbus is present

config HAVE_MHZ19_PWM
    bool
    help
        Indicates that a support for Modbus RTU is present
```

## drivers/motor_driver/Kconfig
```kconfig
# SPDX-FileCopyrightText: 2020 Freie Universitaet Berlin
# SPDX-FileCopyrightText: 2020 HAW Hamburg
# SPDX-License-Identifier: LGPL-2.1-only

menu "MOTOR_DRIVER: DC Motor driver"
    depends on USEMODULE_MOTOR_DRIVER

config MOTOR_DRIVER_MAX
    int "Maximum number of motors"
    default 2
    help
        Maximum number of motors depends on the H-bridge.
        The value should not exceed the number of PWM channels
        Default value is set to 2.

endmenu # Configure the DC Motor driver
```

## drivers/mpl3115a2/Kconfig
```kconfig
# Copyright (c) 2020 HAW Hamburg
#
# This file is subject to the terms and conditions of the GNU Lesser
# General Public License v2.1. See the file LICENSE in the top level
# directory for more details.
#

config MODULE_MPL3115A2
    bool "MPL3115A2 Pressure Sensor"
    depends on HAS_PERIPH_I2C
    depends on TEST_KCONFIG
    select MODULE_PERIPH_I2C

config HAVE_MPL3115A2
    bool
    select MODULE_MPL3115A2 if MODULE_SAUL_DEFAULT
    help
      Indicates that an mpl3115a2 pressure sensor is present.
```

## drivers/mpu9x50/Kconfig
```kconfig
# Copyright (c) 2020 HAW Hamburg
#
# This file is subject to the terms and conditions of the GNU Lesser
# General Public License v2.1. See the file LICENSE in the top level
# directory for more details.
#


menuconfig MODULE_MPU9X50
    bool
    prompt "MPU-9X50 accelerometer/magnetometer/gyroscope" if !(MODULE_SAUL_DEFAULT && HAVE_MPU9X50)
    default y if (MODULE_SAUL_DEFAULT && HAVE_MPU9X50)
    depends on TEST_KCONFIG
    depends on HAS_PERIPH_I2C
    select MODULE_PERIPH_I2C
    select MODULE_ZTIMER
    select MODULE_ZTIMER_MSEC

choice
    bool "Sensor variant"
    default MODULE_MPU9150 if HAVE_MPU9150
    default MODULE_MPU9250 if HAVE_MPU9250
    depends on MODULE_MPU9X50
    help
        This driver supports both MPU9150 and MPU9250. Choose one model.

config MODULE_MPU9150
    bool "MPU-9150"

config MODULE_MPU9250
    bool "MPU-9250"

endchoice

config HAVE_MPU9150
    bool
    select HAVE_MPU9X50
    help
      Indicates that a mpu9150 sensor is present.

config HAVE_MPU9250
    bool
    select HAVE_MPU9X50
    help
      Indicates that a mpu9250 sensor is present.

config HAVE_MPU9X50
    bool
    help
      Indicates that a mpu9X50 sensor is present.
```

## drivers/mq3/Kconfig
```kconfig
# Copyright (c) 2020 HAW Hamburg
#
# This file is subject to the terms and conditions of the GNU Lesser
# General Public License v2.1. See the file LICENSE in the top level
# directory for more details.
#

config MODULE_MQ3
    bool "MQ-3 Alcohol Tester"
    depends on HAS_PERIPH_ADC
    depends on TEST_KCONFIG
    select MODULE_PERIPH_ADC
```

## drivers/mrf24j40/Kconfig
```kconfig
# SPDX-FileCopyrightText: 2020 HAW Hamburg
# SPDX-License-Identifier: LGPL-2.1-only

menu "MRF24J40 driver"
    depends on USEMODULE_MRF24J40

config MRF24J40_OQPSK
    bool "OQPSK support"

config MRF24J40_USE_EXT_PA_LNA
    bool "Enable external PA/LNA control"
    default y
    depends on !USEMODULE_MRF24J40MA
    help
        Increase RSSI for MRF24J40MC/MD/ME devices. No effect on MRF24J40MA.
        For more information, please refer to section 4.2 of MRF24J40 datasheet.

config MRF24J40_TEST_SPI_CONNECTION
    bool "Enable basic self-test on init"
    help
        Perform a write / read to a known register on startup to detect if the
        device is connected. Enable this if you want the boot not to hang if the
        device is not connected / there are SPI errors.

endmenu # MRF24J40 driver
```

## drivers/mtd/Kconfig
```kconfig
# Copyright (c) 2020 HAW Hamburg
#
# This file is subject to the terms and conditions of the GNU Lesser
# General Public License v2.1. See the file LICENSE in the top level
# directory for more details.
#

config HAVE_MTD_AT24CXXX
    bool
    depends on MODULE_AT24CXXX
    imply MODULE_MTD_AT24CXXX if MODULE_MTD
    help
        Indicates that a at24cxxx EEPROM MTD is present

config HAVE_MTD_AT25XXX
    bool
    depends on MODULE_AT25XXX
    imply MODULE_MTD_AT25XXX if MODULE_MTD
    help
        Indicates that a at25xxx SPI-EEPROM MTD is present

config HAVE_MTD_NATIVE
    bool
    imply MODULE_MTD_NATIVE if MODULE_MTD
    help
        Indicates that a native MTD is present.

config HAVE_MTD_SD_SCARD
    bool
    imply MODULE_MTD_SD_CARD if MODULE_MTD
    help
        Indicates that a sdcard MTD is present

config HAVE_MTD_SPI_NOR
    bool
    imply MODULE_MTD_SPI_NOR if MODULE_MTD
    help
        Indicates that a spi-nor MTD is present

config HAVE_MTD_SPI_MCI
    bool
    imply MODULE_MTD_MCI if MODULE_MTD
    help
        Indicates that a Multimedia Card Interface (MCI) MTD is present

menuconfig MODULE_MTD
    bool "Memory Technology Device interface (MTD)"
    depends on TEST_KCONFIG

if MODULE_MTD

menu "MTD Interefaces"

config MODULE_MTD_SPI_NOR
    bool "MTD interface for SPI NOR Flash"
    depends on HAS_PERIPH_SPI
    select MODULE_PERIPH_SPI

config MODULE_MTD_FLASHPAGE
    bool "MTD interface for Flashpage"
    depends on HAS_PERIPH_FLASHPAGE
    depends on HAS_PERIPH_FLASHPAGE_PAGEWISE
    select MODULE_PERIPH_FLASHPAGE
    select MODULE_PERIPH_FLASHPAGE_PAGEWISE
    help
        Driver for internal flash devices implementing flashpage interface.

config MODULE_MTD_NATIVE
    bool "MTD native driver"
    depends on NATIVE_OS_LINUX

config MODULE_MTD_AT24CXXX
    bool "MTD implementation for AT24CXXX"
    depends on MODULE_AT24CXXX

config MODULE_MTD_AT25XXX
    bool "MTD implementation for AT25XXX"
    depends on MODULE_AT25XXX

config MODULE_MTD_MCI
    bool "MTD interface for LPC23XX MCI"
    depends on CPU_FAM_LPC23XX
    select MODULE_MCI

config MODULE_MTD_SDCARD
    bool "MTD interface for SPI SD-Card"
    depends on MODULE_SDCARD_SPI

endmenu # MTD Interfacs

config MODULE_MTD_WRITE_PAGE
    bool "MTD write page API"

endif
```

## drivers/mtd_flashpage/Kconfig
```kconfig
# Copyright (c) 2020 HAW Hamburg
#
# This file is subject to the terms and conditions of the GNU Lesser
# General Public License v2.1. See the file LICENSE in the top level
# directory for more details.
#

config MODULE_MTD_FLASHPAGE
    bool "MTD interface for Flashpage"
    depends on HAS_PERIPH_FLASHPAGE
    depends on HAS_PERIPH_FLASHPAGE_PAGEWISE
    depends on TEST_KCONFIG
    select MODULE_PERIPH_FLASHPAGE
    select MODULE_PERIPH_FLASHPAGE_PAGEWISE
    select MODULE_MTD
    help
        Driver for internal flash devices implementing flashpage interface.
```
