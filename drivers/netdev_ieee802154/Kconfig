## drivers/netdev_ieee802154/Kconfig
```kconfig
# Copyright (c) 2020 HAW Hamburg
#
# This file is subject to the terms and conditions of the GNU Lesser
# General Public License v2.1. See the file LICENSE in the top level
# directory for more details.

config MOD_NETDEV_IEEE802154
    bool "Netdev IEEE802154"
    default y if HAVE_RADIO_IEEE802154 && MOD_NETDEV_DEFAULT
    depends on MOD_IEEE802154
    select MOD_RANDOM

config MOD_NETDEV_IEEE802154_OQPSK
    bool "Netdev IEEE802154 OQPSK support"
    depends on MOD_NETDEV_IEEE802154
    default y if HAVE_RADIO_IEEE802154_OQPSK

config HAVE_RADIO_IEEE802154_OQPSK
    bool
    help
        Indicates that an IEEE 802.15.4 compatible radio with OQPSK supporte is
        present.
```

## drivers/netdev_ieee802154_submac/Kconfig
```kconfig
# Copyright (c) 2022 HAW Hamburg
#
# This file is subject to the terms and conditions of the GNU Lesser
# General Public License v2.1. See the file LICENSE in the top level
# directory for more details.
#

config MODULE_NETDEV_IEEE802154_SUBMAC
    bool
    depends on TEST_KCONFIG
    depends on MODULE_NETDEV
    default y if HAVE_IEEE802154_RADIO_HAL_INTERFACE
    select MODULE_IEEE802154
    select MODULE_IEEE802154_SUBMAC
    select MODULE_NETDEV_IEEE802154
    select MODULE_NETDEV_LEGACY_API
    help
      This module implements the netdev API on top of the IEEE 802.15.4 radio
      HAL.
```

## drivers/nrf24l01p/Kconfig
```kconfig
# Copyright (c) 2023 Inria
# This file is subject to the terms and conditions of the GNU Lesser
# General Public License v2.1. See the file LICENSE in the top level
# directory for more details.
#

menuconfig MODULE_NRF24L01P
    bool
    prompt "nrf24l01p radio" if !(MODULE_NETDEV_DEFAULT && HAVE_NRF24L01P)
    default (MODULE_NETDEV_DEFAULT && HAVE_NRF24L01P)
    depends on TEST_KCONFIG
    select MODULE_PERIPH_GPIO
    select MODULE_PERIPH_GPIO_IRQ
    select MODULE_PERIPH_SPI
    select ZTIMER_USEC

config HAVE_NRF24L01P
    bool
    help
      Indicates that a NRF24L01P radio is present.
```

## drivers/nvram/Kconfig
```kconfig
# Copyright (c) 2020 HAW Hamburg
#
# This file is subject to the terms and conditions of the GNU Lesser
# General Public License v2.1. See the file LICENSE in the top level
# directory for more details.
#

config MODULE_NVRAM
    bool "Non-volatile RAM"
    depends on TEST_KCONFIG
    help
        This API is designed around non-volatile memories which do not need
        blockwise erase, such as ferro-electric RAM (FRAM) or magneto-resistive
        RAM (MRAM).

        This interface is not suitable for flash memories.
```

## drivers/nvram_spi/Kconfig
```kconfig
# Copyright (c) 2020 HAW Hamburg
#
# This file is subject to the terms and conditions of the GNU Lesser
# General Public License v2.1. See the file LICENSE in the top level
# directory for more details.
#

config MODULE_NVRAM_SPI
    bool "Interface for various SPI NVRAM"
    depends on HAS_PERIPH_SPI
    depends on TEST_KCONFIG
    select MODULE_NVRAM
    select MODULE_PERIPH_SPI
    select MODULE_XTIMER
```

## drivers/opt3001/Kconfig
```kconfig
# SPDX-FileCopyrightText: 2020 Freie Universitaet Berlin
# SPDX-FileCopyrightText: 2020 HAW Hamburg
# SPDX-License-Identifier: LGPL-2.1-only

menu "OPT3001 driver"
    depends on USEMODULE_OPT3001

config OPT3001_I2C_ADDRESS
    hex "Default I2C address"
    range 0x44 0x47
    default 0x45
    help
        The OPT3001 allows up to 4 devices on single bus. The address depends on
        the state of ADDR Pin. The default value (0x45) corresponds to ADDR pin
        tied to VDD. For more information check the I2C Address Selection
        (7.3.4.1) section in the Datasheet.

choice
    bool "Conversion time"
    default OPT3001_CONVERSION_TIME_800
    help
        Time over which the results are integrated. A longer integration time
        allows for a lower noise measurement.
        time periods.

config OPT3001_CONVERSION_TIME_100
    bool "100 ms"

config OPT3001_CONVERSION_TIME_800
    bool "800 ms"

endchoice

endmenu # OPT3001 driver
```

## drivers/optmodem/Kconfig
```kconfig
menu "Optical modem driver"
config MODULE_OPTMODEM
    bool "optmodem (optical modem) driver"
    select MODULE_PERIPH_UART
endmenu
```

## drivers/paa5100je/Kconfig
```kconfig
# SPDX-FileCopyrightText: 2025 TU Dresden
# SPDX-License-Identifier: LGPL-2.1-only

config MODULE_PAA5100JE
    bool "PAA5100JE"
    depends on TEST_KCONFIG
    depends on HAS_PERIPH_SPI
    select MODULE_PERIPH_SPI

menu "PAA5100JE driver"
    depends on USEMODULE_PAA5100JE

config PAA5100JE_QUALITY_THRESHOLD
    hex "Quality Threshold"
    range 0x00 0xff
    default 0x19
    help
        Defines a minimum quality threshold when reading from the burst register.
        If the reported quality is below this threshold,
        the driver retries until the threshold is met or the function times out.

config PAA5100JE_TIMEOUT_MS
    int "Timeout in Milliseconds"
    default 1000
    help
        Maximum time (in milliseconds)
        the driver will attempt to read valid motion data before aborting.

config PAA5100JE_SCALE_DENOMINATOR
    int "Scale Denominator"
    default 100
    help
        Denominator used for scaling motion data.
        The raw motion data read from the sensor is multiplied by 100 and
        divided by this value to convert it into meaningful units.

endmenu # PAA5100JE driver
```

## drivers/pca9633/Kconfig
```kconfig
# Copyright (c) 2021 HAW Hamburg
#
# This file is subject to the terms and conditions of the GNU Lesser
# General Public License v2.1. See the file LICENSE in the top level
# directory for more details.
#

config MODULE_PCA9633
    bool "PCA9633 I2C PWM controller"
    depends on HAS_PERIPH_I2C
    depends on TEST_KCONFIG
    select MODULE_PERIPH_I2C
```

## drivers/pca9685/Kconfig
```kconfig
# Copyright (c) 2021 HAW Hamburg
#
# This file is subject to the terms and conditions of the GNU Lesser
# General Public License v2.1. See the file LICENSE in the top level
# directory for more details.
#

config MODULE_PCA9685
    bool "PCA9685 I2C PWM controller"
    depends on !HAS_CPU_EFM32 # efm32 CPU doesn't support PWM_RIGHT
    depends on HAS_PERIPH_GPIO
    depends on HAS_PERIPH_I2C
    depends on TEST_KCONFIG
    select MODULE_PERIPH_GPIO
    select MODULE_PERIPH_I2C
    select MODULE_XTIMER

config HAVE_PCA9685
    bool
    select MODULE_PCA9685 if MODULE_SAUL_DEFAULT
    help
      Indicates that a PCA9685 I2C PWM controller controller is present.
```

## drivers/pcd8544/Kconfig
```kconfig
# Copyright (c) 2021 HAW Hamburg
#
# This file is subject to the terms and conditions of the GNU Lesser
# General Public License v2.1. See the file LICENSE in the top level
# directory for more details.
#

config MODULE_PCD8544
    bool "PCD8544 LCD driver"
    depends on HAS_PERIPH_GPIO
    depends on HAS_PERIPH_SPI
    depends on TEST_KCONFIG
    select MODULE_PERIPH_GPIO
    select MODULE_PERIPH_SPI
    select MODULE_XTIMER
```

## drivers/pcf857x/Kconfig
```kconfig
# Copyright (c) 2021 Gunar Schorcht
#
# This file is subject to the terms and conditions of the GNU Lesser
# General Public License v2.1. See the file LICENSE in the top level
# directory for more details.
#

menuconfig MODULE_PCF857X
    bool "PCF857x Remote I/O Expander for I2C Bus"
    depends on HAS_PERIPH_GPIO
    depends on HAS_PERIPH_I2C
    depends on TEST_KCONFIG
    select MODULE_PERIPH_GPIO
    select MODULE_PERIPH_I2C
    help
        Driver for Texas Instruments PCF857X I2C I/O expanders.
        The driver supports the PCF8574, PCF8574A, and PCF8575 variants.
        Select the variants used by your application.

if MODULE_PCF857X

config MODULE_PCF8574
    bool "PCF8574  Remote  8-Bit I/O is used"

config MODULE_PCF8574A
    bool "PCF8574A Remote  8-Bit I/O is used"

config MODULE_PCF8575
    bool "PCF8575  Remote 16-Bit I/O is used"
    default y

config MODULE_PCF857X_IRQ
    bool "Interrupt support for PCF857x I/O Expander pins"
    depends on MODULE_PCF857X
    depends on HAS_PERIPH_GPIO_IRQ
    select MODULE_PERIPH_GPIO_IRQ
    select MODULE_EVENT
    select MODULE_EVENT_THREAD
    help
        To use the IRQs the MODULE_EVENT_THREAD symbol should be set.

choice
    bool "Thread priority"
    depends on MODULE_PCF857X_IRQ
    default MODULE_PCF857X_IRQ_MEDIUM
    help
        To process IRQs an event thread is used. The MODULE_EVENT_THREAD
        symbol should be set. Choose a priority for the thread that
        processes the IRQs. The default is medium priority.

config MODULE_PCF857X_IRQ_LOW
    bool "Low"
    select MODULE_EVENT_THREAD_LOW

config MODULE_PCF857X_IRQ_MEDIUM
    bool "Medium"
    select MODULE_EVENT_THREAD_MEDIUM

config MODULE_PCF857X_IRQ_HIGHEST
    bool "Highest"
    select MODULE_EVENT_THREAD_HIGHEST

endchoice

endif # MODULE_PCF857X
```

## drivers/periph_common/Kconfig
```kconfig
# SPDX-FileCopyrightText: 2020 HAW Hamburg
# SPDX-License-Identifier: LGPL-2.1-only

rsource "Kconfig.gpio"

rsource "Kconfig.i2c"

rsource "Kconfig.rtc"

rsource "Kconfig.spi"

rsource "Kconfig.timer"

rsource "Kconfig.vbat"
rsource "Kconfig.wdt"
```

## drivers/periph_common/Kconfig.eth
```kconfig
# SPDX-FileCopyrightText: 2026 Bas Stottelaar <basstottelaar@gmail.com>
# SPDX-License-Identifier: LGPL-2.1-only

# Include CPU specific configurations
menu "Ethernet peripheral driver"

osource "$(RIOTCPU)/$(CPU)/periph/Kconfig.eth"

endmenu # Ethernet peripheral driver
```

## drivers/periph_common/Kconfig.flashpage
```kconfig
# Copyright (c) 2020 HAW Hamburg
#
# This file is subject to the terms and conditions of the GNU Lesser
# General Public License v2.1. See the file LICENSE in the top level
# directory for more details.
#

menuconfig MODULE_PERIPH_FLASHPAGE
    bool "Flashpage peripheral driver"
    depends on HAS_PERIPH_FLASHPAGE
    select MODULE_PERIPH_COMMON

# TODO: the 'init' modules are actually just artifacts from the way
# periph_init_% modules are handled in Makefile. We need to define them to keep
# the list the same for now. We should be able to remove them later on.

config MODULE_PERIPH_INIT_FLASHPAGE
    bool "Auto initialize Flashpage peripheral"
    default y if MODULE_PERIPH_INIT
    depends on MODULE_PERIPH_FLASHPAGE

config MODULE_PERIPH_FLASHPAGE_PAGEWISE
    bool "Pagewise writing support"
    depends on HAS_PERIPH_FLASHPAGE_PAGEWISE
    depends on MODULE_PERIPH_FLASHPAGE

config MODULE_PERIPH_INIT_FLASHPAGE_PAGEWISE
    bool "Auto initialize Flashpage pagewise"
    default y if MODULE_PERIPH_INIT
    depends on MODULE_PERIPH_FLASHPAGE_PAGEWISE

config MODULE_PERIPH_FLASHPAGE_RWEE
    bool "Read while Write support"
    depends on HAS_PERIPH_FLASHPAGE_RWEE
    depends on MODULE_PERIPH_FLASHPAGE

config MODULE_PERIPH_INIT_FLASHPAGE_RWEE
    bool "Auto initialize Flashpage RWEE"
    default y if MODULE_PERIPH_INIT
    depends on MODULE_PERIPH_FLASHPAGE_RWEE
```

## drivers/periph_common/Kconfig.gpio
```kconfig
# SPDX-FileCopyrightText: 2020 HAW Hamburg
# SPDX-License-Identifier: LGPL-2.1-only

if USEMODULE_PERIPH_GPIO

# TODO: this module is actually jus  t an artifact from the way periph_init_%
# modules are handled in Makefile. We need to define it to keep the list the
# same for now. We should be able to remove it later on.

endif # USEMODULE_PERIPH_GPIO

osource "$(RIOTCPU)/$(CPU)/periph/Kconfig.gpio"
```

## drivers/periph_common/Kconfig.gpio_ll
```kconfig
# Copyright (c) 2023 HAW Hamburg
#
# This file is subject to the terms and conditions of the GNU Lesser
# General Public License v2.1. See the file LICENSE in the top level
# directory for more details.
#

menuconfig MODULE_PERIPH_GPIO_LL
    bool "Low-level GPIO peripheral driver"
    depends on HAS_PERIPH_GPIO_LL

if MODULE_PERIPH_GPIO_LL

config MODULE_PERIPH_GPIO_LL_IRQ_UNMASK
    bool "Unmask GPIO peripheral interrupts"
    default y
    depends on HAS_PERIPH_GPIO_LL_IRQ_UNMASK
    help
        Enables GPIO peripheral unmasking interrupts without
        clearing pending IRQs that came in while masked.

endif # MODULE_PERIPH_GPIO_LL
```

## drivers/periph_common/Kconfig.i2c
```kconfig
# SPDX-FileCopyrightText: 2020 HAW Hamburg
# SPDX-License-Identifier: LGPL-2.1-only

if USEMODULE_PERIPH_I2C

# TODO: this module is actually just an artifact from the way periph_init_%
# modules are handled in Makefile. We need to define it to keep the list the
# same for now. We should be able to remove it later on.

endif # USEMODULE_PERIPH_I2C

osource "$(RIOTCPU)/$(CPU)/periph/Kconfig.i2c"
```

## drivers/periph_common/Kconfig.leds
```kconfig
# Copyright (c) 2022 Inria
#
# This file is subject to the terms and conditions of the GNU Lesser
# General Public License v2.1. See the file LICENSE in the top level
# directory for more details.
#

config MODULE_PERIPH_INIT_LEDS
    bool
    default y
    depends on TEST_KCONFIG
    help
        Enable auto initialization of board leds

config MODULE_PERIPH_INIT_LED0
    bool
    default y
    depends on MODULE_PERIPH_INIT_LEDS
    help
        Enable auto initialization of LED0 if present

config MODULE_PERIPH_INIT_LED1
    bool
    default y
    depends on MODULE_PERIPH_INIT_LEDS
    help
        Enable auto initialization of LED1 if present

config MODULE_PERIPH_INIT_LED2
    bool
    default y
    depends on MODULE_PERIPH_INIT_LEDS
    help
        Enable auto initialization of LED2 if present

config MODULE_PERIPH_INIT_LED3
    bool
    default y
    depends on MODULE_PERIPH_INIT_LEDS
    help
        Enable auto initialization of LED3 if present

config MODULE_PERIPH_INIT_LED4
    bool
    default y
    depends on MODULE_PERIPH_INIT_LEDS
    help
        Enable auto initialization of LED4 if present

config MODULE_PERIPH_INIT_LED5
    bool
    default y
    depends on MODULE_PERIPH_INIT_LEDS
    help
        Enable auto initialization of LED5 if present

config MODULE_PERIPH_INIT_LED6
    bool
    default y
    depends on MODULE_PERIPH_INIT_LEDS
    help
        Enable auto initialization of LED6 if present

config MODULE_PERIPH_INIT_LED7
    bool
    default y
    depends on MODULE_PERIPH_INIT_LEDS
    help
        Enable auto initialization of LED7 if present
```

## drivers/periph_common/Kconfig.rtc
```kconfig
# SPDX-FileCopyrightText: 2020 HAW Hamburg
# SPDX-License-Identifier: LGPL-2.1-only

if USEMODULE_PERIPH_RTC

endif #MODULE_PERIPH_RTC

# TODO: this module is actually just an artifact from the way periph_init_%
# modules are handled in Makefile. We need to define it to keep the list the
# same for now. We should be able to remove it later on.

# Include CPU specific configurations
osource "$(RIOTCPU)/$(CPU)/periph/Kconfig.rtc"
```
