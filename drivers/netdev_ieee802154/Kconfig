## drivers/periph_common/Kconfig.sdmmc
```kconfig
# Copyright (c) 2020 HAW Hamburg
#
# This file is subject to the terms and conditions of the GNU Lesser
# General Public License v2.1. See the file LICENSE in the top level
# directory for more details.
#

menuconfig MODULE_PERIPH_SDMMC
    bool "SDIO/SD/MMC peripheral driver"
    depends on HAS_PERIPH_SDMMC
    select MODULE_PERIPH_COMMON

if MODULE_PERIPH_SDMMC

config MODULE_PERIPH_INIT_SDMMC
    bool "Auto initialize SDIO/SD/MMC peripheral"
    default y if MODULE_PERIPH_INIT

config MODULE_PERIPH_SDMMC_8BIT
    bool "8 Bit data bus support"
    depends on HAS_PERIPH_SDMMC_8BIT
    default y
    help
        If the SDIO/SD/MMC peripheral supports the 8-bit bus width, it can be
        used by enabling this option. If the option is disabled, the driver
        requires less RAM and ROM.

config MODULE_PERIPH_INIT_SDMMC_8BIT
    bool
    depends on MODULE_PERIPH_SDMMC_8BIT
    default y if MODULE_PERIPH_INIT

config MODULE_PERIPH_SDMMC_HS
    bool "High speed access"
    depends on HAS_PERIPH_SDMMC_HS
    default y
    help
        If the SDIO/SD/MMC peripheral supports the high speed access, i.e. 50
        MHz for SD and 52 MHz for MMC, it can be used by enabling this option.
        If the option is disabled, the driver requires less RAM and ROM.

config MODULE_PERIPH_INIT_SDMMC_HS
    bool
    depends on MODULE_PERIPH_SDMMC_HS
    default y if MODULE_PERIPH_INIT

config MODULE_PERIPH_SDMMC_AUTO_CLK
    bool
    depends on HAS_PERIPH_SDMMC_AUTO_CLK
    default y
    help
        If the SDIO/SD/MMC peripheral supports the Auto-CLK feature, i.e.
        the automatic activation and deactivation of the SD CLK signal,
        it is enabled automatically by this option. Otherwise, the activation
        and deactivation is controlled by SDIO/SD/MMC high-level functions.

config MODULE_PERIPH_INIT_SDMMC_AUTO_CLK
    bool
    depends on MODULE_PERIPH_SDMMC_AUTO_CLK
    default y if MODULE_PERIPH_INIT

config MODULE_PERIPH_SDMMC_AUTO_CMD12
    bool
    depends on HAS_PERIPH_SDMMC_AUTO_CMD12
    default y
    help
        If the SDIO/SD/MMC peripheral supports the Auto-CMD12 feature is
        enabled, i.e. CMD12 is sent automatically to stop the transmission in
        multiple block operations.

config MODULE_PERIPH_INIT_SDMMC_AUTO_CMD12
    bool
    depends on MODULE_PERIPH_SDMMC_AUTO_CMD12
    default y if MODULE_PERIPH_INIT

config MODULE_PERIPH_SDMMC_SDHC
    bool
    depends on HAS_PERIPH_SDMMC_SDHC
    default y
    help
        If the SDIO/SD/MMC peripheral is compliant with the SD Host Controller
        Specification, the low-level SD Host Controller (SDHC) peripheral
        driver is used.

config MODULE_PERIPH_INIT_SDMMC_SDHC
    bool
    depends on MODULE_PERIPH_SDMMC_SDHC
    default y if MODULE_PERIPH_INIT

endif # MODULE_PERIPH_SDMMC
```

## drivers/periph_common/Kconfig.spi
```kconfig
# SPDX-FileCopyrightText: 2020 HAW Hamburg
# SPDX-License-Identifier: LGPL-2.1-only

if USEMODULE_PERIPH_SPI

# TODO: these modules are actually just artifacts from the way periph_init_%
# modules are handled in Makefile. We need to define them to keep the list the
# same for now. We should be able to remove them later on.

# Include CPU specific configurations
osource "$(RIOTCPU)/$(CPU)/periph/Kconfig.spi"

endif # USEMODULE_PERIPH_SPI
```

## drivers/periph_common/Kconfig.timer
```kconfig
# SPDX-FileCopyrightText: 2020 HAW Hamburg
# SPDX-License-Identifier: LGPL-2.1-only

# Include CPU specific configurations
if USEMODULE_PERIPH_TIMER
menu "timer peripheral driver"

osource "$(RIOTCPU)/$(CPU)/periph/Kconfig.timer"

endmenu # timer peripheral driver
endif # USEMODULE_PERIPH_TIMER
```

## drivers/periph_common/Kconfig.uart
```kconfig
# Copyright (c) 2020 HAW Hamburg
#
# This file is subject to the terms and conditions of the GNU Lesser
# General Public License v2.1. See the file LICENSE in the top level
# directory for more details.
#

menuconfig MODULE_PERIPH_UART
    bool "UART peripheral driver"
    depends on HAS_PERIPH_UART
    select MODULE_PERIPH_COMMON

if MODULE_PERIPH_UART

# TODO: the 'init' modules are actually just artifacts from the way
# periph_init_% modules are handled in Makefile. We need to define them to keep
# the list the same for now. We should be able to remove them later on.

config MODULE_PERIPH_INIT_UART
    bool "Auto initialize UART peripheral"
    default y if MODULE_PERIPH_INIT

config MODULE_PERIPH_UART_MODECFG
    bool "Mode configuration support"
    depends on HAS_PERIPH_UART_MODECFG

config MODULE_PERIPH_LPUART
    bool "Enable Low Power UART (LPUART)"
    depends on HAS_PERIPH_LPUART

config MODULE_PERIPH_UART_COLLISION
    bool "Enable UART collision detection"
    depends on HAS_PERIPH_UART_COLLISION

config MODULE_PERIPH_UART_NONBLOCKING
    bool "Non-blocking support"
    depends on HAS_PERIPH_UART_NONBLOCKING

config MODULE_PERIPH_UART_RXSTART_IRQ
    bool "Enable Start Condition Interrupt"
    depends on HAS_PERIPH_UART_RXSTART_IRQ

config MODULE_PERIPH_INIT_UART_MODECFG
    bool
    depends on MODULE_PERIPH_UART_MODECFG
    default y if MODULE_PERIPH_INIT

config MODULE_PERIPH_INIT_UART_NONBLOCKING
    bool
    depends on MODULE_PERIPH_UART_NONBLOCKING
    default y if MODULE_PERIPH_INIT

config MODULE_PERIPH_INIT_LPUART
    bool
    depends on MODULE_PERIPH_LPUART
    default y if MODULE_PERIPH_INIT

config MODULE_PERIPH_UART_HW_FC
    bool
    depends on HAS_PERIPH_UART_HW_FC

config MODULE_PERIPH_INIT_UART_HW_FC
    bool
    depends on MODULE_PERIPH_UART_HW_FC
    default y if MODULE_PERIPH_INIT

endif # MODULE_PERIPH_UART
```

## drivers/periph_common/Kconfig.usbdev
```kconfig
# Copyright (c) 2020 HAW Hamburg
#               2022 Gunar Schorcht
#
# This file is subject to the terms and conditions of the GNU Lesser
# General Public License v2.1. See the file LICENSE in the top level
# directory for more details.
#

menuconfig MODULE_PERIPH_USBDEV
    bool "USBDEV peripheral driver"
    depends on HAS_PERIPH_USBDEV
    select MODULE_PERIPH_COMMON
    select MODULE_PERIPH_USBDEV_CLK

if MODULE_PERIPH_USBDEV

# TODO: the 'init' modules are actually just artifacts from the way
# periph_init_% modules are handled in Makefile. We need to define them to keep
# the list the same for now. We should be able to remove them later on.

config MODULE_PERIPH_INIT_USBDEV
    bool "Auto initialize USBDEV peripheral"
    default y if MODULE_PERIPH_INIT

config MODULE_PERIPH_USBDEV_HS
    bool "Use USB HS peripheral"
    depends on HAS_PERIPH_USBDEV_HS
    default y if MODULE_PERIPH_INIT_USBDEV_HS_ULPI || MODULE_PERIPH_USBDEV_HS_UTMI

config MODULE_PERIPH_INIT_USBDEV_HS
    bool
    depends on MODULE_PERIPH_USBDEV_HS
    default y if MODULE_PERIPH_INIT

config MODULE_PERIPH_USBDEV_HS_ULPI
    bool "Use USB HS peripheral with ULPI HS PHY"
    depends on HAS_PERIPH_USBDEV_HS_ULPI

config MODULE_PERIPH_INIT_USBDEV_HS_ULPI
    bool
    depends on MODULE_PERIPH_USBDEV_HS_ULPI
    default y if MODULE_PERIPH_INIT

config MODULE_PERIPH_USBDEV_HS_UTMI
    bool "Use USB HS peripheral with internal UTMI+ HS PHY"
    depends on HAS_PERIPH_USBDEV_HS_UTMI

config MODULE_PERIPH_INIT_USBDEV_HS_UTMI
    bool
    depends on MODULE_PERIPH_USBDEV_HS_UTMI
    default y if MODULE_PERIPH_INIT

endif

config MODULE_PERIPH_USBDEV_CLK
    bool
    help
        Enable the USB device specific clock settings, if there are any

config MODULE_PERIPH_INIT_USBDEV_CLK
    bool
    depends on MODULE_PERIPH_USBDEV_CLK
    default y if MODULE_PERIPH_INIT
```
