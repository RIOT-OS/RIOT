## drivers/lm75/Kconfig
```kconfig
menu "LM75 driver"
    depends on USEMODULE_LM75

config LM75_I2C_ADDR
    hex "Default I2C Address"
    range 0x48 0x4F
    default 0x48
    help
        The LM75A and TMP1075 allow for up to 8 and 32 devices, respectively, on a single bus.
        The address value depends on the state of the A0, A1 and A2 pins.
        Default value (0x48) corresponds to A0, A1 and A2 pins all connected to GND.
        For more information refer to the 'Slaves Address' section in the datasheet.

choice
    bool "Operation Mode"
    default NORMAL_MODE
    help
        Whether the device operates in normal or shutdown mode.

config NORMAL_MODE
    bool "Normal mode"

config SHUTDOWN_MODE
    bool "Shutdown mode"

endchoice


choice
    bool "Thermostat mode"
    default COMPARATOR_MODE
    help
        Defines whether the device operates is comparator or interrupt mode.
        The main difference between the two modes is that in comparator mode, the OS output becomes active
        when Temp has exceeded T_OS and reset when Temp has dropped below T_hyst, reading a register or
        putting the device into shutdown mode does not change the state of the OS output; while in interrupt mode,
        once it has been activated either by exceeding T_OS or dropping below T_hyst the OS output will remain active
        indefinitely until reading a register, then the OS output is reset.
        For more information please refer to the datasheet.

config COMPARATOR_MODE
    bool "Comparator mode"

config INTERRUPT_MODE
    bool "Interrupt mode"

endchoice


choice
    bool "OS pin polarity"
    default OS_ACTIVE_LOW
    help
        Define the polarity of the overtemperature shutdown(OS) pin.

config OS_ACTIVE_LOW
    bool "os active on low voltage"

config OS_ACTIVE_HIGH
    bool "os active on high voltage"

endchoice


choice
    bool "Fault Queue configuration"
    default FAULT_1
    help
        Define the number of consecutive faults that must occur for the OS pin to become active

config FAULT_1
    bool "1 fault"

config FAULT_2
    bool "2 faults"

config FAULT_3
    bool "3 faults - only available in the TMP1075 sensor"

config FAULT_4
    bool "4 faults"

config FAULT_6
    bool "6 faults - only available in the LM75A sensor"

endchoice


if USEMODULE_TMP1075

choice
    bool "Conversion rate"
    default TMP1075_CONV_RATE_REG_27H
    help
        Defines the frequency through which temperature conversions are performed and the temperature register is updated

config TMP1075_CONV_RATE_REG_27H
    bool "27.5 ms conversion rate"

config TMP1075_CONV_RATE_REG_55
    bool "55 ms conversion rate"

config TMP1075_CONV_RATE_REG_110
    bool "110 ms conversion rate"

config TMP1075_CONV_RATE_REG_220
    bool "220 ms conversion rate"


endchoice

endif # USEMODULE_TMP1075

endmenu # LM75 driver
```

## drivers/lpd8808/Kconfig
```kconfig
# Copyright (c) 2020 HAW Hamburg
#
# This file is subject to the terms and conditions of the GNU Lesser
# General Public License v2.1. See the file LICENSE in the top level
# directory for more details.
#

config MODULE_LPD8808
    bool "LPD8808 based LED Strip"
    depends on HAS_PERIPH_GPIO
    depends on TEST_KCONFIG
    select MODULE_PERIPH_GPIO
    select MODULE_COLOR
```

## drivers/lpm013m126/Kconfig
```kconfig
# Copyright (c) 2022 Nicole Faerber, Digitaluhr Manufaktur
#
# This file is subject to the terms and conditions of the GNU Lesser
# General Public License v2.1. See the file LICENSE in the top level
# directory for more details.
#

config MODULE_LPM013M126
    bool "LPM013M126 display driver"
    depends on HAS_PERIPH_SPI
    depends on HAS_PERIPH_GPIO
    depends on TEST_KCONFIG
    select MODULE_PERIPH_SPI
    select MODULE_PERIPH_GPIO
    select LVGL_UPDATE_FULL_LINES_ONLY if PACKAGE_LVGL

config HAVE_LPM013M126
    bool
    select MODULE_LPM013M126 if MODULE_DISP_DEV
    help
      Indicates that an LPM013M126 display is present.

menuconfig KCONFIG_USEMODULE_LPM013M126
    bool "Configure LPM013M126 driver"
    depends on USEMODULE_LPM013M126
    help
        Configure the LPM013M126 display driver using Kconfig.
```

## drivers/lpsxxx/Kconfig
```kconfig
# SPDX-FileCopyrightText: 2020 Freie Universitaet Berlin
# SPDX-FileCopyrightText: 2020 HAW Hamburg
# SPDX-License-Identifier: LGPL-2.1-only

menu "LPSXXX driver"
    depends on USEMODULE_LPSXXX

config LPSXXX_DEFAULT_ADDRESS
    hex "Default I2C address"
    range 0x5c 0x5d
    default 0x5d
    help
        The address depends on the status of SDO/SA0 Pin. Default
        address corresponds to SDO/SA0 connected to VDD. For more
        information refer to the section 'I2C operation' in the
        datasheet.

endmenu # LPSXXX driver
```

## drivers/lsm303agr/Kconfig
```kconfig
# Copyright (c) 2022 HAW Hamburg
#
# This file is subject to the terms and conditions of the GNU Lesser
# General Public License v2.1. See the file LICENSE in the top level
# directory for more details.
#

config MODULE_LSM303AGR
    bool
    prompt "LSM303AGR 3D accelerometer/magnetometer" if !(MODULE_SAUL_DEFAULT && HAVE_LSM303AGR)
    default y if (MODULE_SAUL_DEFAULT && HAVE_LSM303AGR)
    depends on HAS_PERIPH_I2C
    depends on TEST_KCONFIG
    select  MODULE_RUST_RIOTMODULES
    select MODULE_PERIPH_I2C

config HAVE_LSM303AGR
    bool
    help
        Indicates that a lsm303agr sensor is present.
```

## drivers/lsm303dlhc/Kconfig
```kconfig
# Copyright (c) 2020 HAW Hamburg
#
# This file is subject to the terms and conditions of the GNU Lesser
# General Public License v2.1. See the file LICENSE in the top level
# directory for more details.
#

config MODULE_LSM303DLHC
    bool
    prompt "LSM303DLHC 3D accelerometer/magnetometer" if !(MODULE_SAUL_DEFAULT && HAVE_LSM303DLHC)
    default y if (MODULE_SAUL_DEFAULT && HAVE_LSM303DLHC)
    depends on HAS_PERIPH_I2C
    depends on TEST_KCONFIG
    select MODULE_PERIPH_I2C

config HAVE_LSM303DLHC
    bool
    help
        Indicates that a lsm303dlhc sensor is present.
```
