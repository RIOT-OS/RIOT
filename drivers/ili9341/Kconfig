## drivers/ili9341/Kconfig
```kconfig
# SPDX-FileCopyrightText: 2020 HAW Hamburg
# SPDX-License-Identifier: LGPL-2.1-only

menu "ILI9341 driver"
    depends on USEMODULE_ILI9341

config ILI9341_GVDD
    int "GVDD voltage level (in millivolts)"
    default 4800
    range 3000 6000
    help
        Configure GVDD level, which is a reference level for the VCOM level and
        the grayscale voltage level. GVDD should be ≦ (AVDD - 0.5) V .

config ILI9341_VCOMH
    int "VCOMH voltage level (in millivolts)"
    default 4250
    range 2700 5875
    help
        Configure the high level of VCOM AC voltage. VCOM needs to be adjusted
        to match the capacitance and performance specifications of the TFT panel
        to maximize contrast and minimize flickering

config ILI9341_VCOML
    int "VCOML voltage level (in millivolts)"
    default -2000
    range -2500 0
    help
        Configure the low level of VCOM AC voltage. VCOM needs to be adjusted to
        match the capacitance and performance specifications of the TFT panel to
        maximize contrast and minimize flickering

endmenu # ILI9341 driver
```

## drivers/ina2xx/Kconfig
```kconfig
# Copyright (c) 2020 HAW Hamburg
#
# This file is subject to the terms and conditions of the GNU Lesser
# General Public License v2.1. See the file LICENSE in the top level
# directory for more details.
#

menuconfig MODULE_INA2XX
    bool
    prompt "INA2XX current/power monitor" if !(MODULE_SAUL_DEFAULT && HAVE_INA2XX)
    default (MODULE_SAUL_DEFAULT && HAVE_INA2XX)
    depends on HAS_PERIPH_I2C
    depends on TEST_KCONFIG
    select MODULE_PERIPH_I2C

choice INA2XX_VARIANT
    bool "Variant"
    depends on MODULE_INA2XX
    default MODULE_INA219 if HAVE_INA219
    default MODULE_INA220 if HAVE_INA220
    help
        Select one of the supported models.

config MODULE_INA219
    bool "INA219"

config MODULE_INA220
    bool "INA220"

endchoice

config HAVE_INA2XX
    bool
    help
        Indicates that a INA2XX current/power monitor is present.

config HAVE_INA219
    bool
    select HAVE_INA2XX
    help
        Indicates that a INA219 current/power monitor is present.

config HAVE_INA220
    bool
    select HAVE_INA2XX
    help
        Indicates that a INA220 current/power monitor is present.
```

## drivers/ina3221/Kconfig
```kconfig
# Copyright (c) 2020 HAW Hamburg
#
# This file is subject to the terms and conditions of the GNU Lesser
# General Public License v2.1. See the file LICENSE in the top level
# directory for more details.
#

menuconfig MODULE_INA3221
    bool
    prompt "INA3221 current/power monitor" if !(MODULE_SAUL_DEFAULT && HAVE_INA3221)
    default (MODULE_SAUL_DEFAULT && HAVE_INA3221)
    depends on HAS_PERIPH_GPIO
    depends on HAS_PERIPH_I2C
    depends on TEST_KCONFIG
    select MODULE_PERIPH_GPIO
    select MODULE_PERIPH_I2C

config MODULE_INA3221_ALERTS
    bool "Alert pins"
    depends on HAS_PERIPH_GPIO_IRQ
    depends on MODULE_INA3221
    select MODULE_PERIPH_GPIO_IRQ
    default HAVE_INA3221_ALERTS
    help
        Say y to enable the usage of alert pins.

config HAVE_INA3221
    bool
    help
        Indicates that a INA3221 current/power monitor is present.

config HAVE_INA3221_ALERTS
    bool
    select HAVE_INA3221
    help
        Indicates that a INA3221 current/power monitor is present with alert pins wired.
```

## drivers/inc_encoder/Kconfig
```kconfig
# SPDX-FileCopyrightText: 2025 TU Dresden
# SPDX-License-Identifier: LGPL-2.1-only

config MODULE_INC_ENCODER
    bool "Incremental Rotary Encoder"
    depends on TEST_KCONFIG


menu "Incremental Rotary Encoder Driver"
    depends on USEMODULE_INC_ENCODER

    config INC_ENCODER_MAX_RPM
        int "Maximum RPM"
        default 210
        help
            Defines the maximum RPM the encoder is expected to handle.

    config INC_ENCODER_GEAR_RED_RATIO
        int "Gear Reduction Ratio (in tenths)"
        default 204
        help
            Defines the gear reduction ratio. For example a gear reduction ratio
            of 1:20.4 would result in a value of 204.

    config INC_ENCODER_PPR
        int "Pulses per Revolution"
        default 13
        help
            Number of Rising Edges per Revolution.

    config INC_ENCODER_HARDWARE_PERIOD_MS
        int "RPM Calculation Period (in ms)"
        depends on USEMODULE_INC_ENCODER_HARDWARE
        default 200
        help
            Time period in milliseconds for RPM calculation.

endmenu # Incremental Encoder Driver
```

## drivers/isl29020/Kconfig
```kconfig
# SPDX-FileCopyrightText: 2020 Freie Universitaet Berlin
# SPDX-FileCopyrightText: 2020 HAW Hamburg
# SPDX-License-Identifier: LGPL-2.1-only

menu "ISL29020 driver"
    depends on USEMODULE_ISL29020

config ISL29020_DEFAULT_ADDRESS
    hex "Default I2C address"
    range 0x44 0x45
    default 0x44
    help
        The address depends on the status of A0 Pin. Default address
        corresponds to A0 connected to GND. For more information refer to the
        section 'I2C Interface' in the datasheet.

endmenu # ISL29020 driver
```

## drivers/itg320x/Kconfig
```kconfig
# Copyright (c) 2020 HAW Hamburg
#
# This file is subject to the terms and conditions of the GNU Lesser
# General Public License v2.1. See the file LICENSE in the top level
# directory for more details.
#

menuconfig MODULE_ITG320X
    bool "ITG320X 3-axis gyroscope"
    depends on HAS_PERIPH_I2C
    depends on TEST_KCONFIG
    select MODULE_PERIPH_I2C
    select MODULE_XTIMER
    help
        The driver can be used with InvenSense ITG3200, ITG3205, and MPU3050.

config MODULE_ITG320X_INT
    bool "Interrupt mode"
    depends on MODULE_ITG320X
    depends on HAS_PERIPH_GPIO_IRQ
    select MODULE_PERIPH_GPIO_IRQ
    help
        Say y to fetch the data when the data-ready interrupt is triggered.
```

## drivers/kw2xrf/Kconfig
```kconfig
# Copyright (c) 2022 HAW Hamburg
#
# This file is subject to the terms and conditions of the GNU Lesser
# General Public License v2.1. See the file LICENSE in the top level
# directory for more details.
#

menuconfig MODULE_KW2XRF
    bool
    prompt "KW2XRF radio" if !(MODULE_NETDEV_DEFAULT && HAVE_KW2XRF)
    default (MODULE_NETDEV_DEFAULT && HAVE_KW2XRF)
    depends on TEST_KCONFIG
    depends on HAS_PERIPH_GPIO
    depends on HAS_PERIPH_GPIO_IRQ
    depends on HAS_PERIPH_SPI
    select MODULE_CORE_THREAD_FLAGS
    select MODULE_IEEE802154
    select MODULE_LUID
    select MODULE_PERIPH_GPIO
    select MODULE_PERIPH_GPIO_IRQ
    select MODULE_PERIPH_SPI
    select MODULE_IOLIST
    select HAVE_BHP_IRQ_HANDLER
    select HAVE_IEEE802154_RADIO_HAL_INTERFACE

config MODULE_KW2XRF_TESTMODE
    bool "Test mode"
    depends on MODULE_KW2XRF
    help
        Enables functionalities to help with module testing.

config HAVE_KW2XRF
    bool
    help
        Indicates that a KW2XRF radio is present.
```

## drivers/kw41zrf/Kconfig
```kconfig
# Copyright (c) 2022 HAW Hamburg
#
# This file is subject to the terms and conditions of the GNU Lesser
# General Public License v2.1. See the file LICENSE in the top level
# directory for more details.
#

config MODULE_KW41ZRF
    bool "KW41ZRF radio"
    depends on TEST_KCONFIG
    depends on CPU_MODEL_MKW41Z256VHT4 || CPU_MODEL_MKW41Z512VHT4
    select MODULE_MCUX_XCVR_MKW41Z
    select MODULE_IEEE802154
    select MODULE_NETDEV
    select MODULE_NETDEV_IEEE802154
    select MODULE_CORE_THREAD_FLAGS
    select MODULE_RANDOM
    help
      Device driver for the NXP KW41Z, KW21Z in-cpu transceiver.

rsource "vendor/XCVR/MKW41Z4/Kconfig"

config HAVE_KW41ZRF
    bool
    select MODULE_KW41ZRF if MODULE_NETDEV_DEFAULT
    help
        Indicates that a KW41ZRF radio is present.
```

## drivers/kw41zrf/vendor/XCVR/MKW41Z4/Kconfig
```kconfig
# Copyright (c) 2022 HAW Hamburg
#
# This file is subject to the terms and conditions of the GNU Lesser
# General Public License v2.1. See the file LICENSE in the top level
# directory for more details.
#

config MODULE_MCUX_XCVR_MKW41Z
    bool
    help
        Vendor code for the kw41zrf driver.
```

## drivers/l3g4200d/Kconfig
```kconfig
# SPDX-FileCopyrightText: 2020 Freie Universitaet Berlin
# SPDX-FileCopyrightText: 2020 HAW Hamburg
# SPDX-License-Identifier: LGPL-2.1-only

menu "L3G4200D driver"
    depends on USEMODULE_L3G4200D

config L3G4200D_DEFAULT_ADDRESS
    hex "Default I2C address"
    range 0x68 0x69
    default 0x68
    help
        The address depends on the status of SDO Pin. Default
        address corresponds to SDO connected to GND. For more
        information refer to the section 'I2C Operation' in
        the datasheet.

endmenu # L3G4200D driver
```
