## cpu/native/mtd/Kconfig
```kconfig
# Copyright (c) 2021 HAW Hamburg
#
# This file is subject to the terms and conditions of the GNU Lesser
# General Public License v2.1. See the file LICENSE in the top level
# directory for more details.
#

config MODULE_MTD_NATIVE
    bool
    default y if MODULE_MTD
    depends on NATIVE_OS_LINUX
    depends on TEST_KCONFIG
```

## cpu/native/netdev_tap/Kconfig
```kconfig
# Copyright (c) 2020 HAW Hamburg
#
# This file is subject to the terms and conditions of the GNU Lesser
# General Public License v2.1. See the file LICENSE in the top level
# directory for more details.
#

config MOD_NETDEV_TAP
    bool "Low-level ethernet driver for tap interfaces"
    default y if MOD_NETDEV_DEFAULT
    depends on MOD_NETIF
    depends on MOD_NETDEV_ETH
    depends on CPU_ARCH_NATIVE
    select MOD_IOLIST

config HAVE_TAP
    bool
    select HAVE_NETDEV_ETHERNET
    help
        Indicates that a tap interface is present.
```

## cpu/native/periph/Kconfig
```kconfig
# Copyright (c) 2020 HAW Hamburg
#
# This file is subject to the terms and conditions of the GNU Lesser
# General Public License v2.1. See the file LICENSE in the top level
# directory for more details.
#

config MODULE_PERIPH_SPIDEV_LINUX
    bool
    default y if MODULE_PERIPH_SPI
    depends on NATIVE_OS_LINUX

config MODULE_PERIPH_INIT_SPIDEV_LINUX
    bool
    default y
    depends on MODULE_PERIPH_SPIDEV_LINUX

config MODULE_PERIPH_CAN
    bool
    depends on HAS_PERIPH_CAN
    select PACKAGE_LIBSOCKETCAN
    help
        Native CAN peripheral controller.

config MODULE_PERIPH_INIT_CAN
    bool "Auto initialize CAN peripheral"
    default y if MODULE_PERIPH_INIT
    depends on MODULE_PERIPH_CAN
```

## cpu/native/periph/Kconfig.gpio
```kconfig
# Copyright (c) 2020 HAW Hamburg
#
# This file is subject to the terms and conditions of the GNU Lesser
# General Public License v2.1. See the file LICENSE in the top level
# directory for more details.
#

choice NATIVE_GPIO_IMPLEMENTATION
    bool "Native GPIO peripheral implementation"
    depends on MODULE_PERIPH_GPIO
    depends on CPU_ARCH_NATIVE
    depends on TEST_KCONFIG
    default MODULE_PERIPH_GPIO_LINUX if NATIVE_OS_LINUX

config MODULE_PERIPH_GPIO_LINUX
    bool "Linux GPIO"
    depends on NATIVE_OS_LINUX

config MODULE_PERIPH_GPIO_MOCK
    bool "Mock"

endchoice

# TODO: these modules are actually just artifacts from the way periph_init_%
# modules are handled in Makefile. We need to define them to keep the list the
# same for now. We should be able to remove them later on.

config MODULE_PERIPH_INIT_GPIO_LINUX
    bool
    default y if MODULE_PERIPH_INIT
    depends on MODULE_PERIPH_GPIO_LINUX

config MODULE_PERIPH_INIT_GPIO_MOCK
    bool
    default y if MODULE_PERIPH_INIT
    depends on MODULE_PERIPH_GPIO_MOCK
```

## cpu/native/periph/Kconfig.rtc
```kconfig
# Copyright (c) 2020 HAW Hamburg
#
# This file is subject to the terms and conditions of the GNU Lesser
# General Public License v2.1. See the file LICENSE in the top level
# directory for more details.
#

config MODULE_PERIPH_RTC
    select MODULE_ZTIMER if CPU_ARCH_NATIVE
    select MODULE_ZTIMER_MSEC if CPU_ARCH_NATIVE
    depends on HAS_PERIPH_RTC
```

## cpu/native/socket_zep/Kconfig
```kconfig
menuconfig MODULE_SOCKET_ZEP
    bool "Socket-based ZEP"
    depends on CPU_MODEL_NATIVE
    depends on TEST_KCONFIG
    select MODULE_IOLIST
    select MODULE_CHECKSUM
    select MODULE_RANDOM
    select MODULE_IEEE802154
    help
      UDP socket-based IEEE 802.15.4 device over ZEP

config MODULE_SOCKET_ZEP_HELLO
    bool "Send a dummy HELLO packet on startup"
    depends on MODULE_SOCKET_ZEP
    help
      Say y to send a dummy HELLO packet on startup. This is used to make
      dispatchers aware of the node.
```

## cpu/native/vfs/Kconfig
```kconfig
# Copyright (c) 2021 HAW Hamburg
#
# This file is subject to the terms and conditions of the GNU Lesser
# General Public License v2.1. See the file LICENSE in the top level
# directory for more details.
#

config MODULE_NATIVE_VFS
    bool
    depends on HAS_ARCH_NATIVE
    default y if MODULE_VFS
```

## cpu/nrf51/Kconfig
```kconfig
# SPDX-FileCopyrightText: 2020 Freie Universität Berlin
# SPDX-FileCopyrightText: 2020 HAW Hamburg
# SPDX-License-Identifier: LGPL-2.1-only

config CPU_FAM_NRF51
    bool
    select CPU_CORE_CORTEX_M0
    select CPU_COMMON_NRF5X

## CPU Models
config CPU_MODEL_NRF51X22XXAA
    bool
    select CPU_FAM_NRF51

config CPU_MODEL_NRF51X22XXAB
    bool
    select CPU_FAM_NRF51

config CPU_MODEL_NRF51X22XXAC
    bool
    select CPU_FAM_NRF51

## CPU common symbols
config CPU_FAM
    default "nrf51" if CPU_FAM_NRF51

config CPU_MODEL
    default "nrf51x22xxaa" if CPU_MODEL_NRF51X22XXAA
    default "nrf51x22xxab" if CPU_MODEL_NRF51X22XXAB
    default "nrf51x22xxac" if CPU_MODEL_NRF51X22XXAC

config CPU
    default "nrf51" if CPU_FAM_NRF51

## Platform-specific defaults
config GNRC_PKTBUF_SIZE
    default 2048
    depends on USEMODULE_GNRC_PKTBUF_STATIC

source "$(RIOTCPU)/nrf5x_common/Kconfig"
```

## cpu/nrf52/Kconfig
```kconfig
# SPDX-FileCopyrightText: 2020 HAW Hamburg
# SPDX-License-Identifier: LGPL-2.1-only

config CPU_FAM_NRF52
    bool
    select CPU_COMMON_NRF5X

## CPU Models
config CPU_MODEL_NRF52805XXAA
    bool
    select CPU_CORE_CORTEX_M4
    select CPU_FAM_NRF52

config CPU_MODEL_NRF52810XXAA
    bool
    select CPU_CORE_CORTEX_M4
    select CPU_FAM_NRF52

config CPU_MODEL_NRF52811XXAA
    bool
    select CPU_CORE_CORTEX_M4
    select CPU_FAM_NRF52

config CPU_MODEL_NRF52820XXAA
    bool
    select CPU_CORE_CORTEX_M4
    select CPU_FAM_NRF52

config CPU_MODEL_NRF52832XXAA
    bool
    select CPU_FAM_NRF52
    select CPU_CORE_CORTEX_M4F

config CPU_MODEL_NRF52833XXAA
    bool
    select CPU_CORE_CORTEX_M4F
    select CPU_FAM_NRF52

config CPU_MODEL_NRF52840XXAA
    bool
    select CPU_CORE_CORTEX_M4F
    select CPU_FAM_NRF52

## CPU common symbols
config CPU_FAM
    default "nrf52" if CPU_FAM_NRF52

config CPU_MODEL
    default "nrf52805xxaa" if CPU_MODEL_NRF52805XXAA
    default "nrf52810xxaa" if CPU_MODEL_NRF52810XXAA
    default "nrf52811xxaa" if CPU_MODEL_NRF52811XXAA
    default "nrf52820xxaa" if CPU_MODEL_NRF52820XXAA
    default "nrf52832xxaa" if CPU_MODEL_NRF52832XXAA
    default "nrf52833xxaa" if CPU_MODEL_NRF52833XXAA
    default "nrf52840xxaa" if CPU_MODEL_NRF52840XXAA

config CPU
    default "nrf52" if CPU_FAM_NRF52

source "$(RIOTCPU)/nrf5x_common/Kconfig"
```

## cpu/nrf52/periph/Kconfig
```kconfig
# Copyright (c) 2021 Inria
#
# This file is subject to the terms and conditions of the GNU Lesser
# General Public License v2.1. See the file LICENSE in the top level
# directory for more details.
#

if TEST_KCONFIG

config MODULE_SAUL_NRF_VDDH
    bool "Internal Voltage Sensor"
    depends on HAS_PERIPH_ADC
    select MODULE_PERIPH_ADC

config MODULE_PERIPH_CRYPTOCELL_310
    bool
    depends on HAS_PERIPH_CRYPTOCELL_310
    select PACKAGE_DRIVER_CRYPTOCELL_310

# Asymmetric Crypto Peripheral
config MODULE_PERIPH_ECC_P192R1
    bool
    depends on HAS_PERIPH_ECC_P192R1
    select MODULE_PERIPH_CRYPTOCELL_310
    select MODULE_PSA_CRYPTOCELL_310_ECC_P192

config MODULE_PERIPH_ECC_P256R1
    bool
    depends on HAS_PERIPH_ECC_P256R1
    select MODULE_PERIPH_CRYPTOCELL_310
    select MODULE_PSA_CRYPTOCELL_310_ECC_P256

# Hash Related Symbols
config MODULE_PERIPH_HASH_SHA_1
    bool
    depends on HAS_PERIPH_HASH_SHA_1
    select MODULE_PERIPH_CRYPTOCELL_310
    select MODULE_PSA_CRYPTOCELL_310_HASHES_SHA1

config MODULE_PERIPH_HASH_SHA_224
    bool
    depends on HAS_PERIPH_HASH_SHA_224
    select MODULE_PERIPH_CRYPTOCELL_310
    select MODULE_PSA_CRYPTOCELL_310_HASHES_SHA224

config MODULE_PERIPH_HASH_SHA_256
    bool
    depends on HAS_PERIPH_HASH_SHA_256
    select MODULE_PERIPH_CRYPTOCELL_310
    select MODULE_PSA_CRYPTOCELL_310_HASHES_SHA256

config MODULE_PERIPH_HASH_SHA_512
    bool
    depends on HAS_PERIPH_HASH_SHA_512
    select MODULE_PERIPH_CRYPTOCELL_310
    select MODULE_PSA_CRYPTOCELL_310_HASHES_SHA512

config MODULE_PERIPH_CIPHER_AES_128_CBC
    bool
    depends on HAS_PERIPH_CIPHER_AES_128_CBC
    select MODULE_PERIPH_CRYPTOCELL_310
    select MODULE_PSA_CRYPTOCELL_310_AES_CBC

config MODULE_PERIPH_HMAC_SHA_256
    bool
    depends on HAS_PERIPH_HMAC_SHA_256
    select MODULE_PERIPH_CRYPTOCELL_310
    select MODULE_PSA_CRYPTOCELL_310_HMAC

endif # TEST_KCONFIG

config HAVE_SAUL_NRF_VDDH
    bool
    select MODULE_SAUL_NRF_VDDH if MODULE_SAUL_DEFAULT
    help
        Indicates that internal voltage sensor is present.
```

## cpu/nrf52/radio/nrf802154/Kconfig
```kconfig
# Copyright (c) 2020 HAW Hamburg
#
# This file is subject to the terms and conditions of the GNU Lesser
# General Public License v2.1. See the file LICENSE in the top level
# directory for more details.

menu "nRF802154"
    depends on USEMODULE_NRF802154

config NRF802154_CCA_THRESH_DEFAULT
    hex "Default CCA threshold value"
    default 0x14
    range 0x00 0xFF
    help
        Default CCA threshold value for the CCACTRL register.

endmenu # nRF802154
```

## cpu/nrf53/Kconfig
```kconfig
# SPDX-FileCopyrightText: 2023 Mesotic SAS
# SPDX-License-Identifier: LGPL-2.1-only

# For now, define all features here
# We will rely on nrf5x_common later when we support more peripherals
config CPU_FAM_NRF53
    bool

## CPU Models
config CPU_MODEL_NRF5340_APP
    bool
    select CPU_CORE_CORTEX_M33
    select CPU_FAM_NRF53

## CPU common symbols
config CPU_FAM
    default "nrf53" if CPU_FAM_NRF53

config CPU_MODEL
    default "nrf5340_app" if CPU_MODEL_NRF5340_APP


config CPU
    default "nrf53" if CPU_FAM_NRF53

source "$(RIOTCPU)/nrf5x_common/Kconfig"
```

## cpu/nrf54l/Kconfig
```kconfig
# SPDX-FileCopyrightText: 2026 Inria
# SPDX-License-Identifier: LGPL-2.1-only

config CPU_FAM_NRF54L
    bool

## CPU Models
config CPU_MODEL_NRF54L15XXAA
    bool
    select CPU_CORE_CORTEX_M33
    select CPU_FAM_NRF54L

## CPU common symbols
config CPU_FAM
    default "nrf54l" if CPU_FAM_NRF54L

config CPU_MODEL
    default "nrf54l15xxaa" if CPU_MODEL_NRF54L15XXAA

config CPU
    default "nrf54l" if CPU_FAM_NRF54L

source "$(RIOTCPU)/nrf5x_common/Kconfig"
```

## cpu/nrf5x_common/Kconfig
```kconfig
# SPDX-FileCopyrightText: 2020 HAW Hamburg
# SPDX-License-Identifier: LGPL-2.1-only

config CPU_COMMON_NRF5X
depends on !CPU_FAM_NRF53
    bool

source "$(RIOTCPU)/cortexm_common/Kconfig"
```

## cpu/nrf5x_common/periph/Kconfig.nrf5x
```kconfig
# Copyright (c) 2021 Inria
#
# This file is subject to the terms and conditions of the GNU Lesser
# General Public License v2.1. See the file LICENSE in the top level
# directory for more details.
#

config HAVE_SAUL_NRF_TEMPERATURE
    bool
    select MODULE_SAUL_NRF_TEMPERATURE if MODULE_SAUL_DEFAULT && HAS_PERIPH_TEMPERATURE
    help
        Indicates that a SAUL wrapper to the temperature peripheral is present.

if TEST_KCONFIG

config MODULE_NRF5X_COMMON_PERIPH
    bool
    default y
    help
        nrf52 common peripheral code.

config MODULE_VDD_LC_FILTER_REG0
    bool
    depends on HAS_VDD_LC_FILTER_REG0
    default y
    help
        Use the LC filter attached to the CPUs voltage regulator

config MODULE_VDD_LC_FILTER_REG1
    bool
    depends on HAS_VDD_LC_FILTER_REG1
    default y
    help
        Use the LC filter attached to the CPUs voltage regulator

config MODULE_PERIPH_UART_NONBLOCKING
    depends on HAS_PERIPH_UART_NONBLOCKING
    depends on MODULE_PERIPH_UART
    select MODULE_TSRB

config MODULE_PERIPH_SPI
    depends on HAS_PERIPH_SPI
    select MODULE_PERIPH_GPIO_IRQ if CPU_MODEL_NRF52832XXAA && HAS_PERIPH_GPIO_IRQ
    select MODULE_PERIPH_SPI_GPIO_MODE if MODULE_PERIPH_SPI && HAS_PERIPH_SPI_GPIO_MODE

endif # TEST_KCONFIG
```

## cpu/nrf5x_common/radio/Kconfig.nrf5x
```kconfig
# Copyright (c) 2021 Inria
#
# This file is subject to the terms and conditions of the GNU Lesser
# General Public License v2.1. See the file LICENSE in the top level
# directory for more details.
#

config HAVE_NRF5X_RADIO
    bool
    select NRF5X_RADIO if MODULE_NETDEV_DEFAULT
    help
        Indicates that an NRF5X radio is present.

if TEST_KCONFIG

menuconfig NRF5X_RADIO
    bool "nrf5x radio driver"
    depends on HAVE_NRF5X_RADIO
    depends on TEST_KCONFIG

if NRF5X_RADIO

choice NRF5X_RADIO_BACKEND
    bool "nrf5x radio backend"

config MODULE_NRF802154
    bool "Implementation of the IEEE 802.15.4 for nRF52 radio"
    depends on HAS_RADIO_NRF802154
    depends on HAS_PERIPH_TIMER
    select MODULE_LUID
    select MODULE_PERIPH_TIMER
    select MODULE_IEEE802154

config MODULE_NRFBLE
    bool "Bluetooth low energy radio driver"
    depends on HAS_RADIO_NRFBLE
    help
        Bluetooth low energy radio driver for nRF5x SoCs

config MODULE_NRFMIN
    bool "nrfmin radio driver"
    depends on HAS_RADIO_NRFMIN
    help
        nrfmin radio driver for nRF51 radios

endchoice

endif # NRF5X_RADIO

endif # TEST_KCONFIG

rsource "$(RIOTCPU)/nrf52/radio/nrf802154/Kconfig"
```

## cpu/nrf5x_common/radio/nrf802154/Kconfig
```kconfig
# SPDX-FileCopyrightText: 2020 HAW Hamburg
# SPDX-License-Identifier: LGPL-2.1-only

menu "nRF802154"
    depends on USEMODULE_NRF802154

config NRF802154_CCA_THRESH_DEFAULT
    hex "Default CCA threshold value"
    default 0x14
    range 0x00 0xFF
    help
        Default CCA threshold value for the CCACTRL register.

endmenu # nRF802154
```

## cpu/nrf5x_common/shared_irq/Kconfig
```kconfig
# Copyright (c) 2023 Mesotic SAS
#
# This file is subject to the terms and conditions of the GNU Lesser
# General Public License v2.1. See the file LICENSE in the top level
# directory for more details.
#

config MODULE_NRF_SHARED_SERIAL_IRQ
    bool
    depends on TEST_KCONFIG
    default y
```

## cpu/nrf9160/Kconfig
```kconfig
# Copyright (c) 2021 Mesotic SAS
#
# This file is subject to the terms and conditions of the GNU Lesser
# General Public License v2.1. See the file LICENSE in the top level
# directory for more details.

config CPU_FAM_NRF9160
    bool

## CPU Models
config CPU_MODEL_NRF9160
    bool
    select CPU_CORE_CORTEX_M33
    select CPU_FAM_NRF9160

## CPU common symbols
config CPU_FAM
    default "nrf9160" if CPU_FAM_NRF9160

config CPU_MODEL
    default "nrf9160" if CPU_MODEL_NRF9160

config CPU
    default "nrf9160" if CPU_FAM_NRF9160

source "$(RIOTCPU)/nrf5x_common/Kconfig"
```

## cpu/nrf9160/periph/Kconfig
```kconfig
# Copyright (c) 2022 Inria
#
# This file is subject to the terms and conditions of the GNU Lesser
# General Public License v2.1. See the file LICENSE in the top level
# directory for more details.
#

if TEST_KCONFIG

config MODULE_PERIPH_SPI
    depends on HAS_PERIPH_SPI
    select MODULE_PERIPH_SPI_GPIO_MODE if MODULE_PERIPH_SPI && HAS_PERIPH_SPI_GPIO_MODE

config MODULE_SAUL_NRF_VDDH
    bool "Internal Voltage Sensor"
    depends on HAS_PERIPH_ADC

endif # TEST_KCONFIG
```

## cpu/qn908x/Kconfig
```kconfig
# SPDX-FileCopyrightText: 2020 iosabi
# SPDX-License-Identifier: LGPL-2.1-only

config CPU_FAM_QN908X
    bool
    select CPU_CORE_CORTEX_M4F

## CPU Models
# For cpus QN9080CHN (revision C) and QN9080DHN (revision D)
config CPU_MODEL_QN9080XHN
    bool
    select CPU_FAM_QN908X

# For the smaller package for the same die, with 28 GPIOs instead of 35.
# cpus QN9083CUK (revision C) and QN9083DUK (revision D)
config CPU_MODEL_QN9083XUK
    bool
    select CPU_FAM_QN908X

## CPU common symbols
config CPU_FAM
    default "qn908x" if CPU_FAM_QN908X

config CPU_MODEL
    default "qn9080xhn" if CPU_MODEL_QN9080XHN
    default "qn9083xhk" if CPU_MODEL_QN9083XUK

config CPU
    default "qn908x" if CPU_FAM_QN908X

# Other cpu configuration
rsource "Kconfig.clk"

source "$(RIOTCPU)/cortexm_common/Kconfig"
```
