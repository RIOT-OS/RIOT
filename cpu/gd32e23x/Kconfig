## cpu/gd32e23x/Kconfig
```kconfig
# Copyright (C) 2023 Bissell
#
# This file is subject to the terms and conditions of the GNU Lesser
# General Public License v2.1. See the file LICENSE in the top level
# directory for more details.
#

config CPU_GD32E23X
    bool
    select CPU_CORE_CORTEX_M23
    select HAS_CPU_GD32E23X
    select HAS_PERIPH_CPUID
    select HAS_PERIPH_GPIO
    select HAS_PERIPH_PWM
    select HAS_PERIPH_TIMER



config CPU_MODEL_GD32E230C
    bool
    select CPU_FAM_GD32E23X

## Definition of specific features
config HAS_CPU_GD32E23X
    bool
    help
        Indicates that a 'gd32e23x' cpu is being used.

config CPU_FAM
    default "gd32e23x" if CPU_FAM_GD32E23X

config CPU_MODEL
    default "gd32e230c" if CPU_MODEL_GD32E230C

config CPU
    default "gd32e23x" if CPU_FAM_GD32E23X

source "$(RIOTCPU)/cortexm_common/Kconfig"
```

## cpu/gd32f3x0/Kconfig
```kconfig
# Copyright (C) 2023 BISSELL Homecare, Inc.
#
# This file is subject to the terms and conditions of the GNU Lesser
# General Public License v2.1. See the file LICENSE in the top level
# directory for more details.
#

config CPU_GD32F3X0
    bool
    select CPU_CORE_CORTEX_M4
    select HAS_CPU_GD32F3X0
    select HAS_PERIPH_CPUID
    select HAS_PERIPH_GPIO
    select HAS_PERIPH_PWM
    select HAS_PERIPH_TIMER



config CPU_MODEL_GD32F310C
    bool
    select CPU_FAM_GD32F3X0

## Definition of specific features
config HAS_CPU_GD32F3X0
    bool
    help
        Indicates that a 'gd32f3x0' cpu is being used.

config CPU_FAM
    default "gd32f3x0" if CPU_FAM_GD32F3X0

config CPU_MODEL
    default "gd32f310c" if CPU_MODEL_GD32F310C

config CPU
    default "gd32f3x0" if CPU_FAM_GD32F3X0

source "$(RIOTCPU)/cortexm_common/Kconfig"
```

## cpu/gd32v/Kconfig
```kconfig
# SPDX-FileCopyrightText: 2020 Inria
# SPDX-License-Identifier: LGPL-2.1-only

config CPU_FAM_GD32V
    bool
    select CPU_CORE_RV32IMAC

menu "GD32V configuration"

config CPU_MODEL_GD32VF103CBT6
    bool
    select CPU_FAM_GD32V

config CPU_MODEL_GD32VF103VBT6
    bool
    select CPU_FAM_GD32V

config CPU_FAM
    default "gd32v" if CPU_FAM_GD32V

config CPU_MODEL
    default "gd32vf103cbt6"  if CPU_MODEL_GD32VF103CBT6

config CPU_MODEL
    default "gd32vf103vbt6"  if CPU_MODEL_GD32VF103VBT6

config CPU
    default "gd32v" if CPU_FAM_GD32V

config CPU_CORE
    default "rv32imac" if CPU_CORE_RV32IMAC

rsource "periph/Kconfig"

endmenu

source "$(RIOTCPU)/riscv_common/Kconfig"
```

## cpu/gd32v/periph/Kconfig
```kconfig
# SPDX-FileCopyrightText: 2021 HAW Hamburg
# SPDX-License-Identifier: LGPL-2.1-only

config PM_EWUP_USED
    bool "Use PA0/WKUP pin"
    depends on USEMODULE_PM_LAYERED
    help
        If enabled, the PA0/WKUP pin can be used to wake up the MCU from standby mode.
```

## cpu/imx8-m4/Kconfig
```kconfig
# Copyright (c) 2020 Mesotic SAS
#
# This file is subject to the terms and conditions of the GNU Lesser
# General Public License v2.1. See the file LICENSE in the top level
# directory for more details.
#

config CPU_IMX8_M4
    bool
    select CPU_CORE_CORTEX_M4F
    select HAS_PERIPH_GPIO
    select HAS_PERIPH_GPIO_IRQ

config CPU_MODEL_IMX8MQ
    bool
    select CPU_IMX8_M4

config CPU_MODEL
    default "imx8mq" if CPU_MODEL_IMX8MQ

source "$(RIOTCPU)/cortexm_common/Kconfig"
```

## cpu/kinetis/Kconfig
```kconfig
# SPDX-FileCopyrightText: 2020 HAW Hamburg
# SPDX-License-Identifier: LGPL-2.1-only

config CPU_COMMON_KINETIS
    bool

config CPU_FAM_EA
    bool
    select CPU_COMMON_KINETIS

config CPU_FAM_K
    bool
    select CPU_COMMON_KINETIS

config CPU_FAM_L
    bool
    select CPU_COMMON_KINETIS

config CPU_FAM_W
    bool
    select CPU_COMMON_KINETIS

## CPU Models
config CPU_MODEL_MK20DX256VLH7
    bool
    select CPU_CORE_CORTEX_M4
    select CPU_FAM_K

config CPU_MODEL_MK22FN512VLH12
    bool
    select CPU_CORE_CORTEX_M4F
    select CPU_FAM_K

config CPU_MODEL_MKL43Z256VLH4
    bool
    select CPU_CORE_CORTEX_M0PLUS
    select CPU_FAM_L

config CPU_MODEL_MKL43Z256VMP4
    bool
    select CPU_CORE_CORTEX_M0PLUS
    select CPU_FAM_L

config CPU_MODEL_MKL43Z128VLH4
    bool
    select CPU_CORE_CORTEX_M0PLUS
    select CPU_FAM_L

config CPU_MODEL_MKL43Z128VMP4
    bool
    select CPU_CORE_CORTEX_M0PLUS
    select CPU_FAM_L

config CPU_MODEL_MK60DN512VLL10
    bool
    select CPU_CORE_CORTEX_M4
    select CPU_FAM_K

config CPU_MODEL_MK64FN1M0VLL12
    bool
    select CPU_CORE_CORTEX_M4F
    select CPU_FAM_K

config CPU_MODEL_MKW21D256VHA5
    bool
    select CPU_CORE_CORTEX_M4
    select CPU_FAM_W

config CPU_MODEL_MKW21D512VHA5
    bool
    select CPU_CORE_CORTEX_M4
    select CPU_FAM_W

config CPU_MODEL_MKW22D512VHA5
    bool
    select CPU_CORE_CORTEX_M4
    select CPU_FAM_W

config CPU_MODEL_MKW41Z256VHT4
    bool
    select CPU_CORE_CORTEX_M0PLUS
    select CPU_FAM_W

config CPU_MODEL_MKW41Z512VHT4
    bool
    select CPU_CORE_CORTEX_M0PLUS
    select CPU_FAM_W

config CPU_MODEL_S9KEAZ128ACLH
    bool
    select CPU_CORE_CORTEX_M4
    select CPU_FAM_EA

## Common CPU symbols
config CPU_FAM
    default "ea" if CPU_FAM_EA
    default "k" if CPU_FAM_K
    default "l" if CPU_FAM_L
    default "w" if CPU_FAM_W

config CPU_MODEL
    default "mk20dx256vlh7"   if CPU_MODEL_MK20DX256VLH7
    default "mk22fn512vlh12"  if CPU_MODEL_MK22FN512VLH12
    default "mk60dn512vll10"  if CPU_MODEL_MK60DN512VLL10
    default "mk64fn1m0vll12"  if CPU_MODEL_MK64FN1M0VLL12
    default "mkw21d256vha5"   if CPU_MODEL_MKW21D256VHA5
    default "mkw21d512vha5"   if CPU_MODEL_MKW21D512VHA5
    default "mkw22d512vha5"   if CPU_MODEL_MKW22D512VHA5
    default "mkw41z256vht4"   if CPU_MODEL_MKW41Z256VHT4
    default "mkw41z512vht4"   if CPU_MODEL_MKW41Z512VHT4
    default "mkl43z256vlh4"   if CPU_MODEL_MKL43Z256VLH4
    default "mkl43z256vmp4"   if CPU_MODEL_MKL43Z256VMP4
    default "mkl43z128vlh4"   if CPU_MODEL_MKL43Z128VLH4
    default "mkl43z128vmp4"   if CPU_MODEL_MKL43Z128VMP4
    default "s9keaz128aclh" if CPU_MODEL_S9KEAZ128ACLH

config CPU
    default "kinetis" if CPU_COMMON_KINETIS

source "$(RIOTCPU)/cortexm_common/Kconfig"
```

## cpu/kinetis/periph/Kconfig
```kconfig
# Copyright (c) 2021 HAW Hamburg
#
# This file is subject to the terms and conditions of the GNU Lesser
# General Public License v2.1. See the file LICENSE in the top level
# directory for more details.
#

if TEST_KCONFIG

config MODULE_PERIPH_WDOG
    bool
    help
        Low-level WDOG driver.

config MODULE_PERIPH_ICS
    bool
    depends on HAS_PERIPH_ICS
    help
        Kinetis internal clock source controller.

config MODULE_PERIPH_MCG
    bool
    depends on HAS_PERIPH_MCG
    help
      Kinetis Multipurpose Clock Generator.

config MODULE_PERIPH_MCG_LITE
    bool
    depends on HAS_PERIPH_MCG_LITE
    help
      Kinetis Multipurpose Clock Generator (Lite version).

endif # TEST_KCONFIG
```

## cpu/lm4f120/Kconfig
```kconfig
# SPDX-FileCopyrightText: 2020 HAW Hamburg
# SPDX-License-Identifier: LGPL-2.1-only

config CPU_FAM_LM4F120
    bool
    select CPU_CORE_CORTEX_M4F

config CPU_MODEL_LM4F120H5QR
    bool
    select CPU_FAM_LM4F120

## Common CPU symbols
config CPU_FAM
    default "lm4f120" if CPU_FAM_LM4F120

config CPU
    default "lm4f120" if CPU_FAM_LM4F120

config CPU_MODEL
    # uppercase to match the Makefile.features
    default "LM4F120H5QR" if CPU_MODEL_LM4F120H5QR

source "$(RIOTCPU)/cortexm_common/Kconfig"
```

## cpu/lpc1768/Kconfig
```kconfig
# SPDX-FileCopyrightText: 2020 HAW Hamburg
# SPDX-License-Identifier: LGPL-2.1-only

config CPU_FAM_LPC176X
    bool
    select CPU_CORE_CORTEX_M3

## CPU Models
config CPU_MODEL_LPC1768
    bool
    select CPU_FAM_LPC176X

## Common CPU symbols
config CPU_FAM
    default "lpc176x" if CPU_FAM_LPC176X

config CPU_MODEL
    default "lpc1768" if CPU_MODEL_LPC1768

config CPU
    default "lpc1768" if CPU_MODEL_LPC1768

source "$(RIOTCPU)/cortexm_common/Kconfig"
```

## cpu/lpc1768/periph/Kconfig.eth
```kconfig
# SPDX-FileCopyrightText: 2026 Bas Stottelaar <basstottelaar@gmail.com>
# SPDX-License-Identifier: LGPL-2.1-only

config LPC1768_ETH_AN_TIMEOUT_MS
    int "Auto-negotiation timeout"
    depends on CPU_MODEL_LPC1768 && USEMODULE_LPC1768_ETH_AUTO
    default 5000
    help
        Timeout for PHY auto-negotiation completion, in milliseconds.

config LPC1768_ETH_LINK_POLL_MS
    int "Link state poll interval"
    depends on CPU_MODEL_LPC1768 && USEMODULE_LPC1768_ETH_LINK_UP
    default 1000
    help
        Poll interval for checking the link state, in milliseconds.

config LPC1768_ETH_PHY_TIMEOUT_US
    int "PHY operations timeout"
    depends on CPU_MODEL_LPC1768 && USEMODULE_LPC1768_ETH
    default 1000
    help
        Timeout for PHY operations, in microseconds.

config LPC1768_ETH_RX_BUF_NUMOF
    int "Receive buffers"
    depends on CPU_MODEL_LPC1768 && USEMODULE_LPC1768_ETH
    default 4
    help
        Number of receive buffers. The combination of this and the number of
        transmit buffers must fit in memory.

config LPC1768_ETH_TX_BUF_NUMOF
    int "Transmit buffers"
    depends on CPU_MODEL_LPC1768 && USEMODULE_LPC1768_ETH
    default 4
    help
        Number of transmit buffers. The combination of this and the number of
        receive buffers must fit in memory.
```

## cpu/lpc23xx/Kconfig
```kconfig
# SPDX-FileCopyrightText: 2020 HAW Hamburg
# SPDX-License-Identifier: LGPL-2.1-only

config CPU_FAM_LPC23XX
    bool
    select CPU_CORE_ARM7TDMI_S

## CPU Models
config CPU_MODEL_LPC2387
    bool
    select CPU_FAM_LPC23XX

config CPU_MODEL_LPC2388
    bool
    select CPU_FAM_LPC23XX

## Common CPU symbols
config CPU_FAM
    default "lpc23xx" if CPU_FAM_LPC23XX

config CPU_MODEL
    default "lpc2387" if CPU_MODEL_LPC2387
    default "lpc2388" if CPU_MODEL_LPC2388

config CPU
    default "lpc23xx" if CPU_FAM_LPC23XX

source "$(RIOTCPU)/arm7_common/Kconfig"
```

## cpu/lpc23xx/mci/Kconfig
```kconfig
# Copyright (c) 2020 HAW Hamburg
#
# This file is subject to the terms and conditions of the GNU Lesser
# General Public License v2.1. See the file LICENSE in the top level
# directory for more details.
#

config MODULE_MCI
    bool "LPC23XX Multimedia Card Interface (MCI) driver"
    depends on CPU_FAM_LPC23XX
    depends on TEST_KCONFIG
```

## cpu/mips32r2_common/Kconfig
```kconfig
# Copyright (c) 2020 HAW Hamburg
#
# This file is subject to the terms and conditions of the GNU Lesser
# General Public License v2.1. See the file LICENSE in the top level
# directory for more details.
#

config CPU_ARCH_MIPS32R2
    bool
    select HAS_ARCH_32BIT
    select HAS_ARCH_MIPS32R2
    select HAS_NEWLIB
    select HAS_CPP
    select HAS_LIBSTDCPP
    select HAS_PERIPH_PM
    select MODULE_MALLOC_THREAD_SAFE if TEST_KCONFIG

config CPU_CORE_M4K
    bool
    select CPU_ARCH_MIPS32R2

config CPU_CORE_M5101
    bool
    select CPU_ARCH_MIPS32R2

## Declaration of specific features
config HAS_ARCH_MIPS32R2
    bool
    help
        Indicates that the current architecture is 'mips32r2'.

## Common CPU symbols
config CPU_ARCH
    default "mips32r2" if CPU_ARCH_MIPS32R2

config CPU_CORE
    default "m4k" if CPU_CORE_M4K
    default "m5101" if CPU_CORE_M5101
```

## cpu/mips_pic32_common/Kconfig
```kconfig
# Copyright (c) 2020 HAW Hamburg
#
# This file is subject to the terms and conditions of the GNU Lesser
# General Public License v2.1. See the file LICENSE in the top level
# directory for more details.
#

config CPU_COMMON_MIPS_PIC32
    bool
    select HAS_PERIPH_CPUID
    select HAS_PERIPH_GPIO
    select HAS_PERIPH_GPIO_IRQ

source "$(RIOTCPU)/mips32r2_common/Kconfig"
```

## cpu/mips_pic32mx/Kconfig
```kconfig
# Copyright (c) 2020 HAW Hamburg
#
# This file is subject to the terms and conditions of the GNU Lesser
# General Public License v2.1. See the file LICENSE in the top level
# directory for more details.
#

config CPU_FAM_PIC32MX
    bool
    select CPU_COMMON_MIPS_PIC32
    select CPU_CORE_M4K
    select HAS_CPU_MIPS_PIC32MX

## CPU Models
config CPU_MODEL_P32MX470F512H
    bool
    select CPU_FAM_PIC32MX

## Declaration of specific features
config HAS_CPU_MIPS_PIC32MX
    bool
    help
        Indicates that a 'mips_pic32mx' cpu is being used.

## Common CPU symbols
config CPU_FAM
    default "pic32mx" if CPU_FAM_PIC32MX

config CPU_MODEL
    default "p32mx470f512h" if CPU_MODEL_P32MX470F512H

config CPU
    default "mips_pic32mx" if CPU_FAM_PIC32MX

source "$(RIOTCPU)/mips_pic32_common/Kconfig"
```

## cpu/mips_pic32mz/Kconfig
```kconfig
# Copyright (c) 2020 HAW Hamburg
#
# This file is subject to the terms and conditions of the GNU Lesser
# General Public License v2.1. See the file LICENSE in the top level
# directory for more details.
#

config CPU_FAM_PIC32MZ
    bool
    select CPU_COMMON_MIPS_PIC32
    select CPU_CORE_M5101
    select HAS_CPU_MIPS_PIC32MZ
    select HAS_PERIPH_HWRNG

## CPU Models
config CPU_MODEL_P32MZ2048EFG100
    bool
    select CPU_FAM_PIC32MZ

## Declaration of specific features
config HAS_CPU_MIPS_PIC32MZ
    bool
    help
        Indicates that a 'mips_pic32mz' cpu is being used.

## Common CPU symbols
config CPU_FAM
    default "pic32mz" if CPU_FAM_PIC32MZ

config CPU_MODEL
    default "p32mz2048efg100" if CPU_MODEL_P32MZ2048EFG100

config CPU
    default "mips_pic32mz" if CPU_FAM_PIC32MZ

source "$(RIOTCPU)/mips_pic32_common/Kconfig"
```

## cpu/msp430/Kconfig
```kconfig
# SPDX-FileCopyrightText: 2020 Freie Universität Berlin
# SPDX-FileCopyrightText: 2020 HAW Hamburg
# SPDX-License-Identifier: LGPL-2.1-only

config CPU_ARCH_MSP430
    bool

config CPU_MSP430
    bool
    select CPU_ARCH_MSP430

## Common CPU symbols
config CPU_ARCH
    default "msp430" if CPU_MSP430

config CPU
    default "msp430" if CPU_MSP430

config CPU_CORE
    default "msp430" if CPU_MSP430

## Specific default configuration values
config GNRC_PKTBUF_SIZE
    default 2560
    depends on USEMODULE_GNRC_PKTBUF_STATIC

source "$(RIOTCPU)/msp430/kconfigs/x1xx/Kconfig"
source "$(RIOTCPU)/msp430/kconfigs/f2xx_g2xx/Kconfig"
```

## cpu/msp430/kconfigs/f2xx_g2xx/Kconfig
```kconfig
# SPDX-FileCopyrightText: 2020 Freie Universität Berlin
# SPDX-FileCopyrightText: 2020 HAW Hamburg
# SPDX-License-Identifier: LGPL-2.1-only

config CPU_FAM_MSP430_F2XX_G2XX
    bool
    select CPU_MSP430

## CPU Models
config CPU_MODEL_MSP430F2617
    bool
    select CPU_FAM_MSP430_F2XX_G2XX

config CPU_MODEL_MSP430F2618
    bool
    select CPU_FAM_MSP430_F2XX_G2XX

## Common CPU symbols
config CPU_FAM
    default "msp430_f2xx_g2xx" if HAS_CPU_MSP430_F2XX_G2XX

config CPU_MODEL
    default "msp430f2617" if CPU_MODEL_MSP430F2617
    default "msp430f2618" if CPU_MODEL_MSP430F2618
```

## cpu/msp430/kconfigs/x1xx/Kconfig
```kconfig
# SPDX-FileCopyrightText: 2020 Freie Universität Berlin
# SPDX-FileCopyrightText: 2020 HAW Hamburg
# SPDX-License-Identifier: LGPL-2.1-only

config CPU_FAM_MSP430_X1XX
    bool
    select CPU_MSP430

## CPU Models
config CPU_MODEL_MSP430F1611
    bool
    select CPU_FAM_MSP430_X1XX

config CPU_MODEL_MSP430F1612
    bool
    select CPU_FAM_MSP430_X1XX

## Common CPU symbols
config CPU_FAM
    default "msp430_x1xx" if HAS_CPU_MSP430_X1XX

config CPU_MODEL
    default "msp430f1611" if CPU_MODEL_MSP430F1611
    default "msp430f1612" if CPU_MODEL_MSP430F1612
```

## cpu/msp430/periph/Kconfig
```kconfig
# Copyright (c) 2023 Marian Buschsieweke
#
# This file is subject to the terms and conditions of the GNU Lesser
# General Public License v2.1. See the file LICENSE in the top level
# directory for more details.
#

config MODULE_PERIPH
    bool
    default y
    help
        MSP430 peripheral drivers.
```
