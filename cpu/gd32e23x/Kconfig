## cpu/msp430_common/Kconfig
```kconfig
# Copyright (c) 2020 Freie Universitaet Berlin
#               2020 HAW Hamburg
#
# This file is subject to the terms and conditions of the GNU Lesser
# General Public License v2.1. See the file LICENSE in the top level
# directory for more details.
#

config MODULE_MSP430_COMMON
    bool
    default y if CPU_CORE_MSP430
    depends on TEST_KCONFIG
    imply MODULE_NEWLIB_NANO
    select MODULE_MALLOC_THREAD_SAFE
    help
        Common code for MSP430 cores.

config MODULE_MSP430_COMMON_PERIPH
    bool
    default y if CPU_CORE_MSP430
    depends on TEST_KCONFIG
    select MODULE_PERIPH
    help
        Common peripheral code for MSP430 cores.

choice LIBC_IMPLEMENTATION
    default MODULE_NEWLIB
endchoice

config CPU_ARCH_MSP430
    bool
    select HAS_ARCH_16BIT
    select HAS_ARCH_MSP430
    select HAS_DBGPIN
    select HAS_PERIPH_FLASHPAGE
    select HAS_PERIPH_FLASHPAGE_PAGEWISE
    select HAS_NEWLIB
    select HAS_PERIPH_PM

config CPU_CORE_MSP430
    bool
    select CPU_ARCH_MSP430

## Common CPU symbols
config CPU_ARCH
    default "msp430" if CPU_ARCH_MSP430

config CPU_CORE
    default "msp430" if CPU_CORE_MSP430

## Definition of specific features
config HAS_ARCH_MSP430
    bool
    help
        Indicates that the current architecture is MSP430.

## Specific default configuration values
config GNRC_PKTBUF_SIZE
    default 2560
    depends on KCONFIG_USEMODULE_GNRC_PKTBUF_STATIC
```

## cpu/msp430fxyz/Kconfig
```kconfig
# Copyright (c) 2020 Freie Universität Berlin
#               2020 HAW Hamburg
#
# This file is subject to the terms and conditions of the GNU Lesser
# General Public License v2.1. See the file LICENSE in the top level
# directory for more details.
#

config CPU_FAM_MSP430F
    bool
    select CPU_CORE_MSP430
    select HAS_CPU_MSP430FXYZ

## CPU Models
config CPU_MODEL_MSP430F1611
    bool
    select CPU_FAM_MSP430F

config CPU_MODEL_MSP430F1612
    bool
    select CPU_FAM_MSP430F

config CPU_MODEL_MSP430F2617
    bool
    select CPU_FAM_MSP430F

## Definition of specific features
config HAS_CPU_MSP430FXYZ
    bool
    help
        Indicates that an 'msp430fxyz' cpu is being used.

## Common CPU symbols
config CPU_FAM
    default "msp430f" if CPU_FAM_MSP430F

config CPU_MODEL
    default "msp430f1611" if CPU_MODEL_MSP430F1611
    default "msp430f1612" if CPU_MODEL_MSP430F1612
    default "msp430f2617" if CPU_MODEL_MSP430F2617

config CPU
    default "msp430fxyz" if CPU_FAM_MSP430F

source "$(RIOTCPU)/msp430_common/Kconfig"
```

## cpu/native/Kconfig
```kconfig
# Copyright (c) 2020 HAW Hamburg
#
# This file is subject to the terms and conditions of the GNU Lesser
# General Public License v2.1. See the file LICENSE in the top level
# directory for more details.
#

config CPU_ARCH_NATIVE
    bool

config CPU_CORE_NATIVE
    bool
    select CPU_ARCH_NATIVE

config CPU_FAM_NATIVE
    bool
    select CPU_CORE_NATIVE

config CPU_MODEL_NATIVE
    bool
    select CPU_FAM_NATIVE
    select NATIVE_OS_LINUX if "$(OS)" = "Linux"
    select NATIVE_OS_FREEBSD if "$(OS)" = "FreeBSD"

## OS Variants
config NATIVE_OS_LINUX
    bool

config NATIVE_OS_FREEBSD
    bool

## CPU Common symbols
config CPU_ARCH
    default "native" if CPU_ARCH_NATIVE

config CPU_CORE
    default "native" if CPU_CORE_NATIVE

config CPU_FAM
    default "native" if CPU_FAM_NATIVE

config CPU_MODEL
    default "native" if CPU_MODEL_NATIVE

config CPU
    default "native" if CPU_MODEL_NATIVE
```

## cpu/native/backtrace/Kconfig
```kconfig
# Copyright (c) 2020 HAW Hamburg
#
# This file is subject to the terms and conditions of the GNU Lesser
# General Public License v2.1. See the file LICENSE in the top level
# directory for more details.
#

config MODULE_BACKTRACE
    bool "Stack backtrace"
    depends on CPU_ARCH_NATIVE
    depends on TEST_KCONFIG
```

## cpu/native/cli_eui_provider/Kconfig
```kconfig
# Copyright (c) 2022 HAW Hamburg
#
# This file is subject to the terms and conditions of the GNU Lesser
# General Public License v2.1. See the file LICENSE in the top level
# directory for more details.
#

config MODULE_NATIVE_CLI_EUI_PROVIDER
    bool "Command-line EUI provider"
    depends on TEST_KCONFIG
    depends on CPU_ARCH_NATIVE
    select MODULE_L2UTIL
```
