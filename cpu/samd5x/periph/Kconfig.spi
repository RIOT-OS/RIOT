## cpu/stm32/kconfig/f2/Kconfig.lines
```kconfig
# Copyright (c) 2020 Inria
#
# This file is subject to the terms and conditions of the GNU Lesser
# General Public License v2.1. See the file LICENSE in the top level
# directory for more details.
#

# CPU lines
config CPU_LINE_STM32F205XX
    bool
    select CPU_FAM_F2

config CPU_LINE_STM32F207XX
    bool
    select CPU_FAM_F2

config CPU_LINE_STM32F215XX
    bool
    select CPU_FAM_F2

config CPU_LINE_STM32F217XX
    bool
    select CPU_FAM_F2
```

## cpu/stm32/kconfig/f2/Kconfig.models
```kconfig
# Copyright (c) 2020 Inria
#
# This file is subject to the terms and conditions of the GNU Lesser
# General Public License v2.1. See the file LICENSE in the top level
# directory for more details.
#

# CPU models
config CPU_MODEL_STM32F207ZG
    bool
    select CPU_LINE_STM32F207XX

# Configure CPU model
config CPU_MODEL
    default "stm32f207zg" if CPU_MODEL_STM32F207ZG
```

## cpu/stm32/kconfig/f4/Kconfig.models
```kconfig
# Copyright (c) 2020 Inria
#
# This file is subject to the terms and conditions of the GNU Lesser
# General Public License v2.1. See the file LICENSE in the top level
# directory for more details.
#

# CPU models
config CPU_MODEL_STM32F401RE
    bool
    select CPU_LINE_STM32F401XE

config CPU_MODEL_STM32F405RG
    bool
    select CPU_LINE_STM32F405XX

config CPU_MODEL_STM32F407VG
    bool
    select CPU_LINE_STM32F407XX

config CPU_MODEL_STM32F410RB
    bool
    select CPU_LINE_STM32F410RX

config CPU_MODEL_STM32F411RE
    bool
    select CPU_LINE_STM32F411XE

config CPU_MODEL_STM32F411CEU6
    bool
    select CPU_LINE_STM32F411XE

config CPU_MODEL_STM32F412ZG
    bool
    select CPU_LINE_STM32F412ZX

config CPU_MODEL_STM32F413ZH
    bool
    select CPU_LINE_STM32F413XX

config CPU_MODEL_STM32F415RG
    bool
    select CPU_LINE_STM32F415XX

config CPU_MODEL_STM32F429ZI
    bool
    select CPU_LINE_STM32F429XX

config CPU_MODEL_STM32F437VG
    bool
    select CPU_LINE_STM32F437XX

config CPU_MODEL_STM32F446RE
    bool
    select CPU_LINE_STM32F446XX

config CPU_MODEL_STM32F446ZE
    bool
    select CPU_LINE_STM32F446XX

# Configure CPU model
config CPU_MODEL
    default "stm32f401re" if CPU_MODEL_STM32F401RE
    default "stm32f405rg" if CPU_MODEL_STM32F405RG
    default "stm32f407vg" if CPU_MODEL_STM32F407VG
    default "stm32f410rb" if CPU_MODEL_STM32F410RB
    default "stm32f411re" if CPU_MODEL_STM32F411RE
    default "stm32f411ceu6" if CPU_MODEL_STM32F411CEU6
    default "stm32f412zg" if CPU_MODEL_STM32F412ZG
    default "stm32f413zh" if CPU_MODEL_STM32F413ZH
    default "stm32f415rg" if CPU_MODEL_STM32F415RG
    default "stm32f429zi" if CPU_MODEL_STM32F429ZI
    default "stm32f437vg" if CPU_MODEL_STM32F437VG
    default "stm32f446re" if CPU_MODEL_STM32F446RE
    default "stm32f446ze" if CPU_MODEL_STM32F446ZE
```

## cpu/stm32/kconfig/g0/Kconfig.lines
```kconfig
# Copyright (c) 2020 Inria
#
# This file is subject to the terms and conditions of the GNU Lesser
# General Public License v2.1. See the file LICENSE in the top level
# directory for more details.
#

# CPU lines
config CPU_LINE_STM32G0B0XX
    bool
    select CPU_FAM_G0

config CPU_LINE_STM32G0B1XX
    bool
    select CPU_FAM_G0

config CPU_LINE_STM32G0C1XX
    bool
    select CPU_FAM_G0

config CPU_LINE_STM32G030XX
    bool
    select CPU_FAM_G0

config CPU_LINE_STM32G031XX
    bool
    select CPU_FAM_G0

config CPU_LINE_STM32G041XX
    bool
    select CPU_FAM_G0

config CPU_LINE_STM32G070XX
    bool
    select CPU_FAM_G0

config CPU_LINE_STM32G071XX
    bool
    select CPU_FAM_G0

config CPU_LINE_STM32G081XX
    bool
    select CPU_FAM_G0
```

## cpu/stm32/kconfig/l1/Kconfig.models
```kconfig
# Copyright (c) 2020 Inria
#
# This file is subject to the terms and conditions of the GNU Lesser
# General Public License v2.1. See the file LICENSE in the top level
# directory for more details.
#

# CPU models
config CPU_MODEL_STM32L151CB
    bool
    select CPU_LINE_STM32L151XB

config CPU_MODEL_STM32L151CB_A
    bool
    select CPU_LINE_STM32L151XBA

config CPU_MODEL_STM32L151RC
    bool
    select CPU_LINE_STM32L151XC

config CPU_MODEL_STM32L152RE
    bool
    select CPU_LINE_STM32L152XE

# Configure CPU model
config CPU_MODEL
    default "stm32l151cb" if CPU_MODEL_STM32L151CB
    default "stm32l151cb_a" if CPU_MODEL_STM32L151CB_A
    default "stm32l151rc" if CPU_MODEL_STM32L151RC
    default "stm32l152re" if CPU_MODEL_STM32L152RE
```

## cpu/stm32/kconfig/wb/Kconfig
```kconfig
# Copyright (c) 2020 Inria
#
# This file is subject to the terms and conditions of the GNU Lesser
# General Public License v2.1. See the file LICENSE in the top level
# directory for more details.
#

config CPU_FAM_WB
    bool
    select CPU_STM32
    select CPU_CORE_CORTEX_M4
    select HAS_CPU_STM32WB
    select HAS_PERIPH_FLASHPAGE
    select HAS_PERIPH_FLASHPAGE_RAW
    select HAS_PERIPH_HWRNG

config CPU_FAM
    default "wb" if CPU_FAM_WB

config HAS_CPU_STM32WB
    bool
    help
        Indicates that the cpu being used belongs to the 'stm32wb' family.
```
