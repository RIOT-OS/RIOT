## cpu/stm32/Kconfig.lines
```kconfig
# Copyright (c) 2020 Inria
#
# This file is subject to the terms and conditions of the GNU Lesser
# General Public License v2.1. See the file LICENSE in the top level
# directory for more details.
#

# CPU Lines
# STM32F0
config CPU_LINE_STM32F030X6
    bool
    select CPU_FAM_F0

config CPU_LINE_STM32F030X8
    bool
    select CPU_FAM_F0

config CPU_LINE_STM32F030XC
    bool
    select CPU_FAM_F0

config CPU_LINE_STM32F031X6
    bool
    select CPU_FAM_F0

config CPU_LINE_STM32F038XX
    bool
    select CPU_FAM_F0

config CPU_LINE_STM32F042X6
    bool
    select CPU_FAM_F0

config CPU_LINE_STM32F048XX
    bool
    select CPU_FAM_F0

config CPU_LINE_STM32F051X8
    bool
    select CPU_FAM_F0

config CPU_LINE_STM32F058XX
    bool
    select CPU_FAM_F0

config CPU_LINE_STM32F070X6
    bool
    select CPU_FAM_F0

config CPU_LINE_STM32F070XB
    bool
    select CPU_FAM_F0

config CPU_LINE_STM32F071XB
    bool
    select CPU_FAM_F0

config CPU_LINE_STM32F072XB
    bool
    select CPU_FAM_F0

config CPU_LINE_STM32F078XX
    bool
    select CPU_FAM_F0

config CPU_LINE_STM32F091XC
    bool
    select CPU_FAM_F0

config CPU_LINE_STM32F098XX
    bool
    select CPU_FAM_F0

# STM32F1
config CPU_LINE_STM32F100XB
    bool
    select CPU_FAM_F1

config CPU_LINE_STM32F100XE
    bool
    select CPU_FAM_F1

config CPU_LINE_STM32F101X6
    bool
    select CPU_FAM_F1

config CPU_LINE_STM32F101XB
    bool
    select CPU_FAM_F1

config CPU_LINE_STM32F101XE
    bool
    select CPU_FAM_F1

config CPU_LINE_STM32F101XG
    bool
    select CPU_FAM_F1

config CPU_LINE_STM32F102X6
    bool
    select CPU_FAM_F1

config CPU_LINE_STM32F102XB
    bool
    select CPU_FAM_F1

config CPU_LINE_STM32F103X6
    bool
    select CPU_FAM_F1

config CPU_LINE_STM32F103XB
    bool
    select CPU_FAM_F1

config CPU_LINE_STM32F103XE
    bool
    select CPU_FAM_F1

config CPU_LINE_STM32F103XG
    bool
    select CPU_FAM_F1

config CPU_LINE_STM32F105XC
    bool
    select CPU_FAM_F1

config CPU_LINE_STM32F107XC
    bool
    select CPU_FAM_F1

# STM32F2
config CPU_LINE_STM32F205XX
    bool
    select CPU_FAM_F2

config CPU_LINE_STM32F207XX
    bool
    select CPU_FAM_F2

config CPU_LINE_STM32F215XX
    bool
    select CPU_FAM_F2

config CPU_LINE_STM32F217XX
    bool
    select CPU_FAM_F2

# STM32F3
config CPU_LINE_STM32F301X8
    bool
    select CPU_FAM_F3

config CPU_LINE_STM32F302X8
    bool
    select CPU_FAM_F3

config CPU_LINE_STM32F302XC
    bool
    select CPU_FAM_F3
    select HAS_CORTEXM_MPU

config CPU_LINE_STM32F302XE
    bool
    select CPU_FAM_F3
    select HAS_CORTEXM_MPU

config CPU_LINE_STM32F303X8
    bool
    select CPU_FAM_F3

config CPU_LINE_STM32F303XC
    bool
    select CPU_FAM_F3

config CPU_LINE_STM32F303XE
    bool
    select CPU_FAM_F3

config CPU_LINE_STM32F318XX
    bool
    select CPU_FAM_F3

config CPU_LINE_STM32F328XX
    bool
    select CPU_FAM_F3

config CPU_LINE_STM32F334X8
    bool
    select CPU_FAM_F3

config CPU_LINE_STM32F358XX
    bool
    select CPU_FAM_F3

config CPU_LINE_STM32F373XC
    bool
    select CPU_FAM_F3

config CPU_LINE_STM32F378XX
    bool
    select CPU_FAM_F3

config CPU_LINE_STM32F398XX
    bool
    select CPU_FAM_F3

# STM32F4
config CPU_LINE_STM32F401XC
    bool
    select CPU_FAM_F4

config CPU_LINE_STM32F401XE
    bool
    select CPU_FAM_F4

config CPU_LINE_STM32F405XX
    bool
    select CPU_FAM_F4
    select HAS_PERIPH_HWRNG

config CPU_LINE_STM32F407XX
    bool
    select CPU_FAM_F4
    select HAS_PERIPH_HWRNG

config CPU_LINE_STM32F410CX
    bool
    select CPU_FAM_F4

config CPU_LINE_STM32F410RX
    bool
    select CPU_FAM_F4
    select HAS_PERIPH_HWRNG

config CPU_LINE_STM32F410TX
    bool
    select CPU_FAM_F4

config CPU_LINE_STM32F411XE
    bool
    select CPU_FAM_F4

config CPU_LINE_STM32F412CX
    bool
    select CPU_FAM_F4

config CPU_LINE_STM32F412RX
    bool
    select CPU_FAM_F4

config CPU_LINE_STM32F412VX
    bool
    select CPU_FAM_F4

config CPU_LINE_STM32F412ZX
    bool
    select CPU_FAM_F4
    select HAS_PERIPH_HWRNG

config CPU_LINE_STM32F413XX
    bool
    select CPU_FAM_F4
    select HAS_PERIPH_HWRNG

config CPU_LINE_STM32F415XX
    bool
    select CPU_FAM_F4
    select HAS_PERIPH_HWRNG

config CPU_LINE_STM32F417XX
    bool
    select CPU_FAM_F4

config CPU_LINE_STM32F423XX
    bool
    select CPU_FAM_F4

config CPU_LINE_STM32F427XX
    bool
    select CPU_FAM_F4

config CPU_LINE_STM32F429XX
    bool
    select CPU_FAM_F4
    select HAS_PERIPH_HWRNG

config CPU_LINE_STM32F437XX
    bool
    select CPU_FAM_F4
    select HAS_PERIPH_HWRNG

config CPU_LINE_STM32F439XX
    bool
    select CPU_FAM_F4

config CPU_LINE_STM32F446XX
    bool
    select CPU_FAM_F4

config CPU_LINE_STM32F469XX
    bool
    select CPU_FAM_F4

config CPU_LINE_STM32F479XX
    bool
    select CPU_FAM_F4

# STM32F7
config CPU_LINE_STM32F722XX
    bool
    select CPU_FAM_F7

config CPU_LINE_STM32F723XX
    bool
    select CPU_FAM_F7

config CPU_LINE_STM32F730XX
    bool
    select CPU_FAM_F7

config CPU_LINE_STM32F732XX
    bool
    select CPU_FAM_F7

config CPU_LINE_STM32F733XX
    bool
    select CPU_FAM_F7

config CPU_LINE_STM32F745XX
    bool
    select CPU_FAM_F7

config CPU_LINE_STM32F746XX
    bool
    select CPU_FAM_F7

config CPU_LINE_STM32F750XX
    bool
    select CPU_FAM_F7

config CPU_LINE_STM32F756XX
    bool
    select CPU_FAM_F7

config CPU_LINE_STM32F765XX
    bool
    select CPU_FAM_F7

config CPU_LINE_STM32F767XX
    bool
    select CPU_FAM_F7

config CPU_LINE_STM32F769XX
    bool
    select CPU_FAM_F7

config CPU_LINE_STM32F777XX
    bool
    select CPU_FAM_F7

config CPU_LINE_STM32F779XX
    bool
    select CPU_FAM_F7

# STM32G0
config CPU_LINE_STM32G0B0XX
    bool
    select CPU_FAM_G0

config CPU_LINE_STM32G0B1XX
    bool
    select CPU_FAM_G0

config CPU_LINE_STM32G0C1XX
    bool
    select CPU_FAM_G0

config CPU_LINE_STM32G030XX
    bool
    select CPU_FAM_G0

config CPU_LINE_STM32G031XX
    bool
    select CPU_FAM_G0

config CPU_LINE_STM32G041XX
    bool
    select CPU_FAM_G0

config CPU_LINE_STM32G070XX
    bool
    select CPU_FAM_G0

config CPU_LINE_STM32G071XX
    bool
    select CPU_FAM_G0

config CPU_LINE_STM32G081XX
    bool
    select CPU_FAM_G0

# STM32G4
config CPU_LINE_STM32G431XX
    bool
    select CPU_FAM_G4

config CPU_LINE_STM32G441X
    bool
    select CPU_FAM_G4

config CPU_LINE_STM32G471XX
    bool
    select CPU_FAM_G4

config CPU_LINE_STM32G473XX
    bool
    select CPU_FAM_G4

config CPU_LINE_STM32G474XX
    bool
    select CPU_FAM_G4

config CPU_LINE_STM32G483XX
    bool
    select CPU_FAM_G4

config CPU_LINE_STM32G484XX
    bool
    select CPU_FAM_G4

config CPU_LINE_STM32GBK1CB
    bool
    select CPU_FAM_G4

# STM32L0
config CPU_LINE_STM32L010X4
    bool
    select CPU_FAM_L0

config CPU_LINE_STM32L010X6
    bool
    select CPU_FAM_L0

config CPU_LINE_STM32L010X8
    bool
    select CPU_FAM_L0

config CPU_LINE_STM32L010XB
    bool
    select CPU_FAM_L0

config CPU_LINE_STM32L011XX
    bool
    select CPU_FAM_L0

config CPU_LINE_STM32L021XX
    bool
    select CPU_FAM_L0

config CPU_LINE_STM32L031XX
    bool
    select CPU_FAM_L0

config CPU_LINE_STM32L041XX
    bool
    select CPU_FAM_L0

config CPU_LINE_STM32L051XX
    bool
    select CPU_FAM_L0

config CPU_LINE_STM32L052XX
    bool
    select CPU_FAM_L0
    select HAS_PERIPH_HWRNG

config CPU_LINE_STM32L053XX
    bool
    select CPU_FAM_L0
    select HAS_PERIPH_HWRNG

config CPU_LINE_STM32L061XX
    bool
    select CPU_FAM_L0

config CPU_LINE_STM32L062XX
    bool
    select CPU_FAM_L0

config CPU_LINE_STM32L063XX
    bool
    select CPU_FAM_L0

config CPU_LINE_STM32L071XX
    bool
    select CPU_FAM_L0

config CPU_LINE_STM32L072XX
    bool
    select CPU_FAM_L0
    select HAS_PERIPH_HWRNG

config CPU_LINE_STM32L073XX
    bool
    select CPU_FAM_L0
    select HAS_PERIPH_HWRNG

config CPU_LINE_STM32L081XX
    bool
    select CPU_FAM_L0

config CPU_LINE_STM32L082XX
    bool
    select CPU_FAM_L0

config CPU_LINE_STM32L083XX
    bool
    select CPU_FAM_L0

# STM32L1
config CPU_LINE_STM32L100XB
    bool
    select CPU_FAM_L1

config CPU_LINE_STM32L100XBA
    bool
    select CPU_FAM_L1

config CPU_LINE_STM32L100XC
    bool
    select CPU_FAM_L1

config CPU_LINE_STM32L151XB
    bool
    select CPU_FAM_L1

config CPU_LINE_STM32L151XBA
    bool
    select CPU_FAM_L1

config CPU_LINE_STM32L151XC
    bool
    select CPU_FAM_L1

config CPU_LINE_STM32L151XCA
    bool
    select CPU_FAM_L1

config CPU_LINE_STM32L151XD
    bool
    select CPU_FAM_L1

config CPU_LINE_STM32L151XDX
    bool
    select CPU_FAM_L1

config CPU_LINE_STM32L151XE
    bool
    select CPU_FAM_L1

config CPU_LINE_STM32L152XB
    bool
    select CPU_FAM_L1

config CPU_LINE_STM32L152XBA
    bool
    select CPU_FAM_L1

config CPU_LINE_STM32L152XC
    bool
    select CPU_FAM_L1

config CPU_LINE_STM32L152XCA
    bool
    select CPU_FAM_L1

config CPU_LINE_STM32L152XD
    bool
    select CPU_FAM_L1

config CPU_LINE_STM32L152XDX
    bool
    select CPU_FAM_L1

config CPU_LINE_STM32L152XE
    bool
    select CPU_FAM_L1

config CPU_LINE_STM32L162XC
    bool
    select CPU_FAM_L1

config CPU_LINE_STM32L162XCA
    bool
    select CPU_FAM_L1

config CPU_LINE_STM32L162XD
    bool
    select CPU_FAM_L1

config CPU_LINE_STM32L162XDX
    bool
    select CPU_FAM_L1

config CPU_LINE_STM32L162XE
    bool
    select CPU_FAM_L1

# STM32L4
config CPU_LINE_STM32L4A6XX
    bool
    select CPU_FAM_L4

config CPU_LINE_STM32L4P5XX
    bool
    select CPU_FAM_L4

config CPU_LINE_STM32L4Q5XX
    bool
    select CPU_FAM_L4

config CPU_LINE_STM32L4R5XX
    bool
    select CPU_FAM_L4

config CPU_LINE_STM32L4R7XX
    bool
    select CPU_FAM_L4

config CPU_LINE_STM32L4R9XX
    bool
    select CPU_FAM_L4

config CPU_LINE_STM32L4S5XX
    bool
    select CPU_FAM_L4

config CPU_LINE_STM32L4S7XX
    bool
    select CPU_FAM_L4

config CPU_LINE_STM32L4S9XX
    bool
    select CPU_FAM_L4

config CPU_LINE_STM32L412XX
    bool
    select CPU_FAM_L4

config CPU_LINE_STM32L422XX
    bool
    select CPU_FAM_L4

config CPU_LINE_STM32L431XX
    bool
    select CPU_FAM_L4

config CPU_LINE_STM32L432XX
    bool
    select CPU_FAM_L4

config CPU_LINE_STM32L433XX
    bool
    select CPU_FAM_L4

config CPU_LINE_STM32L442XX
    bool
    select CPU_FAM_L4

config CPU_LINE_STM32L443XX
    bool
    select CPU_FAM_L4

config CPU_LINE_STM32L451XX
    bool
    select CPU_FAM_L4

config CPU_LINE_STM32L452XX
    bool
    select CPU_FAM_L4

config CPU_LINE_STM32L462XX
    bool
    select CPU_FAM_L4

config CPU_LINE_STM32L471XX
    bool
    select CPU_FAM_L4

config CPU_LINE_STM32L475XX
    bool
    select CPU_FAM_L4

config CPU_LINE_STM32L476XX
    bool
    select CPU_FAM_L4

config CPU_LINE_STM32L485XX
    bool
    select CPU_FAM_L4

config CPU_LINE_STM32L486XX
    bool
    select CPU_FAM_L4

config CPU_LINE_STM32L496XX
    bool
    select CPU_FAM_L4

# STM32WB
config CPU_LINE_STM32WB5MXX
    bool
    select CPU_FAM_WB

config CPU_LINE_STM32WB30XX
    bool
    select CPU_FAM_WB

config CPU_LINE_STM32WB35XX
    bool
    select CPU_FAM_WB

config CPU_LINE_STM32WB50XX
    bool
    select CPU_FAM_WB

config CPU_LINE_STM32WB55XX
    bool
    select CPU_FAM_WB
```

## cpu/stm32/Kconfig.models
```kconfig
# Copyright (c) 2020 Inria
#
# This file is subject to the terms and conditions of the GNU Lesser
# General Public License v2.1. See the file LICENSE in the top level
# directory for more details.
#

# STM32F0
config CPU_MODEL_STM32F030F4
    bool
    select CPU_FAM_F0

config CPU_MODEL_STM32F030R8
    bool
    select CPU_FAM_F0

config CPU_MODEL_STM32F031K6
    bool
    select CPU_FAM_F0

config CPU_MODEL_STM32F042K6
    bool
    select CPU_FAM_F0

config CPU_MODEL_STM32F051R8
    bool
    select CPU_FAM_F0

config CPU_MODEL_STM32F070RB
    bool
    select CPU_FAM_F0

config CPU_MODEL_STM32F072RB
    bool
    select CPU_FAM_F0

config CPU_MODEL_STM32F091RC
    bool
    select CPU_FAM_F0

# STM32F1
config CPU_MODEL_STM32F103C8
    bool
    select CPU_FAM_F1

config CPU_MODEL_STM32F103CB
    bool
    select CPU_FAM_F1

config CPU_MODEL_STM32F103RB
    bool
    select CPU_FAM_F1

config CPU_MODEL_STM32F103RE
    bool
    select CPU_FAM_F1

# STM32F2
config CPU_MODEL_STM32F207ZG
    bool
    select CPU_FAM_F2

# STM32F3
config CPU_MODEL_STM32F302R8
    bool
    select CPU_FAM_F3

config CPU_MODEL_STM32F303K8
    bool
    select CPU_FAM_F3

config CPU_MODEL_STM32F303RE
    bool
    select CPU_FAM_F3
    select HAS_CORTEXM_MPU

config CPU_MODEL_STM32F303VC
    bool
    select CPU_FAM_F3
    select HAS_CORTEXM_MPU

config CPU_MODEL_STM32F303ZE
    bool
    select CPU_FAM_F3
    select HAS_CORTEXM_MPU

config CPU_MODEL_STM32F334R8
    bool
    select CPU_FAM_F3

# STM32F4
config CPU_MODEL_STM32F401RE
    bool
    select CPU_FAM_F4

config CPU_MODEL_STM32F405RG
    bool
    select CPU_FAM_F4
    select HAS_PERIPH_HWRNG

config CPU_MODEL_STM32F407VG
    bool
    select CPU_FAM_F4
    select HAS_PERIPH_HWRNG

config CPU_MODEL_STM32F410RB
    bool
    select CPU_FAM_F4
    select HAS_PERIPH_HWRNG

config CPU_MODEL_STM32F411RE
    bool
    select CPU_FAM_F4

config CPU_MODEL_STM32F411CEU6
    bool
    select CPU_FAM_F4

config CPU_MODEL_STM32F412ZG
    bool
    select CPU_FAM_F4
    select HAS_PERIPH_HWRNG

config CPU_MODEL_STM32F413ZH
    bool
    select CPU_FAM_F4
    select HAS_PERIPH_HWRNG

config CPU_MODEL_STM32F415RG
    bool
    select CPU_FAM_F4
    select HAS_PERIPH_HWRNG

config CPU_MODEL_STM32F429ZI
    bool
    select CPU_FAM_F4
    select HAS_PERIPH_HWRNG

config CPU_MODEL_STM32F437VG
    bool
    select CPU_FAM_F4
    select HAS_PERIPH_HWRNG

config CPU_MODEL_STM32F446RE
    bool
    select CPU_FAM_F4

config CPU_MODEL_STM32F446ZE
    bool
    select CPU_FAM_F4

# STM32F7
config CPU_MODEL_STM32F722ZE
    bool
    select CPU_FAM_F7

config CPU_MODEL_STM32F723IE
    bool
    select CPU_FAM_F7

config CPU_MODEL_STM32F746ZG
    bool
    select CPU_FAM_F7

config CPU_MODEL_STM32F767ZI
    bool
    select CPU_FAM_F7

config CPU_MODEL_STM32F769NI
    bool
    select CPU_FAM_F7

# STM32G0
config CPU_MODEL_STM32G070RB
    bool
    select CPU_FAM_G0

# STM32G4
config CPU_MODEL_STM32G474RE
    bool
    select CPU_FAM_G4

# STM32L0
config CPU_MODEL_STM32L031K6
    bool
    select CPU_FAM_L0

config CPU_MODEL_STM32L052T8
    bool
    select CPU_FAM_L0
    select HAS_PERIPH_HWRNG

config CPU_MODEL_STM32L053R8
    bool
    select CPU_FAM_L0
    select HAS_PERIPH_HWRNG

config CPU_MODEL_STM32L053C8
    bool
    select CPU_FAM_L0
    select HAS_PERIPH_HWRNG

config CPU_MODEL_STM32L072CZ
    bool
    select CPU_FAM_L0
    select HAS_PERIPH_HWRNG

config CPU_MODEL_STM32L073RZ
    bool
    select CPU_FAM_L0
    select HAS_PERIPH_HWRNG

# STM32L1
config CPU_MODEL_STM32L151CB
    bool
    select CPU_FAM_L1

config CPU_MODEL_STM32L151CB_A
    bool
    select CPU_FAM_L1

config CPU_MODEL_STM32L151RC
    bool
    select CPU_FAM_L1

config CPU_MODEL_STM32L152RE
    bool
    select CPU_FAM_L1

# STM32L4
config CPU_MODEL_STM32L412KB
    bool
    select CPU_FAM_L4

config CPU_MODEL_STM32L432KC
    bool
    select CPU_FAM_L4

config CPU_MODEL_STM32L433RC
    bool
    select CPU_FAM_L4

config CPU_MODEL_STM32L452RE
    bool
    select CPU_FAM_L4

config CPU_MODEL_STM32L475VG
    bool
    select CPU_FAM_L4

config CPU_MODEL_STM32L476RG
    bool
    select CPU_FAM_L4

config CPU_MODEL_STM32L476VG
    bool
    select CPU_FAM_L4

config CPU_MODEL_STM32L496AG
    bool
    select CPU_FAM_L4

config CPU_MODEL_STM32L496ZG
    bool
    select CPU_FAM_L4

config CPU_MODEL_STM32L4R5ZI
    bool
    select CPU_FAM_L4

# STM32WB
config CPU_MODEL_STM32WB55RG
    bool
    select CPU_FAM_WB
```
