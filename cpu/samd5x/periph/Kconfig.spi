## cpu/saml1x/Kconfig
```kconfig
# Copyright (c) 2020 HAW Hamburg
#
# This file is subject to the terms and conditions of the GNU Lesser
# General Public License v2.1. See the file LICENSE in the top level
# directory for more details.
#

config CPU_COMMON_SAML1X
    bool
    select CPU_COMMON_SAM0
    select CPU_CORE_CORTEX_M23

config CPU_FAM_SAML10
    bool
    select CPU_COMMON_SAML1X

config CPU_FAM_SAML11
    bool
    select CPU_COMMON_SAML1X

## Common CPU symbols
config CPU_FAM
    default "saml10" if CPU_FAM_SAML10
    default "saml11" if CPU_FAM_SAML11

config CPU
    default "saml1x" if CPU_COMMON_SAML1X

source "$(RIOTCPU)/saml1x/Kconfig.saml10"
source "$(RIOTCPU)/saml1x/Kconfig.saml11"

source "$(RIOTCPU)/sam0_common/Kconfig"
```

## cpu/saml21/Kconfig
```kconfig
# SPDX-FileCopyrightText: 2020 HAW Hamburg
# SPDX-License-Identifier: LGPL-2.1-only

config CPU_COMMON_SAML21
    bool
    select CPU_COMMON_SAM0
    select CPU_CORE_CORTEX_M0PLUS

config CPU_FAM_SAML21
    bool
    select CPU_COMMON_SAML21

config CPU_FAM_SAMR30
    bool
    select CPU_COMMON_SAML21

config CPU_FAM_SAMR34
    bool
    select CPU_COMMON_SAML21

## Common CPU symbols
config CPU_FAM
    default "saml21" if CPU_FAM_SAML21
    default "samr30" if CPU_FAM_SAMR30
    default "samr34" if CPU_FAM_SAMR34

config CPU
    default "saml21" if CPU_COMMON_SAML21

source "$(RIOTCPU)/saml21/Kconfig.saml21"
source "$(RIOTCPU)/saml21/Kconfig.samr30"
source "$(RIOTCPU)/saml21/Kconfig.samr34"

source "$(RIOTCPU)/sam0_common/Kconfig"
```

## cpu/saml21/Kconfig.saml21
```kconfig
## CPU Models
config CPU_MODEL_SAML21E15B
    bool
    select CPU_FAM_SAML21

config CPU_MODEL_SAML21E16B
    bool
    select CPU_FAM_SAML21

config CPU_MODEL_SAML21E17B
    bool
    select CPU_FAM_SAML21

config CPU_MODEL_SAML21E18B
    bool
    select CPU_FAM_SAML21

config CPU_MODEL_SAML21G16B
    bool
    select CPU_FAM_SAML21

config CPU_MODEL_SAML21G17B
    bool
    select CPU_FAM_SAML21

config CPU_MODEL_SAML21G18B
    bool
    select CPU_FAM_SAML21

config CPU_MODEL_SAML21J16B
    bool
    select CPU_FAM_SAML21

config CPU_MODEL_SAML21J17B
    bool
    select CPU_FAM_SAML21

config CPU_MODEL_SAML21J17BU
    bool
    select CPU_FAM_SAML21

config CPU_MODEL_SAML21J18B
    bool
    select CPU_FAM_SAML21

config CPU_MODEL_SAML21J18BU
    bool
    select CPU_FAM_SAML21

config CPU_MODEL_SAML21E18A
    bool
    select CPU_FAM_SAML21

config CPU_MODEL_SAML21G18A
    bool
    select CPU_FAM_SAML21

config CPU_MODEL_SAML21J18A
    bool
    select CPU_FAM_SAML21

config CPU_MODEL
    default "saml21e15b" if CPU_MODEL_SAML21E15B
    default "saml21e16b" if CPU_MODEL_SAML21E16B
    default "saml21e17b" if CPU_MODEL_SAML21E17B
    default "saml21e18b" if CPU_MODEL_SAML21E18B
    default "saml21g16b" if CPU_MODEL_SAML21G16B
    default "saml21g17b" if CPU_MODEL_SAML21G17B
    default "saml21g18b" if CPU_MODEL_SAML21G18B
    default "saml21j16b" if CPU_MODEL_SAML21J16B
    default "saml21j17b" if CPU_MODEL_SAML21J17B
    default "saml21j17bu" if CPU_MODEL_SAML21J17BU
    default "saml21j18b" if CPU_MODEL_SAML21J18B
    default "saml21j18bu" if CPU_MODEL_SAML21J18BU
    default "saml21e18a" if CPU_MODEL_SAML21E18A
    default "saml21g18a" if CPU_MODEL_SAML21G18A
    default "saml21j18a" if CPU_MODEL_SAML21J18A
```

## cpu/saml21/Kconfig.samr34
```kconfig
## CPU Models
config CPU_MODEL_SAMR34J16B
    bool
    select CPU_FAM_SAMR34

config CPU_MODEL_SAMR34J17B
    bool
    select CPU_FAM_SAMR34

config CPU_MODEL_SAMR34J18B
    bool
    select CPU_FAM_SAMR34

config CPU_MODEL
    default "samr34j16b" if CPU_MODEL_SAMR34J16B
    default "samr34j17b" if CPU_MODEL_SAMR34J17B
    default "samr34j18b" if CPU_MODEL_SAMR34J18B
```

## cpu/stm32/Kconfig
```kconfig
# Copyright (c) 2020 Inria
#
# This file is subject to the terms and conditions of the GNU Lesser
# General Public License v2.1. See the file LICENSE in the top level
# directory for more details.
#

config CPU_STM32
    bool

menu "STM32 configuration"

# Common CPU symbol
config CPU
    default "stm32" if CPU_STM32


menu "STM32 clock configuration"
    depends on CPU_STM32

rsource "kconfigs/Kconfig.clk"
orsource "kconfigs/$(CPU_FAM)/Kconfig.clk"

endmenu

rsource "kconfigs/$(CPU_FAM)/Kconfig"
rsource "kconfigs/$(CPU_FAM)/Kconfig.lines"
rsource "kconfigs/$(CPU_FAM)/Kconfig.models"

choice
    prompt "ReaDout Protection level"
    default RDP0
    help
        Set minimum running RDP level.
        RDP0 is full debug permissions, RDP1 disables read from Flash but
        otherwise leaves debug enabled, RDP2 disables JTAG completely. If
        there is a mismatch between desired RDP level here and RDP level
        set on the chip, early cpu init will hang.  This ensures production
        devices with the wrong RDP level, by fault or malace intent, will
        not run.  See cpu manual for further details on RDP.
depends on (CPU_FAM_F1 || CPU_FAM_F2 || CPU_FAM_F3 || CPU_FAM_F4 || CPU_FAM_F7)
config RDP0
    bool "RDP0"
config RDP1
    bool "RDP1"
config RDP2
    bool "RDP2"
endchoice

endmenu
```

## cpu/stm32/Kconfig.fam
```kconfig
# Copyright (c) 2020 Inria
#
# This file is subject to the terms and conditions of the GNU Lesser
# General Public License v2.1. See the file LICENSE in the top level
# directory for more details.
#

config CPU_FAM_F0
    bool
    select CPU_STM32
    select CPU_CORE_CORTEX_M0
    select HAS_CPU_STM32F0
    select HAS_PERIPH_FLASHPAGE
    select HAS_PERIPH_FLASHPAGE_RAW

config CPU_FAM_F1
    bool
    select CPU_STM32
    select CPU_CORE_CORTEX_M3
    select HAS_CPU_STM32F1
    select HAS_PERIPH_FLASHPAGE
    select HAS_PERIPH_FLASHPAGE_RAW

config CPU_FAM_F2
    bool
    select CPU_STM32
    select CPU_CORE_CORTEX_M3
    select HAS_CPU_STM32F2
    select HAS_CORTEXM_MPU
    select HAS_PERIPH_HWRNG

config CPU_FAM_F3
    bool
    select CPU_STM32
    select CPU_CORE_CORTEX_M4F
    select HAS_CPU_STM32F3
    select HAS_PERIPH_FLASHPAGE
    select HAS_PERIPH_FLASHPAGE_RAW

config CPU_FAM_F4
    bool
    select CPU_STM32
    select CPU_CORE_CORTEX_M4F
    select HAS_CPU_STM32F4
    select HAS_CORTEXM_MPU

config CPU_FAM_F7
    bool
    select CPU_STM32
    select CPU_CORE_CORTEX_M7
    select HAS_CPU_STM32F7
    select HAS_CORTEXM_MPU
    select HAS_PERIPH_HWRNG

config CPU_FAM_G0
    bool
    select CPU_STM32
    select CPU_CORE_CORTEX_M0PLUS
    select HAS_CPU_STM32G0
    select HAS_PERIPH_FLASHPAGE
    select HAS_PERIPH_FLASHPAGE_RAW

config CPU_FAM_G4
    bool
    select CPU_STM32
    select CPU_CORE_CORTEX_M4
    select HAS_CPU_STM32G4
    select HAS_CORTEXM_MPU
    select HAS_PERIPH_FLASHPAGE
    select HAS_PERIPH_FLASHPAGE_RAW
    select HAS_PERIPH_HWRNG

config CPU_FAM_L0
    bool
    select CPU_STM32
    select CPU_CORE_CORTEX_M0PLUS
    select HAS_CPU_STM32L0
    select HAS_PERIPH_FLASHPAGE
    select HAS_PERIPH_FLASHPAGE_RAW
    select HAS_PERIPH_EEPROM

config CPU_FAM_L1
    bool
    select CPU_STM32
    select CPU_CORE_CORTEX_M3
    select HAS_CPU_STM32L1
    select HAS_CORTEXM_MPU
    select HAS_PERIPH_FLASHPAGE
    select HAS_PERIPH_FLASHPAGE_RAW
    select HAS_PERIPH_EEPROM

config CPU_FAM_L4
    bool
    select CPU_STM32
    select CPU_CORE_CORTEX_M4F
    select HAS_CPU_STM32L4
    select HAS_CORTEXM_MPU
    select HAS_PERIPH_FLASHPAGE
    select HAS_PERIPH_FLASHPAGE_RAW
    select HAS_PERIPH_HWRNG

config CPU_FAM_WB
    bool
    select CPU_STM32
    select CPU_CORE_CORTEX_M4
    select HAS_CPU_STM32WB
    select HAS_PERIPH_FLASHPAGE
    select HAS_PERIPH_FLASHPAGE_RAW
    select HAS_PERIPH_HWRNG
```

## cpu/stm32/Kconfig.features
```kconfig
# Copyright (c) 2020 Inria
#
# This file is subject to the terms and conditions of the GNU Lesser
# General Public License v2.1. See the file LICENSE in the top level
# directory for more details.
#

# Definition of specific features
config HAS_CPU_STM32
    bool
    help
        Indicates that a 'stm32' cpu is being used.

config HAS_CPU_STM32F0
    bool
    help
        Indicates that the cpu being used belongs to the 'stm32f0' family.

config HAS_CPU_STM32F1
    bool
    help
        Indicates that the cpu being used belongs to the 'stm32f1' family.

config HAS_CPU_STM32F2
    bool
    help
        Indicates that the cpu being used belongs to the 'stm32f2' family.

config HAS_CPU_STM32F3
    bool
    help
        Indicates that the cpu being used belongs to the 'stm32f3' family.

config HAS_CPU_STM32F4
    bool
    help
        Indicates that the cpu being used belongs to the 'stm32f4' family.

config HAS_CPU_STM32F7
    bool
    help
        Indicates that the cpu being used belongs to the 'stm32f7' family.

config HAS_CPU_STM32G0
    bool
    help
        Indicates that the cpu being used belongs to the 'stm32g0' family.

config HAS_CPU_STM32G4
    bool
    help
        Indicates that the cpu being used belongs to the 'stm32g4' family.

config HAS_CPU_STM32L0
    bool
    help
        Indicates that the cpu being used belongs to the 'stm32l0' family.

config HAS_CPU_STM32L1
    bool
    help
        Indicates that the cpu being used belongs to the 'stm32l1' family.

config HAS_CPU_STM32L4
    bool
    help
        Indicates that the cpu being used belongs to the 'stm32l4' family.

config HAS_CPU_STM32WB
    bool
    help
        Indicates that the cpu being used belongs to the 'stm32wb' family.

config HAS_BOOTLOADER_STM32
    bool
    help
        Indicates that the stm32 bootloader is being used.
```
