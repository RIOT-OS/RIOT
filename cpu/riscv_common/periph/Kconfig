## cpu/riscv_common/periph/Kconfig
```kconfig
# Copyright (c) 2021 HAW Hamburg
#
# This file is subject to the terms and conditions of the GNU Lesser
# General Public License v2.1. See the file LICENSE in the top level
# directory for more details.
#

config MODULE_RISCV_COMMON_PERIPH
    bool
    default y
    depends on TEST_KCONFIG && CPU_ARCH_RISCV
    help
        Common peripheral code for RISC-V architecture.

if MODULE_RISCV_COMMON_PERIPH

config MODULE_PERIPH_CLIC
    bool
    depends on HAS_PERIPH_CLIC
    help
        Core-Local interrupt controller driver.

config MODULE_PERIPH_CORETIMER
    bool
    depends on HAS_PERIPH_CORETIMER
    help
        Low-level timer driver based on the Core-local Interrupt (CLINT)

config MODULE_PERIPH_PLIC
    bool
    depends on HAS_PERIPH_PLIC
    help
        Platform-Level interrupt controller driver.

endif # MODULE_RISCV_COMMON_PERIPH
```

## cpu/rp2350/Kconfig
```kconfig
# SPDX-FileCopyrightText: 2025 Tom Hert <git@annsann.eu>
# SPDX-FileCopyrightText: 2025 HAW Hamburg
# SPDX-License-Identifier: LGPL-2.1-only

config CPU_FAM_RP2350
    bool
    select CPU_CORE_CORTEX_M33

config CPU_FAM
    default "RP2350" if CPU_FAM_RP2350

config CPU_MODEL_RP2350
    bool
    select CPU_FAM_RP2350

config CPU_MODEL
    default "RP2350" if CPU_MODEL_RP2350

config CPU
    default "rp2350" if CPU_FAM_RP2350


source "$(RIOTCPU)/cortexm_common/Kconfig"
```

## cpu/rp2350_arm/Kconfig
```kconfig
# SPDX-FileCopyrightText: 2025 Tom Hert <git@annsann.eu>
# SPDX-FileCopyrightText: 2025 HAW Hamburg
# SPDX-License-Identifier: LGPL-2.1-only

config CPU_FAM_RP2350_ARM
    bool
    select CPU_CORE_CORTEX_M33

config CPU_FAM
    default "RP2350_ARM" if CPU_FAM_RP2350_ARM

config CPU_MODEL_RP2350_ARM
    bool
    select CPU_FAM_RP2350_ARM

config CPU_MODEL
    default "RP2350_ARM" if CPU_MODEL_RP2350_ARM

config CPU
    default "rp2350_arm" if CPU_FAM_RP2350_ARM


source "$(RIOTCPU)/cortexm_common/Kconfig"
```

## cpu/rpx0xx/Kconfig
```kconfig
# SPDX-FileCopyrightText: 2021 Otto-von-Guericke-Universität Magdeburg
# SPDX-License-Identifier: LGPL-2.1-only

config CPU_FAM_RPX0XX
    bool
    select CPU_CORE_CORTEX_M0PLUS

config CPU_FAM
    default "RPX0XX" if CPU_FAM_RPX0XX

config CPU_MODEL_RP2040
    bool
    select CPU_FAM_RPX0XX

config CPU_MODEL
    default "RP2040" if CPU_MODEL_RP2040

config CPU
    default "rpx0xx" if CPU_FAM_RPX0XX


source "$(RIOTCPU)/cortexm_common/Kconfig"
```

## cpu/sam/sam3/Kconfig
```kconfig
# SPDX-FileCopyrightText: 2020 HAW Hamburg
# SPDX-License-Identifier: LGPL-2.1-only

config CPU_FAM_SAM3
    bool
    select CPU_CORE_CORTEX_M3

## CPU Models
config CPU_MODEL_SAM3X8E
    bool
    select CPU_FAM_SAM3

## Common CPU symbols
config CPU_FAM
    default "sam3" if CPU_FAM_SAM3

config CPU_MODEL
    default "sam3x8e" if CPU_MODEL_SAM3X8E

config CPU
    default "sam3" if CPU_FAM_SAM3

source "$(RIOTCPU)/cortexm_common/Kconfig"
```

## cpu/sam/sam4s/Kconfig
```kconfig
# SPDX-FileCopyrightText: 2025 Mesotic SAS
# SPDX-License-Identifier: LGPL-2.1-only

config CPU_FAM_SAM4S
    bool
    select CPU_CORE_CORTEX_M4

## CPU Models
config CPU_MODEL_SAM4SD32C
    bool
    select CPU_FAM_SAM4S

## Common CPU symbols
config CPU_FAM
    default "sam4s" if CPU_FAM_SAM4S

config CPU_MODEL
    default "sam4sd32c" if CPU_MODEL_SAM4SD32C

config CPU
    default "sam4s" if CPU_FAM_SAM4s

source "$(RIOTCPU)/cortexm_common/Kconfig"
```

## cpu/sam0/common/Kconfig
```kconfig
# SPDX-FileCopyrightText: 2020 HAW Hamburg
# SPDX-License-Identifier: LGPL-2.1-only

config CPU_COMMON_SAM0
    bool

if CPU_COMMON_SAM0

rsource "periph/Kconfig"

endif # CPU_COMMON_SAM0

source "$(RIOTCPU)/cortexm_common/Kconfig"
```

## cpu/sam0/samd5x/Kconfig.samd51
```kconfig
## CPU Models
config CPU_MODEL_SAMD51G18A
    bool
    select CPU_FAM_SAMD51

config CPU_MODEL_SAMD51G19A
    bool
    select CPU_FAM_SAMD51

config CPU_MODEL_SAMD51J18A
    bool
    select CPU_FAM_SAMD51

config CPU_MODEL_SAMD51J19A
    bool
    select CPU_FAM_SAMD51

config CPU_MODEL_SAMD51J20A
    bool
    select CPU_FAM_SAMD51

config CPU_MODEL_SAMD51N19A
    bool
    select CPU_FAM_SAMD51

config CPU_MODEL_SAMD51N20A
    bool
    select CPU_FAM_SAMD51

config CPU_MODEL_SAMD51P19A
    bool
    select CPU_FAM_SAMD51

config CPU_MODEL_SAMD51P20A
    bool
    select CPU_FAM_SAMD51

config CPU_MODEL
    default "samd51g18a" if CPU_MODEL_SAMD51G18A
    default "samd51g19a" if CPU_MODEL_SAMD51G19A
    default "samd51j18a" if CPU_MODEL_SAMD51J18A
    default "samd51j19a" if CPU_MODEL_SAMD51J19A
    default "samd51j20a" if CPU_MODEL_SAMD51J20A
    default "samd51n19a" if CPU_MODEL_SAMD51N19A
    default "samd51n20a" if CPU_MODEL_SAMD51N20A
    default "samd51p19a" if CPU_MODEL_SAMD51P19A
    default "samd51p20a" if CPU_MODEL_SAMD51P20A
```

## cpu/sam0/samd5x/Kconfig.same54
```kconfig
## CPU Models
config CPU_MODEL_SAME54N19A
    bool
    select CPU_FAM_SAME54

config CPU_MODEL_SAME54N20A
    bool
    select CPU_FAM_SAME54

config CPU_MODEL_SAME54P19A
    bool
    select CPU_FAM_SAME54

config CPU_MODEL_SAME54P20A
    bool
    select CPU_FAM_SAME54

config CPU_MODEL
    default "same54n19a" if CPU_MODEL_SAME54N19A
    default "same54n20a" if CPU_MODEL_SAME54N20A
    default "same54p19a" if CPU_MODEL_SAME54P19A
    default "same54p20a" if CPU_MODEL_SAME54P20A
```

## cpu/sam0/saml1x/Kconfig.saml10
```kconfig
## CPU Models
config CPU_MODEL_SAML10D14A
    bool
    select CPU_FAM_SAML10

config CPU_MODEL_SAML10D15A
    bool
    select CPU_FAM_SAML10

config CPU_MODEL_SAML10D16A
    bool
    select CPU_FAM_SAML10

config CPU_MODEL_SAML10E14A
    bool
    select CPU_FAM_SAML10

config CPU_MODEL_SAML10E15A
    bool
    select CPU_FAM_SAML10

config CPU_MODEL_SAML10E16A
    bool
    select CPU_FAM_SAML10

config CPU_MODEL
    default "saml10d14a" if CPU_MODEL_SAML10D14A
    default "saml10d15a" if CPU_MODEL_SAML10D15A
    default "saml10d16a" if CPU_MODEL_SAML10D16A
    default "saml10e14a" if CPU_MODEL_SAML10E14A
    default "saml10e15a" if CPU_MODEL_SAML10E15A
    default "saml10e16a" if CPU_MODEL_SAML10E16A
```

## cpu/sam0/saml1x/Kconfig.saml11
```kconfig
## CPU Models
config CPU_MODEL_SAML11D14A
    bool
    select CPU_FAM_SAML11

config CPU_MODEL_SAML11D15A
    bool
    select CPU_FAM_SAML11

config CPU_MODEL_SAML11D16A
    bool
    select CPU_FAM_SAML11

config CPU_MODEL_SAML11E14A
    bool
    select CPU_FAM_SAML11

config CPU_MODEL_SAML11E15A
    bool
    select CPU_FAM_SAML11

config CPU_MODEL_SAML11E16A
    bool
    select CPU_FAM_SAML11

config CPU_MODEL
    default "saml11d14a" if CPU_MODEL_SAML11D14A
    default "saml11d15a" if CPU_MODEL_SAML11D15A
    default "saml11d16a" if CPU_MODEL_SAML11D16A
    default "saml11e14a" if CPU_MODEL_SAML11E14A
    default "saml11e15a" if CPU_MODEL_SAML11E15A
    default "saml11e16a" if CPU_MODEL_SAML11E16A
```

## cpu/sam0/saml21/Kconfig.samr30
```kconfig
## CPU Models
config CPU_MODEL_SAMR30E18A
    bool
    select CPU_FAM_SAMR30

config CPU_MODEL_SAMR30G18A
    bool
    select CPU_FAM_SAMR30

config CPU_MODEL
    default "samr30e18a" if CPU_MODEL_SAMR30E18A
    default "samr30g18a" if CPU_MODEL_SAMR30G18A
```

## cpu/sam0_common/Kconfig
```kconfig
# Copyright (c) 2020 HAW Hamburg
#
# This file is subject to the terms and conditions of the GNU Lesser
# General Public License v2.1. See the file LICENSE in the top level
# directory for more details.
#

config CPU_COMMON_SAM0
    bool

if CPU_COMMON_SAM0

rsource "periph/Kconfig"

endif # CPU_COMMON_SAM0

source "$(RIOTCPU)/cortexm_common/Kconfig"
```

## cpu/sam0_common/periph/Kconfig
```kconfig
# Copyright (c) 2020 HAW Hamburg
#
# This file is subject to the terms and conditions of the GNU Lesser
# General Public License v2.1. See the file LICENSE in the top level
# directory for more details.

config WDT_WARNING_PERIOD
    depends on HAS_PERIPH_WDT_WARNING_PERIOD && KCONFIG_USEMODULE_PERIPH_WDT
    default 1

if TEST_KCONFIG

config MODULE_SAM0_COMMON_PERIPH
    bool
    default y
    help
        SAM0 common peripheral code.

config MODULE_PERIPH_RTC_RTT
    bool
    default y if MODULE_PERIPH_RTT || MODULE_PERIPH_RTC

config MODULE_PERIPH_UART_NONBLOCKING
    depends on HAS_PERIPH_UART_NONBLOCKING
    depends on MODULE_PERIPH_UART
    select MODULE_TSRB

endif # TEST_KCONFIG
```

## cpu/sam0_common/periph/Kconfig.spi
```kconfig
# Copyright (c) 2020 HAW Hamburg
#
# This file is subject to the terms and conditions of the GNU Lesser
# General Public License v2.1. See the file LICENSE in the top level
# directory for more details.

config SPI_DMA_THRESHOLD_BYTES
    int "SPI DMA threshold (bytes)"
    depends on MODULE_PERIPH_DMA
    depends on MODULE_PERIPH_SPI
    default 16
    help
        Threshold in bytes under which no SPI DMA transfer will be performed.
        Polling will be used instead.
```

## cpu/sam0_common/sam0_eth/Kconfig
```kconfig
# Copyright (c) 2022 HAW Hamburg
#
# This file is subject to the terms and conditions of the GNU Lesser
# General Public License v2.1. See the file LICENSE in the top level
# directory for more details.
#

config MODULE_SAM0_ETH
    bool "SAM0 Ethernet GMAC peripheral"
    depends on TEST_KCONFIG
    depends on CPU_COMMON_SAM0
    depends on HAS_PERIPH_ETH
    select MODULE_PERIPH_GPIO_IRQ
    select MODULE_NETDEV_ETH
    select MODULE_NETDEV_LEGACY_API
    select MODULE_NETOPT
    select MODULE_IOLIST
    select MODULE_PERIPH_ETH

config HAVE_SAM0_ETH
    bool
    select MODULE_SAM0_ETH if MODULE_NETDEV_DEFAULT
    help
        Indicates that a SAM0 ethernet peripheral is present.
```

## cpu/sam3/Kconfig
```kconfig
# Copyright (c) 2020 HAW Hamburg
#
# This file is subject to the terms and conditions of the GNU Lesser
# General Public License v2.1. See the file LICENSE in the top level
# directory for more details.
#

config CPU_FAM_SAM3
    bool
    select CPU_CORE_CORTEX_M3

## CPU Models
config CPU_MODEL_SAM3X8E
    bool
    select CPU_FAM_SAM3

## Common CPU symbols
config CPU_FAM
    default "sam3" if CPU_FAM_SAM3

config CPU_MODEL
    default "sam3x8e" if CPU_MODEL_SAM3X8E

config CPU
    default "sam3" if CPU_FAM_SAM3

source "$(RIOTCPU)/cortexm_common/Kconfig"
```

## cpu/sam4s/Kconfig
```kconfig
# Copyright (c) 2025 Mesotic SAS
#
# This file is subject to the terms and conditions of the GNU Lesser
# General Public License v2.1. See the file LICENSE in the top level
# directory for more details.
#

config CPU_FAM_SAM4S
    bool
    select CPU_CORE_CORTEX_M4

## CPU Models
config CPU_MODEL_SAM4SD32C
    bool
    select CPU_FAM_SAM4S

## Common CPU symbols
config CPU_FAM
    default "sam4s" if CPU_FAM_SAM4S

config CPU_MODEL
    default "sam4sd32c" if CPU_MODEL_SAM4SD32C

config CPU
    default "sam4s" if CPU_FAM_SAM4s

source "$(RIOTCPU)/cortexm_common/Kconfig"
```

## cpu/samd21/Kconfig
```kconfig
# SPDX-FileCopyrightText: 2020 HAW Hamburg
# SPDX-License-Identifier: LGPL-2.1-only

config CPU_COMMON_SAMD21
    bool
    select CPU_COMMON_SAM0
    select CPU_CORE_CORTEX_M0PLUS

config CPU_FAM_SAMD10
    bool
    select CPU_COMMON_SAMD21

config CPU_FAM_SAMD20
    bool
    select CPU_COMMON_SAMD21

config CPU_FAM_SAMD21
    bool
    select CPU_COMMON_SAMD21

config CPU_FAM_SAMR21
    bool
    select CPU_COMMON_SAMD21

## Common CPU symbols
config CPU_FAM
    default "samd10" if CPU_FAM_SAMD10
    default "samd20" if CPU_FAM_SAMD20
    default "samd21" if CPU_FAM_SAMD21
    default "samr21" if CPU_FAM_SAMR21

config CPU
    default "samd21" if CPU_COMMON_SAMD21

source "$(RIOTCPU)/samd21/Kconfig.samd10"
source "$(RIOTCPU)/samd21/Kconfig.samd20"
source "$(RIOTCPU)/samd21/Kconfig.samd21"
source "$(RIOTCPU)/samd21/Kconfig.samr21"

source "$(RIOTCPU)/sam0_common/Kconfig"
```

## cpu/samd21/Kconfig.samd10
```kconfig
## CPU Models
config CPU_MODEL_SAMD10C13A
    bool
    select CPU_FAM_SAMD10

config CPU_MODEL_SAMD10C14A
    bool
    select CPU_FAM_SAMD10

config CPU_MODEL_SAMD10D13AM
    bool
    select CPU_FAM_SAMD10

config CPU_MODEL_SAMD10D13AS
    bool
    select CPU_FAM_SAMD10

config CPU_MODEL_SAMD10D14AM
    bool
    select CPU_FAM_SAMD10

config CPU_MODEL_SAMD10D14AS
    bool
    select CPU_FAM_SAMD10

config CPU_MODEL_SAMD10D14AU
    bool
    select CPU_FAM_SAMD10

config CPU_MODEL
    default "samd10c13a" if CPU_MODEL_SAMD10C13A
    default "samd10c14a" if CPU_MODEL_SAMD10C14A
    default "samd10d13am" if CPU_MODEL_SAMD10D13AM
    default "samd10d13as" if CPU_MODEL_SAMD10D13AS
    default "samd10d14am" if CPU_MODEL_SAMD10D14AM
    default "samd10d14as" if CPU_MODEL_SAMD10D14AS
    default "samd10d14au" if CPU_MODEL_SAMD10D14AU
```

## cpu/samd21/Kconfig.samd20
```kconfig
## CPU Models
config CPU_MODEL_SAMD20E14B
    bool
    select CPU_FAM_SAMD20

config CPU_MODEL_SAMD20E15B
    bool
    select CPU_FAM_SAMD20

config CPU_MODEL_SAMD20E15BU
    bool
    select CPU_FAM_SAMD20

config CPU_MODEL_SAMD20E16B
    bool
    select CPU_FAM_SAMD20

config CPU_MODEL_SAMD20E16BU
    bool
    select CPU_FAM_SAMD20

config CPU_MODEL_SAMD20G14B
    bool
    select CPU_FAM_SAMD20

config CPU_MODEL_SAMD20G15B
    bool
    select CPU_FAM_SAMD20

config CPU_MODEL_SAMD20G16B
    bool
    select CPU_FAM_SAMD20

config CPU_MODEL_SAMD20J14B
    bool
    select CPU_FAM_SAMD20

config CPU_MODEL_SAMD20J15B
    bool
    select CPU_FAM_SAMD20

config CPU_MODEL_SAMD20J16B
    bool
    select CPU_FAM_SAMD20

config CPU_MODEL_SAMD20E14
    bool
    select CPU_FAM_SAMD20

config CPU_MODEL_SAMD20E15
    bool
    select CPU_FAM_SAMD20

config CPU_MODEL_SAMD20E16
    bool
    select CPU_FAM_SAMD20

config CPU_MODEL_SAMD20E17
    bool
    select CPU_FAM_SAMD20

config CPU_MODEL_SAMD20E18
    bool
    select CPU_FAM_SAMD20

config CPU_MODEL_SAMD20G14
    bool
    select CPU_FAM_SAMD20

config CPU_MODEL_SAMD20G15
    bool
    select CPU_FAM_SAMD20

config CPU_MODEL_SAMD20G16
    bool
    select CPU_FAM_SAMD20

config CPU_MODEL_SAMD20G17
    bool
    select CPU_FAM_SAMD20

config CPU_MODEL_SAMD20G17U
    bool
    select CPU_FAM_SAMD20

config CPU_MODEL_SAMD20G18
    bool
    select CPU_FAM_SAMD20

config CPU_MODEL_SAMD20G18U
    bool
    select CPU_FAM_SAMD20

config CPU_MODEL_SAMD20J14
    bool
    select CPU_FAM_SAMD20

config CPU_MODEL_SAMD20J15
    bool
    select CPU_FAM_SAMD20

config CPU_MODEL_SAMD20J16
    bool
    select CPU_FAM_SAMD20

config CPU_MODEL_SAMD20J17
    bool
    select CPU_FAM_SAMD20

config CPU_MODEL_SAMD20J18
    bool
    select CPU_FAM_SAMD20

config CPU_MODEL
    default "samd20e14b" if CPU_MODEL_SAMD20E14B
    default "samd20e15b" if CPU_MODEL_SAMD20E15B
    default "samd20e15bu" if CPU_MODEL_SAMD20E15BU
    default "samd20e16b" if CPU_MODEL_SAMD20E16B
    default "samd20e16bu" if CPU_MODEL_SAMD20E16BU
    default "samd20g14b" if CPU_MODEL_SAMD20G14B
    default "samd20g15b" if CPU_MODEL_SAMD20G15B
    default "samd20g16b" if CPU_MODEL_SAMD20G16B
    default "samd20j14b" if CPU_MODEL_SAMD20J14B
    default "samd20j15b" if CPU_MODEL_SAMD20J15B
    default "samd20j16b" if CPU_MODEL_SAMD20J16B
    default "samd20e14" if CPU_MODEL_SAMD20E14
    default "samd20e15" if CPU_MODEL_SAMD20E15
    default "samd20e16" if CPU_MODEL_SAMD20E16
    default "samd20e17" if CPU_MODEL_SAMD20E17
    default "samd20e18" if CPU_MODEL_SAMD20E18
    default "samd20g14" if CPU_MODEL_SAMD20G14
    default "samd20g15" if CPU_MODEL_SAMD20G15
    default "samd20g16" if CPU_MODEL_SAMD20G16
    default "samd20g17" if CPU_MODEL_SAMD20G17
    default "samd20g17u" if CPU_MODEL_SAMD20G17U
    default "samd20g18" if CPU_MODEL_SAMD20G18
    default "samd20g18u" if CPU_MODEL_SAMD20G18U
    default "samd20j14" if CPU_MODEL_SAMD20J14
    default "samd20j15" if CPU_MODEL_SAMD20J15
    default "samd20j16" if CPU_MODEL_SAMD20J16
    default "samd20j17" if CPU_MODEL_SAMD20J17
    default "samd20j18" if CPU_MODEL_SAMD20J18
```
