## cpu/samd21/Kconfig.samd21
```kconfig
## CPU Models
config CPU_MODEL_SAMD21E15A
    bool
    select CPU_FAM_SAMD21

config CPU_MODEL_SAMD21E16A
    bool
    select CPU_FAM_SAMD21

config CPU_MODEL_SAMD21E17A
    bool
    select CPU_FAM_SAMD21

config CPU_MODEL_SAMD21E18A
    bool
    select CPU_FAM_SAMD21

config CPU_MODEL_SAMD21G15A
    bool
    select CPU_FAM_SAMD21

config CPU_MODEL_SAMD21G16A
    bool
    select CPU_FAM_SAMD21

config CPU_MODEL_SAMD21G17A
    bool
    select CPU_FAM_SAMD21

config CPU_MODEL_SAMD21G17AU
    bool
    select CPU_FAM_SAMD21

config CPU_MODEL_SAMD21G18A
    bool
    select CPU_FAM_SAMD21

config CPU_MODEL_SAMD21G18AU
    bool
    select CPU_FAM_SAMD21

config CPU_MODEL_SAMD21J15A
    bool
    select CPU_FAM_SAMD21

config CPU_MODEL_SAMD21J16A
    bool
    select CPU_FAM_SAMD21

config CPU_MODEL_SAMD21J17A
    bool
    select CPU_FAM_SAMD21

config CPU_MODEL_SAMD21J18A
    bool
    select CPU_FAM_SAMD21

config CPU_MODEL_SAMD21E15BU
    bool
    select CPU_FAM_SAMD21

config CPU_MODEL_SAMD21E16BU
    bool
    select CPU_FAM_SAMD21

config CPU_MODEL_SAMD21E15B
    bool
    select CPU_FAM_SAMD21

config CPU_MODEL_SAMD21E15CU
    bool
    select CPU_FAM_SAMD21

config CPU_MODEL_SAMD21E15L
    bool
    select CPU_FAM_SAMD21

config CPU_MODEL_SAMD21E16B
    bool
    select CPU_FAM_SAMD21

config CPU_MODEL_SAMD21E16CU
    bool
    select CPU_FAM_SAMD21

config CPU_MODEL_SAMD21E16L
    bool
    select CPU_FAM_SAMD21

config CPU_MODEL_SAMD21G15B
    bool
    select CPU_FAM_SAMD21

config CPU_MODEL_SAMD21G15L
    bool
    select CPU_FAM_SAMD21

config CPU_MODEL_SAMD21G16B
    bool
    select CPU_FAM_SAMD21

config CPU_MODEL_SAMD21G16L
    bool
    select CPU_FAM_SAMD21

config CPU_MODEL_SAMD21J15B
    bool
    select CPU_FAM_SAMD21

config CPU_MODEL_SAMD21J16B
    bool
    select CPU_FAM_SAMD21

config CPU_MODEL_SAMD21E17D
    bool
    select CPU_FAM_SAMD21

config CPU_MODEL_SAMD21E17DU
    bool
    select CPU_FAM_SAMD21

config CPU_MODEL_SAMD21E17L
    bool
    select CPU_FAM_SAMD21

config CPU_MODEL_SAMD21G17D
    bool
    select CPU_FAM_SAMD21

config CPU_MODEL_SAMD21G17L
    bool
    select CPU_FAM_SAMD21

config CPU_MODEL_SAMD21J17D
    bool
    select CPU_FAM_SAMD21

config CPU_MODEL
    default "samd21e15a" if CPU_MODEL_SAMD21E15A
    default "samd21e16a" if CPU_MODEL_SAMD21E16A
    default "samd21e17a" if CPU_MODEL_SAMD21E17A
    default "samd21e18a" if CPU_MODEL_SAMD21E18A
    default "samd21g15a" if CPU_MODEL_SAMD21G15A
    default "samd21g16a" if CPU_MODEL_SAMD21G16A
    default "samd21g17a" if CPU_MODEL_SAMD21G17A
    default "samd21g17au" if CPU_MODEL_SAMD21G17AU
    default "samd21g18a" if CPU_MODEL_SAMD21G18A
    default "samd21g18au" if CPU_MODEL_SAMD21G18AU
    default "samd21j15a" if CPU_MODEL_SAMD21J15A
    default "samd21j16a" if CPU_MODEL_SAMD21J16A
    default "samd21j17a" if CPU_MODEL_SAMD21J17A
    default "samd21j18a" if CPU_MODEL_SAMD21J18A
    default "samd21e15bu" if CPU_MODEL_SAMD21E15BU
    default "samd21e16bu" if CPU_MODEL_SAMD21E16BU
    default "samd21e15b" if CPU_MODEL_SAMD21E15B
    default "samd21e15cu" if CPU_MODEL_SAMD21E15CU
    default "samd21e15l" if CPU_MODEL_SAMD21E15L
    default "samd21e16b" if CPU_MODEL_SAMD21E16B
    default "samd21e16cu" if CPU_MODEL_SAMD21E16CU
    default "samd21e16l" if CPU_MODEL_SAMD21E16L
    default "samd21g15b" if CPU_MODEL_SAMD21G15B
    default "samd21g15l" if CPU_MODEL_SAMD21G15L
    default "samd21g16b" if CPU_MODEL_SAMD21G16B
    default "samd21g16l" if CPU_MODEL_SAMD21G16L
    default "samd21j15b" if CPU_MODEL_SAMD21J15B
    default "samd21j16b" if CPU_MODEL_SAMD21J16B
    default "samd21e17d" if CPU_MODEL_SAMD21E17D
    default "samd21e17du" if CPU_MODEL_SAMD21E17DU
    default "samd21e17l" if CPU_MODEL_SAMD21E17L
    default "samd21g17d" if CPU_MODEL_SAMD21G17D
    default "samd21g17l" if CPU_MODEL_SAMD21G17L
    default "samd21j17d" if CPU_MODEL_SAMD21J17D
```

## cpu/samd21/Kconfig.samr21
```kconfig
## CPU Models
config CPU_MODEL_SAMR21E16A
    bool
    select CPU_FAM_SAMR21

config CPU_MODEL_SAMR21E17A
    bool
    select CPU_FAM_SAMR21

config CPU_MODEL_SAMR21E18A
    bool
    select CPU_FAM_SAMR21

config CPU_MODEL_SAMR21E19A
    bool
    select CPU_FAM_SAMR21

config CPU_MODEL_SAMR21G16A
    bool
    select CPU_FAM_SAMR21

config CPU_MODEL_SAMR21G17A
    bool
    select CPU_FAM_SAMR21

config CPU_MODEL_SAMR21G18A
    bool
    select CPU_FAM_SAMR21

config CPU_MODEL
    default "samr21e16a" if CPU_MODEL_SAMR21E16A
    default "samr21e17a" if CPU_MODEL_SAMR21E17A
    default "samr21e18a" if CPU_MODEL_SAMR21E18A
    default "samr21e19a" if CPU_MODEL_SAMR21E19A
    default "samr21g16a" if CPU_MODEL_SAMR21G16A
    default "samr21g17a" if CPU_MODEL_SAMR21G17A
    default "samr21g18a" if CPU_MODEL_SAMR21G18A
```

## cpu/samd21/vectors/Kconfig
```kconfig
# Copyright (c) 2020 ML!PA Consulting GmbH
#
# This file is subject to the terms and conditions of the GNU Lesser
# General Public License v2.1. See the file LICENSE in the top level
# directory for more details.

config MODULE_SAMD21_VECTORS
    bool
    default y
    depends on CPU_COMMON_SAMD21
    help
        SAM D1x/D2x interrupt vector table.
```

## cpu/samd5x/Kconfig
```kconfig
# SPDX-FileCopyrightText: 2020 HAW Hamburg
# SPDX-License-Identifier: LGPL-2.1-only

config CPU_COMMON_SAMD5X
    bool
    select CPU_COMMON_SAM0
    select CPU_CORE_CORTEX_M4F

config CPU_FAM_SAMD51
    bool
    select CPU_COMMON_SAMD5X

config CPU_FAM_SAME54
    bool
    select CPU_COMMON_SAMD5X

## CPU common symbols
config CPU_FAM
    default "samd51" if CPU_FAM_SAMD51
    default "same54" if CPU_FAM_SAME54

config CPU
    default "samd5x" if CPU_COMMON_SAMD5X

source "$(RIOTCPU)/samd5x/Kconfig.samd51"
source "$(RIOTCPU)/samd5x/Kconfig.same54"

source "$(RIOTCPU)/sam0_common/Kconfig"
```
