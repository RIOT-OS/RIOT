## cpu/esp32/esp-idf/wifi/Kconfig
```kconfig
# Copyright (c) 2022 Gunar Schorcht
#
# This file is subject to the terms and conditions of the GNU Lesser
# General Public License v2.1. See the file LICENSE in the top level
# directory for more details.
#

config MODULE_ESP_IDF_WIFI
    bool
    depends on TEST_KCONFIG
    depends on MODULE_ESP_IDF

    select MODULE_ESP_IDF_ADC

    help
        ESP-IDF code required for accessing the WiFi interface.
```

## cpu/esp32/esp-idf/wpa_supplicant/Kconfig
```kconfig
# SPDX-FileCopyrightText: 2021 HAW Hamburg
# SPDX-FileCopyrightText: 2022 Gunar Schorcht
# SPDX-License-Identifier: LGPL-2.1-only

rsource "esp_supplicant/Kconfig"
rsource "port/Kconfig"
rsource "src/ap/Kconfig"
rsource "src/common/Kconfig"
rsource "src/crypto/Kconfig"
rsource "src/eap_peer/Kconfig"
rsource "src/rsn_supp/Kconfig"
rsource "src/tls/Kconfig"
rsource "src/utils/Kconfig"
rsource "src/wps/Kconfig"
```

## cpu/esp32/esp-lcd/Kconfig
```kconfig
# Copyright (c) 2023 Gunar Schorcht
#
# This file is subject to the terms and conditions of the GNU Lesser
# General Public License v2.1. See the file LICENSE in the top level
# directory for more details.
#

if USEMODULE_ESP_LCD

config LCD_WRITE_CLOCK_MHZ
    int "LCD write clock rate in MHz"
    range 1 80
    depends on CPU_FAM_ESP32 || CPU_FAM_ESP32S2 || CPU_FAM_ESP32S3
    default 10 if CPU_FAM_ESP32
    default 40 if CPU_FAM_ESP32S2
    default 20 if CPU_FAM_ESP32S3
    help
        Defines the clock rate that is used for the LCD write signal. It
        depends on used ESP32x SoC variant and used display interface.

config LCD_DATA_BUF_SIZE
    int "LCD data buffer size in byte"
    depends on CPU_FAM_ESP32 || CPU_FAM_ESP32S2 || CPU_FAM_ESP32S3
    default 512
    help
        Defines the size of the buffers used to write data to the LCD
        screen. Since double buffering is used, there are two buffers
        of this size. One buffer is used first by the LCD driver to
        write the data that needs to be transferred to the LCD, and
        one buffer from which the DMA then transfers the data to the
        LCD peripherals. This allows data to be written before the
        DMA transfer is complete. The larger the buffers, the better
        the performance, but the higher the memory requirements.

endif
```

## cpu/esp32/periph/Kconfig
```kconfig
# Copyright (c) 2021 HAW Hamburg
#
# This file is subject to the terms and conditions of the GNU Lesser
# General Public License v2.1. See the file LICENSE in the top level
# directory for more details.
#

choice ESP_FLASHPAGE_CAPACITY
    bool "Flashpage capacity"
    default ESP_FLASHPAGE_CAPACITY_512K
    depends on USEMODULE_PERIPH_FLASHPAGE
    config ESP_FLASHPAGE_CAPACITY_64K
        bool "64 kByte"
    config ESP_FLASHPAGE_CAPACITY_128K
        bool "128 kByte"
    config ESP_FLASHPAGE_CAPACITY_256K
        bool "256 kByte"
    config ESP_FLASHPAGE_CAPACITY_512K
        bool "512 kByte"
    config ESP_FLASHPAGE_CAPACITY_1M
        bool "1 MByte"
    config ESP_FLASHPAGE_CAPACITY_2M
        bool "2 MByte"
endchoice
```

## cpu/esp32/periph/Kconfig.i2c
```kconfig
# Copyright (c) 2021 HAW Hamburg
#
# This file is subject to the terms and conditions of the GNU Lesser
# General Public License v2.1. See the file LICENSE in the top level
# directory for more details.
#

if TEST_KCONFIG

choice
    bool "I2C implementation"
    depends on MODULE_PERIPH_I2C
    help
      Due to the poor and faulty hardware I2C implementation the software one
      is used by default for the moment.

config MODULE_ESP_I2C_SW
    bool "Software"
    select MODULE_PERIPH_I2C_SW

config MODULE_ESP_I2C_HW
    bool "Hardware"
    select MODULE_CORE_THREAD_FLAGS
    select MODULE_ZTIMER
    select MODULE_ZTIMER_MSEC
    select MODULE_PERIPH_I2C_HW

endchoice

config MODULE_PERIPH_I2C_HW
    bool
    help
      Hardware implementation of I2C.

endif # TEST_KCONFIG
```

## cpu/esp32/periph/Kconfig.timer
```kconfig
# Copyright (c) 2021 HAW Hamburg
#
# This file is subject to the terms and conditions of the GNU Lesser
# General Public License v2.1. See the file LICENSE in the top level
# directory for more details.
#

if TEST_KCONFIG

config MODULE_ESP_HW_COUNTER
    bool "Enable hardware counter as low-level timer peripheral"
    depends on HAS_ESP_HW_COUNTER
    depends on MODULE_PERIPH_TIMER

endif # TEST_KCONFIG
```

## cpu/esp32/stdio_usb_serial_jtag/Kconfig
```kconfig
choice STDIO_IMPLEMENTATION

config MODULE_STDIO_USB_SERIAL_JTAG
    bool "STDIO via ESP32 Debug USB Serial/JTAG interface"
    depends on TEST_KCONFIG
    depends on CPU_FAM_ESP32C3 || CPU_FAM_ESP32S3
    select MODULE_TSRB

endchoice
```

## cpu/esp32/vendor/esp-idf/Kconfig
```kconfig
# Copyright (c) 2021 HAW Hamburg
#
# This file is subject to the terms and conditions of the GNU Lesser
# General Public License v2.1. See the file LICENSE in the top level
# directory for more details.
#

config MODULE_ESP_IDF
    bool
    depends on TEST_KCONFIG
    depends on HAS_ARCH_ESP32
    default y
    select MODULE_ESP_IDF_DRIVER
    select MODULE_ESP_IDF_ESP32
    select MODULE_ESP_IDF_SOC
    help
      Espressif IoT Development Framework.

rsource "driver/Kconfig"
rsource "esp32/Kconfig"
rsource "ethernet/Kconfig"
rsource "heap/Kconfig"
rsource "nvs_flash/Kconfig"
rsource "soc/Kconfig"
rsource "spi_flash/Kconfig"
rsource "wpa_supplicant/Kconfig"
```

## cpu/esp32/vendor/esp-idf/nvs_flash/Kconfig
```kconfig
# Copyright (c) 2021 HAW Hamburg
#
# This file is subject to the terms and conditions of the GNU Lesser
# General Public License v2.1. See the file LICENSE in the top level
# directory for more details.
#

config MODULE_ESP_IDF_NVS_FLASH
    bool
    depends on TEST_KCONFIG
    depends on MODULE_ESP_IDF
    select MODULE_MTD
    help
        Non-volatile storage library.
```

## cpu/esp8266/Kconfig
```kconfig
# Copyright (c) 2020 HAW Hamburg
#
# This file is subject to the terms and conditions of the GNU Lesser
# General Public License v2.1. See the file LICENSE in the top level
# directory for more details.

config CPU_CORE_XTENSA_L106
    bool
    select CPU_ARCH_XTENSA

config CPU_FAM_ESP8266
    bool
    select CPU_COMMON_ESP
    select CPU_CORE_XTENSA_L106
    select HAS_ARCH_ESP8266
    select HAS_CPU_ESP8266

    select PACKAGE_ESP8266_SDK if TEST_KCONFIG
    select MODULE_ESP_SDK if TEST_KCONFIG
    select MODULE_ESP_IDF_ESP8266 if TEST_KCONFIG
    select MODULE_ESP_IDF_NVS_FLASH if TEST_KCONFIG
    select MODULE_ESP_IDF_SPI_FLASH if TEST_KCONFIG
    select MODULE_ESP_IDF_UTIL if TEST_KCONFIG
    select MODULE_ESP_IDF_WPA_SUPPLICANT_CRYPTO if TEST_KCONFIG
    select MODULE_ESP_SDK if TEST_KCONFIG
    select MODULE_PERIPH_COMMON if TEST_KCONFIG
    select MODULE_RTT_RTC if HAS_PERIPH_RTT && MODULE_PERIPH_RTC
    select MODULE_ZTIMER_NO_PERIPH_RTT if MODULE_ESP_WIFI_ANY

## CPU Models
config CPU_MODEL_ESP8266EX
    bool
    select CPU_FAM_ESP8266

config CPU_MODEL_ESP8266_ESP_12X
    bool
    select CPU_FAM_ESP8266

## Definition of specific features
config HAS_ARCH_ESP8266
    bool
    help
        Indicates that the current architecture is ESP8266.

config HAS_CPU_ESP8266
    bool
    help
        Indicates that the current CPU is 'esp8266'.

## Common CPU symbols
config CPU_CORE
    default "xtensa-l106" if CPU_CORE_XTENSA_L106

config CPU_FAM
    default "esp8266" if CPU_FAM_ESP8266

config CPU_MODEL
    default "esp8266ex" if CPU_MODEL_ESP8266EX
    default "esp8266-esp-12x" if CPU_MODEL_ESP8266_ESP_12X

config CPU
    default "esp8266" if CPU_FAM_ESP8266

menu "ESP8266 specific configurations"
    depends on TEST_KCONFIG
    depends on HAS_ARCH_ESP8266

    choice
        bool "CPU clock frequency"
        default ESP8266_CPU_FREQUENCY_80

        config ESP8266_CPU_FREQUENCY_80
            bool "80 MHz"
        config ESP8266_CPU_FREQUENCY_160
            bool "160 MHz"
    endchoice

endmenu

source "$(RIOTCPU)/esp_common/Kconfig"

config MODULE_ESP_I2C_SW
    bool
    default y if MODULE_PERIPH_I2C
    select MODULE_PERIPH_I2C_SW

rsource "sdk/Kconfig"
rsource "vendor/Kconfig"
```

## cpu/esp8266/esp-wifi/Kconfig
```kconfig
# Copyright (c) 2020 Gunar Schorcht
#
# This file is subject to the terms and conditions of the GNU Lesser
# General Public License v2.1. See the file LICENSE in the top level
# directory for more details.
#

menuconfig KCONFIG_MODULE_ESP_WIFI
    bool "Configure ESP-WiFi netdev"
    depends on MODULE_ESP_WIFI
    help
        Configure ESP-Wifi netdev when module esp_wifi is used.

if KCONFIG_MODULE_ESP_WIFI

config ESP_WIFI_SSID
    string "SSID"
    default "RIOT_AP"
    help
        This string defines the SSID of the AP to be used.

config ESP_WIFI_PASS
    string "Passphrase for WPA2"
    default "ThisistheRIOTporttoESP"
    help
        This string defines the passphrase as plain text, which is used for
        the AP during WPA2 authentication. It can be up to 64 characters long.

endif # KCONFIG_MODULE_ESP_WIFI
```

## cpu/esp8266/sdk/Kconfig
```kconfig
# Copyright (c) 2021 HAW Hamburg
#
# This file is subject to the terms and conditions of the GNU Lesser
# General Public License v2.1. See the file LICENSE in the top level
# directory for more details.
#

config MODULE_ESP_SDK
    bool
    depends on TEST_KCONFIG
    depends on HAS_ARCH_ESP8266
```

## cpu/esp8266/vendor/esp-idf/Kconfig
```kconfig
# Copyright (c) 2021 HAW Hamburg
#
# This file is subject to the terms and conditions of the GNU Lesser
# General Public License v2.1. See the file LICENSE in the top level
# directory for more details.
#

rsource "heap/src/Kconfig"
rsource "nvs_flash/src/Kconfig"
rsource "spi_flash/Kconfig"
rsource "util/src/Kconfig"
rsource "wpa_supplicant/Kconfig"
```

## cpu/esp8266/vendor/esp-idf/wpa_supplicant/Kconfig
```kconfig
# Copyright (c) 2021 HAW Hamburg
#
# This file is subject to the terms and conditions of the GNU Lesser
# General Public License v2.1. See the file LICENSE in the top level
# directory for more details.
#

rsource "port/Kconfig"
rsource "src/crypto/Kconfig"
```

## cpu/esp_common/Kconfig
```kconfig
# Copyright (c) 2020 HAW Hamburg
#
# This file is subject to the terms and conditions of the GNU Lesser
# General Public License v2.1. See the file LICENSE in the top level
# directory for more details.

config CPU_ARCH_XTENSA
    bool
    help
        Xtensa based architecture is used for the ESP8266 or the ESP32x SoC variant

config CPU_ARCH_RISCV
    bool
    help
        RISC-V based architecture is used for the ESP32x SoC variant.

config CPU_COMMON_ESP
    bool

## Common CPU symbols
config CPU_ARCH
    default "xtensa" if CPU_ARCH_XTENSA
    default "rv32" if CPU_ARCH_RISCV
```

## cpu/esp_common/Kconfig.netdev.esp_now
```kconfig
# Copyright (c) 2021 Gunar Schorcht
#
# This file is subject to the terms and conditions of the GNU Lesser
# General Public License v2.1. See the file LICENSE in the top level
# directory for more details.

menuconfig ESP_NOW_NETDEV
    bool "ESP NOW interface used"
    depends on HAS_ESP_NOW
    default y if TEST_KCONFIG && MODULE_NETDEV_DEFAULT && !ESP_ETH_NETDEV && !MODULE_LWIP
    select MODULE_ESP_NOW

if ESP_NOW_NETDEV
    config ESP_NOW_SOFT_AP_PASS
        string "ESP-NOW Passphrase used by all ESP-NOW nodes"
        default "This is RIOT-OS"
        help
            The passphrase is used for the SoftAP interface of ESP-NOW
            nodes. It is defined as a clear text string with a maximum
            of 64 characters and must be the same for all ESP-NOW nodes
            in the network.

    config ESP_NOW_CHANNEL
        int "ESP-NOW Channel for ESP-NOW in the 2.4 GHz band"
        default 6
        range 1 13
        help
            The channel is in the range of 1 to 13. In some regions
            not all 13 channels may be used for regulatory reasons.
            Select a channel that is allowed in your region.
            If ESP-NOW is used together with an infrastructure WiFi
            network, e.g. to realize a border router, the channel must
            be the same as used by the AP of the infrastructure WiFi.

    config ESP_NOW_SCAN_PERIOD_MS
        int "ESP-NOW Scan interval [ms]"
        default 10000
        help
            Each node searches for other nodes in its range with the
            defined interval.

    config ESP_NOW_KEY
        string "ESP-NOW 128-bit key used for encrypted communication"
        default ""
        help
            The key has to be defined to enable encrypted communication
            between ESP-NOW nodes. The key is 16 bytes long and is
            defined by a string of 8-bit hex values separated by spaces,
            for example: "0f 1e 2d 3c 4b 5a 69 78 87 96 a5 b4 c3 d2 e1 f0"
            An empty string for this parameter means that the encryption
            is not used. If less than 16 bytes are defined by the string,
            the remaining bytes of the key are filled with 0.

endif # ESP_NOW_NETDEV
```
