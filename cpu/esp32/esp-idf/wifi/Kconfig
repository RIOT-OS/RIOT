## cpu/esp_common/Kconfig.netdev.esp_wifi
```kconfig
# Copyright (c) 2021 Gunar Schorcht
#
# This file is subject to the terms and conditions of the GNU Lesser
# General Public License v2.1. See the file LICENSE in the top level
# directory for more details.

menuconfig ESP_WIFI_NETDEV
    bool "ESP WiFi interface used"
    depends on HAS_ESP_WIFI
    default y if TEST_KCONFIG && MODULE_NETDEV_DEFAULT && !ESP_ETH_NETDEV && MODULE_LWIP
    select MODULE_ESP_WIFI

if ESP_WIFI_NETDEV

    choice
        bool "Mode"
        default ESP_WIFI_NETDEV_PERSONAL_MODE

        config ESP_WIFI_NETDEV_PERSONAL_MODE
            bool "WPA2 Personal Mode"
            help
                Indicates that the WiFi interface is used in
                WPA2 Personal Mode.

        config ESP_WIFI_NETDEV_ENTERPRISE_MODE
            bool "WPA2 Enterprise Mode"
            depends on HAS_ESP_WIFI_ENTERPRISE
            help
                Indicates that the WiFi interface is used in
                WPA2 Enterprise Mode with IEEE 802.1X/EAP authentication.

        config ESP_WIFI_NETDEV_SOFTAP_MODE
            bool "SoftAP Mode"
            help
                Indicates that the WiFi interface is used in
                SoftAP mode.
    endchoice

    config ESP_WIFI_SSID
        string "SSID"
        default "RIOT_AP"
        help
            In station mode, the SSID is used to define the AP to which
            the node should connect. In SoftAP mode, the SSID is used as a
            static SSID or as prefix for dynamic SSID generation.
            The SSID must not contain more than 32 characters.

    config ESP_WIFI_USE_WPA2
        bool "Use WPA2 authentication"
        depends on ESP_WIFI_NETDEV_PERSONAL_MODE || ESP_WIFI_NETDEV_SOFTAP_MODE
        default y
        help
            Specify whether WPA2 authentication is used to connect to the
            AP or to the SoftAP network interface in SoftAP mode. If WPA2
            authentication is enabled, the passphrase has to be defined.
            Otherwise an "open" AP without WPA2 authentication is used in
            station mode or the SoftAP interface is "open" in SoftAP mode.

    config ESP_WIFI_PASS
        string "Passphrase for WPA2 Personal Mode authentication"
        depends on ESP_WIFI_USE_WPA2
        default "This is RIOT-OS"
        help
            The passphrase is defined as a clear text string with a maximum
            of 64 characters. It is used for WPA2 personal mode authentication
            in station mode and the SoftAP network interface in SoftAP mode.

if ESP_WIFI_NETDEV_SOFTAP_MODE

    config ESP_WIFI_SSID_DYNAMIC
        bool "Dynamic SSID is used"
        help
            If set, a dynamic SSID is generated for the SoftAP by extending
            the defined SSID with the MAC address of the SoftAP interface used,
            e.g.: RIOT_AP_aabbccddeeff

    config ESP_WIFI_SSID_HIDDEN
        bool "SSID should be hidden"
        default n
        help
            Select to define that the SoftAP SSID should be hidden.

    config ESP_WIFI_MAX_CONN
        int "Maximum number of connecttions"
        default 4

    config ESP_WIFI_BEACON_INTERVAL
        int "Beacon intervall [ms]"
        default 100

endif # ESP_WIFI_NETDEV_SOFTAP_MODE

if ESP_WIFI_NETDEV_ENTERPRISE_MODE

    config ESP_WIFI_EAP_ID
        string "Anonymous identity (optional)"
        help
            Optional anonymous identity used in phase 1 (outer) EAP
            authentication. If it is not defined, the user name as defined
            for phase 2 (inner) EAP authentication is used. Please note
            that the identity in phase 1 (outer) authentication is
            sent as plain text with no encryption.

    config ESP_WIFI_EAP_USER
        string "User name"
        help
            Specify the user name required for phase 2 (inner) EAP
            authentication to identify the user.

    config ESP_WIFI_EAP_PASS
        string "Password"
        help
            Specify the password required for phase 2 (inner) EAP
            authentication.

endif # ESP_WIFI_NETDEV_ENTERPRISE_MODE

endif # ESP_WIFI_NETDEV
```

## cpu/esp_common/esp-now/Kconfig
```kconfig
# Copyright (c) 2020 Gunar Schorcht
#
# This file is subject to the terms and conditions of the GNU Lesser
# General Public License v2.1. See the file LICENSE in the top level
# directory for more details.
#

menuconfig KCONFIG_MODULE_ESP_NOW
    bool "Configure ESP-NOW netdev"
    depends on MODULE_ESP_NOW
    help
        Configure ESP-NOW netdev when module esp_now is used.

if KCONFIG_MODULE_ESP_NOW

config ESP_NOW_CHANNEL
    int "WiFi channel"
    default 6
    help
        The WiFi channel that is used as by all ESP-NOW nodes.

config ESP_NOW_SCAN_PERIOD
    int "Scan period in microseconds"
    default 10000000
    help
        Period in microseconds at which an ESP-NOW node scans for other
        ESP-NOW nodes in its range.

config ESP_NOW_SOFT_AP_PASS
    string "SoftAP interface passphrase"
    default "ThisistheRIOTporttoESP"
    help
        Passphrase used for the SoftAP interface of all ESP-NOW nodes.

        ESP_NOW uses the WiFi interface in Station and SoftAP mode
        simultaneously to build a peer-to-peer network. A passphrase is
        required for the SoftAP mode. This passphrase is used by all ESP-NOW
        nodes to establish the connection between them in the peer-to-peer
        network.

endif # KCONFIG_MODULE_ESP_NOW
```

## cpu/esp_common/esp-xtensa/Kconfig
```kconfig
# Copyright (c) 2022 Gunar Schorcht
#
# This file is subject to the terms and conditions of the GNU Lesser
# General Public License v2.1. See the file LICENSE in the top level
# directory for more details.
#

config MODULE_ESP_XTENSA
    bool
    depends on TEST_KCONFIG
    depends on HAS_ARCH_ESP_XTENSA
    default y
    help
        Platform-dependent code for Xtensa-based ESP SoCs.
```

## cpu/esp_common/freertos/Kconfig
```kconfig
# Copyright (c) 2021 HAW Hamburg
#
# This file is subject to the terms and conditions of the GNU Lesser
# General Public License v2.1. See the file LICENSE in the top level
# directory for more details.
#

if TEST_KCONFIG && HAS_ARCH_ESP

config MODULE_ESP_FREERTOS
    bool
    default y
    help
      FreeRTOS to RIOT-OS adaption module for ESP SoCs source code compatibility.

config MODULE_ESP_FREERTOS_COMMON
    bool
    default MODULE_ESP_FREERTOS

endif # TEST_KCONFIG && HAS_ARCH_ESP
```

## cpu/esp_common/vendor/xtensa/Kconfig
```kconfig
# Copyright (c) 2021 HAW Hamburg
#
# This file is subject to the terms and conditions of the GNU Lesser
# General Public License v2.1. See the file LICENSE in the top level
# directory for more details.
#

config MODULE_XTENSA
    bool
    depends on TEST_KCONFIG
    depends on HAS_ARCH_ESP
    default y
    help
        Third-party software components used by the RIOT port for ESP32 and
        ESP8266.
```

## cpu/ezr32wg/Kconfig
```kconfig
# Copyright (c) 2020 HAW Hamburg
#
# This file is subject to the terms and conditions of the GNU Lesser
# General Public License v2.1. See the file LICENSE in the top level
# directory for more details.

config CPU_FAM_EZR32WG
    bool
    select CPU_CORE_CORTEX_M4F
    select HAS_CORTEXM_MPU
    select HAS_CPU_EZR32WG
    select HAS_PERIPH_CPUID
    select HAS_PERIPH_GPIO
    select HAS_PERIPH_GPIO_IRQ

## CPU Models
config CPU_MODEL_EZR32WG330F256R60
    bool
    select CPU_FAM_EZR32WG

## Definition of specific features
config HAS_CPU_EZR32WG
    bool
    help
        Indicates that an 'ezr32wg' cpu is being used.

## Common CPU symbols
config CPU_FAM
    default "ezr32wg" if CPU_FAM_EZR32WG

config CPU_MODEL
    default "ezr32wg330f256r60" if CPU_MODEL_EZR32WG330F256R60

config CPU
    default "ezr32wg" if CPU_FAM_EZR32WG

source "$(RIOTCPU)/cortexm_common/Kconfig"
```

## cpu/fe310/Kconfig
```kconfig
# SPDX-FileCopyrightText: 2020 Inria
# SPDX-License-Identifier: LGPL-2.1-only

config CPU_FAM_FE310
    bool
    select CPU_CORE_RV32IMAC

config CPU_MODEL_FE310_G000
    bool
    select CPU_FAM_FE310

config CPU_MODEL_FE310_G002
    bool
    select CPU_FAM_FE310

config CPU_FAM
    default "fe310" if CPU_FAM_FE310

config CPU_MODEL
    default "fe310_g000"  if CPU_MODEL_FE310_G000
    default "fe310_g002"  if CPU_MODEL_FE310_G002

config CPU
    default "fe310" if CPU_FAM_FE310

config CPU_CORE
    default "rv32imac" if CPU_CORE_RV32IMAC

rsource "Kconfig.clk"

source "$(RIOTCPU)/riscv_common/Kconfig"
```

## cpu/fe310/Kconfig.clk
```kconfig
# Copyright (c) 2020 Inria
#
# This file is subject to the terms and conditions of the GNU Lesser
# General Public License v2.1. See the file LICENSE in the top level
# directory for more details.
#

menu "FE310 clock configuration"
    depends on CPU_FAM_FE310

choice
bool "Clock source selection"
default USE_CLOCK_HFXOSC_PLL

config USE_CLOCK_HFXOSC_PLL
    bool "PLL clocked by high frequency external oscillator (HFXOSC)"

config USE_CLOCK_HFXOSC
    bool "Direct High frequency external oscillator (HFXOSC)"

config USE_CLOCK_HFROSC_PLL
    bool "PLL clocked by High frequency internal oscillator (HFROSC)"

config USE_CLOCK_HFROSC
    bool "Direct High frequency internal oscillator (HFROSC)"
endchoice

# the configuration macros must always be defined for clock.c to compile
config CLOCK_PLL_F
    int "F: REFR multiply factor" if USE_CLOCK_HFXOSC_PLL
    default 39

config CLOCK_PLL_Q
    int "Q: VCO divide factor" if USE_CLOCK_HFXOSC_PLL
    default 1

config CLOCK_DESIRED_FREQUENCY
    int
    prompt "Desired clock frequency" if USE_CLOCK_HFROSC_PLL
    default 320000000
    range 1000000 320000000

config CLOCK_HFROSC_TRIM
    int "TRIM: input frequency multiplier" if USE_CLOCK_HFROSC
    default 6
    range 0 31

config CLOCK_HFROSC_DIV
    int "DIV: output frequency divider" if USE_CLOCK_HFROSC
    default 1
    range 0 63

endmenu
```

## cpu/fe310/vendor/Kconfig
```kconfig
# Copyright (c) 2021 HAW Hamburg
#
# This file is subject to the terms and conditions of the GNU Lesser
# General Public License v2.1. See the file LICENSE in the top level
# directory for more details.
#

config MODULE_SIFIVE_DRIVERS_FE310
    bool
    default y
    depends on CPU_FAM_FE310
    help
        sifive drivers for fe310.
```
