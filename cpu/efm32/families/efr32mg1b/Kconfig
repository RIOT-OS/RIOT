## cpu/efm32/families/efr32mg1b/Kconfig
```kconfig
# SPDX-FileCopyrightText: 2020 HAW Hamburg
# SPDX-License-Identifier: LGPL-2.1-only

config CPU_FAM_EFR32MG1B
    bool
    select CPU_CORE_CORTEX_M4F
    select CPU_COMMON_EFM32
    select CPU_EFM32_SERIES1

## CPU Models
config CPU_MODEL_EFR32MG1B232F256GM48
    bool
    select CPU_FAM_EFR32MG1B

config CPU_MODEL_EFR32MG1B732F256IM32
    bool
    select CPU_FAM_EFR32MG1B

config CPU_MODEL_EFR32MG1B231F256GM32
    bool
    select CPU_FAM_EFR32MG1B

config CPU_MODEL_EFR32MG1B131F256GM32
    bool
    select CPU_FAM_EFR32MG1B

config CPU_MODEL_EFR32MG1B132F256GM48
    bool
    select CPU_FAM_EFR32MG1B

config CPU_MODEL_EFR32MG1B632F256GM32
    bool
    select CPU_FAM_EFR32MG1B

config CPU_MODEL_EFR32MG1B132F256GM32
    bool
    select CPU_FAM_EFR32MG1B

config CPU_MODEL_EFR32MG1B132F256GJ43
    bool
    select CPU_FAM_EFR32MG1B

config CPU_MODEL_EFR32MG1B632F256IM32
    bool
    select CPU_FAM_EFR32MG1B

config CPU_MODEL_EFR32MG1B131F256GM48
    bool
    select CPU_FAM_EFR32MG1B

config CPU_MODEL_EFR32MG1B732F256GM32
    bool
    select CPU_FAM_EFR32MG1B

config CPU_MODEL_EFR32MG1B231F256GM48
    bool
    select CPU_FAM_EFR32MG1B

config CPU_MODEL_EFR32MG1B232F256IM48
    bool
    select CPU_FAM_EFR32MG1B

config CPU_MODEL_EFR32MG1B232F256GJ43
    bool
    select CPU_FAM_EFR32MG1B

config CPU_MODEL_EFR32MG1B232F256GM32
    bool
    select CPU_FAM_EFR32MG1B

## Common CPU symbols
config CPU_FAM
    default "efr32mg1b" if CPU_FAM_EFR32MG1B

config CPU_MODEL
    default "efr32mg1b232f256gm48" if CPU_MODEL_EFR32MG1B232F256GM48
    default "efr32mg1b732f256im32" if CPU_MODEL_EFR32MG1B732F256IM32
    default "efr32mg1b231f256gm32" if CPU_MODEL_EFR32MG1B231F256GM32
    default "efr32mg1b131f256gm32" if CPU_MODEL_EFR32MG1B131F256GM32
    default "efr32mg1b132f256gm48" if CPU_MODEL_EFR32MG1B132F256GM48
    default "efr32mg1b632f256gm32" if CPU_MODEL_EFR32MG1B632F256GM32
    default "efr32mg1b132f256gm32" if CPU_MODEL_EFR32MG1B132F256GM32
    default "efr32mg1b132f256gj43" if CPU_MODEL_EFR32MG1B132F256GJ43
    default "efr32mg1b632f256im32" if CPU_MODEL_EFR32MG1B632F256IM32
    default "efr32mg1b131f256gm48" if CPU_MODEL_EFR32MG1B131F256GM48
    default "efr32mg1b732f256gm32" if CPU_MODEL_EFR32MG1B732F256GM32
    default "efr32mg1b231f256gm48" if CPU_MODEL_EFR32MG1B231F256GM48
    default "efr32mg1b232f256im48" if CPU_MODEL_EFR32MG1B232F256IM48
    default "efr32mg1b232f256gj43" if CPU_MODEL_EFR32MG1B232F256GJ43
    default "efr32mg1b232f256gm32" if CPU_MODEL_EFR32MG1B232F256GM32
```

## cpu/efm32/families/efr32mg1p/Kconfig
```kconfig
# SPDX-FileCopyrightText: 2020 HAW Hamburg
# SPDX-License-Identifier: LGPL-2.1-only

config CPU_FAM_EFR32MG1P
    bool
    select CPU_CORE_CORTEX_M4F
    select CPU_COMMON_EFM32
    select CPU_EFM32_SERIES1

## CPU Models
config CPU_MODEL_EFR32MG1P632F256GM32
    bool
    select CPU_FAM_EFR32MG1P

config CPU_MODEL_EFR32MG1P132F256GM48
    bool
    select CPU_FAM_EFR32MG1P

config CPU_MODEL_EFR32MG1P233F256GM48
    bool
    select CPU_FAM_EFR32MG1P

config CPU_MODEL_EFR32MG1P132F256IM32
    bool
    select CPU_FAM_EFR32MG1P

config CPU_MODEL_EFR32MG1P232F256IM32
    bool
    select CPU_FAM_EFR32MG1P

config CPU_MODEL_EFR32MG1P133F256GM48
    bool
    select CPU_FAM_EFR32MG1P

config CPU_MODEL_EFR32MG1P232F256GM48
    bool
    select CPU_FAM_EFR32MG1P

config CPU_MODEL_EFR32MG1P732F256IM32
    bool
    select CPU_FAM_EFR32MG1P

config CPU_MODEL_EFR32MG1P232F256GJ43
    bool
    select CPU_FAM_EFR32MG1P

config CPU_MODEL_EFR32MG1P232F256GM32
    bool
    select CPU_FAM_EFR32MG1P

config CPU_MODEL_EFR32MG1P231F256GM48
    bool
    select CPU_FAM_EFR32MG1P

config CPU_MODEL_EFR32MG1P732F256GM32
    bool
    select CPU_FAM_EFR32MG1P

config CPU_MODEL_EFR32MG1P232F256IM48
    bool
    select CPU_FAM_EFR32MG1P

config CPU_MODEL_EFR32MG1P132F256IM48
    bool
    select CPU_FAM_EFR32MG1P

config CPU_MODEL_EFR32MG1P632F256IM32
    bool
    select CPU_FAM_EFR32MG1P

config CPU_MODEL_EFR32MG1P131F256GM48
    bool
    select CPU_FAM_EFR32MG1P

config CPU_MODEL_EFR32MG1P132F256GM32
    bool
    select CPU_FAM_EFR32MG1P

config CPU_MODEL_EFR32MG1P233F256IM48
    bool
    select CPU_FAM_EFR32MG1P

config CPU_MODEL_EFR32MG1P132F256GJ43
    bool
    select CPU_FAM_EFR32MG1P

## Common CPU symbols
config CPU_FAM
    default "efr32mg1p" if CPU_FAM_EFR32MG1P

config CPU_MODEL
    default "efr32mg1p632f256gm32" if CPU_MODEL_EFR32MG1P632F256GM32
    default "efr32mg1p132f256gm48" if CPU_MODEL_EFR32MG1P132F256GM48
    default "efr32mg1p233f256gm48" if CPU_MODEL_EFR32MG1P233F256GM48
    default "efr32mg1p132f256im32" if CPU_MODEL_EFR32MG1P132F256IM32
    default "efr32mg1p232f256im32" if CPU_MODEL_EFR32MG1P232F256IM32
    default "efr32mg1p133f256gm48" if CPU_MODEL_EFR32MG1P133F256GM48
    default "efr32mg1p232f256gm48" if CPU_MODEL_EFR32MG1P232F256GM48
    default "efr32mg1p732f256im32" if CPU_MODEL_EFR32MG1P732F256IM32
    default "efr32mg1p232f256gj43" if CPU_MODEL_EFR32MG1P232F256GJ43
    default "efr32mg1p232f256gm32" if CPU_MODEL_EFR32MG1P232F256GM32
    default "efr32mg1p231f256gm48" if CPU_MODEL_EFR32MG1P231F256GM48
    default "efr32mg1p732f256gm32" if CPU_MODEL_EFR32MG1P732F256GM32
    default "efr32mg1p232f256im48" if CPU_MODEL_EFR32MG1P232F256IM48
    default "efr32mg1p132f256im48" if CPU_MODEL_EFR32MG1P132F256IM48
    default "efr32mg1p632f256im32" if CPU_MODEL_EFR32MG1P632F256IM32
    default "efr32mg1p131f256gm48" if CPU_MODEL_EFR32MG1P131F256GM48
    default "efr32mg1p132f256gm32" if CPU_MODEL_EFR32MG1P132F256GM32
    default "efr32mg1p233f256im48" if CPU_MODEL_EFR32MG1P233F256IM48
    default "efr32mg1p132f256gj43" if CPU_MODEL_EFR32MG1P132F256GJ43
```

## cpu/efm32/families/efr32zg23/Kconfig
```kconfig
# Copyright (c) 2020 HAW Hamburg
#
# This file is subject to the terms and conditions of the GNU Lesser
# General Public License v2.1. See the file LICENSE in the top level
# directory for more details.

config CPU_FAM_EFR32ZG23
    bool
    select CPU_CORE_CORTEX_M33
    select CPU_COMMON_EFM32
    select CPU_EFM32_SERIES2

## CPU Models
config CPU_MODEL_EFR32ZG23B020F512IM40
    bool
    select CPU_FAM_EFR32ZG23

config CPU_MODEL_EFR32ZG23B020F512IM48
    bool
    select CPU_FAM_EFR32ZG23

config CPU_MODEL_EFR32ZG23A010F512GM48
    bool
    select CPU_FAM_EFR32ZG23

config CPU_MODEL_EFR32ZG23A010F512GM40
    bool
    select CPU_FAM_EFR32ZG23

config CPU_MODEL_EFR32ZG23A020F512GM48
    bool
    select CPU_FAM_EFR32ZG23

config CPU_MODEL_EFR32ZG23B010F512IM40
    bool
    select CPU_FAM_EFR32ZG23

config CPU_MODEL_EFR32ZG23A020F512GM40
    bool
    select CPU_FAM_EFR32ZG23

config CPU_MODEL_EFR32ZG23B011F512IM40
    bool
    select CPU_FAM_EFR32ZG23

config CPU_MODEL_EFR32ZG23B010F512IM48
    bool
    select CPU_FAM_EFR32ZG23

config CPU_MODEL_EFR32ZG23B021F512IM40
    bool
    select CPU_FAM_EFR32ZG23

## Common CPU symbols
config CPU_FAM
    default "efr32zg23" if CPU_FAM_EFR32ZG23

config CPU_MODEL
    default "efr32zg23b020f512im40" if CPU_MODEL_EFR32ZG23B020F512IM40
    default "efr32zg23b020f512im48" if CPU_MODEL_EFR32ZG23B020F512IM48
    default "efr32zg23a010f512gm48" if CPU_MODEL_EFR32ZG23A010F512GM48
    default "efr32zg23a010f512gm40" if CPU_MODEL_EFR32ZG23A010F512GM40
    default "efr32zg23a020f512gm48" if CPU_MODEL_EFR32ZG23A020F512GM48
    default "efr32zg23b010f512im40" if CPU_MODEL_EFR32ZG23B010F512IM40
    default "efr32zg23a020f512gm40" if CPU_MODEL_EFR32ZG23A020F512GM40
    default "efr32zg23b011f512im40" if CPU_MODEL_EFR32ZG23B011F512IM40
    default "efr32zg23b010f512im48" if CPU_MODEL_EFR32ZG23B010F512IM48
    default "efr32zg23b021f512im40" if CPU_MODEL_EFR32ZG23B021F512IM40
```

## cpu/efm32/families/ezr32wg/Kconfig
```kconfig
# Copyright (c) 2020 HAW Hamburg
#
# This file is subject to the terms and conditions of the GNU Lesser
# General Public License v2.1. See the file LICENSE in the top level
# directory for more details.

config CPU_FAM_EZR32WG
    bool
    select CPU_CORE_CORTEX_M4F
    select CPU_COMMON_EFM32
    select CPU_EFM32_SERIES0
    select HAS_CORTEXM_MPU

## CPU Models
config CPU_MODEL_EZR32WG230F128R68
    bool
    select CPU_FAM_EZR32WG

config CPU_MODEL_EZR32WG230F256R68
    bool
    select CPU_FAM_EZR32WG

config CPU_MODEL_EZR32WG330F128R55
    bool
    select CPU_FAM_EZR32WG

config CPU_MODEL_EZR32WG330F256R55
    bool
    select CPU_FAM_EZR32WG

config CPU_MODEL_EZR32WG330F64R61
    bool
    select CPU_FAM_EZR32WG

config CPU_MODEL_EZR32WG330F256R60
    bool
    select CPU_FAM_EZR32WG

config CPU_MODEL_EZR32WG230F64R68
    bool
    select CPU_FAM_EZR32WG

config CPU_MODEL_EZR32WG330F128R60
    bool
    select CPU_FAM_EZR32WG

config CPU_MODEL_EZR32WG230F128R61
    bool
    select CPU_FAM_EZR32WG

config CPU_MODEL_EZR32WG230F256R61
    bool
    select CPU_FAM_EZR32WG

config CPU_MODEL_EZR32WG330F256R69
    bool
    select CPU_FAM_EZR32WG

config CPU_MODEL_EZR32WG230F64R61
    bool
    select CPU_FAM_EZR32WG

config CPU_MODEL_EZR32WG330F128R69
    bool
    select CPU_FAM_EZR32WG

config CPU_MODEL_EZR32WG330F256R63
    bool
    select CPU_FAM_EZR32WG

config CPU_MODEL_EZR32WG330F128R63
    bool
    select CPU_FAM_EZR32WG

config CPU_MODEL_EZR32WG330F64R68
    bool
    select CPU_FAM_EZR32WG

config CPU_MODEL_EZR32WG330F256R67
    bool
    select CPU_FAM_EZR32WG

config CPU_MODEL_EZR32WG330F128R67
    bool
    select CPU_FAM_EZR32WG

config CPU_MODEL_EZR32WG230F256R60
    bool
    select CPU_FAM_EZR32WG

config CPU_MODEL_EZR32WG230F128R60
    bool
    select CPU_FAM_EZR32WG

config CPU_MODEL_EZR32WG230F64R55
    bool
    select CPU_FAM_EZR32WG

config CPU_MODEL_EZR32WG330F128R68
    bool
    select CPU_FAM_EZR32WG

config CPU_MODEL_EZR32WG230F64R60
    bool
    select CPU_FAM_EZR32WG

config CPU_MODEL_EZR32WG330F256R68
    bool
    select CPU_FAM_EZR32WG

config CPU_MODEL_EZR32WG330F64R63
    bool
    select CPU_FAM_EZR32WG

config CPU_MODEL_EZR32WG330F64R69
    bool
    select CPU_FAM_EZR32WG

config CPU_MODEL_EZR32WG230F128R55
    bool
    select CPU_FAM_EZR32WG

config CPU_MODEL_EZR32WG230F256R55
    bool
    select CPU_FAM_EZR32WG

config CPU_MODEL_EZR32WG330F64R67
    bool
    select CPU_FAM_EZR32WG

config CPU_MODEL_EZR32WG230F256R63
    bool
    select CPU_FAM_EZR32WG

config CPU_MODEL_EZR32WG230F128R63
    bool
    select CPU_FAM_EZR32WG

config CPU_MODEL_EZR32WG230F256R69
    bool
    select CPU_FAM_EZR32WG

config CPU_MODEL_EZR32WG230F128R69
    bool
    select CPU_FAM_EZR32WG

config CPU_MODEL_EZR32WG330F64R55
    bool
    select CPU_FAM_EZR32WG

config CPU_MODEL_EZR32WG230F256R67
    bool
    select CPU_FAM_EZR32WG

config CPU_MODEL_EZR32WG230F128R67
    bool
    select CPU_FAM_EZR32WG

config CPU_MODEL_EZR32WG330F64R60
    bool
    select CPU_FAM_EZR32WG

config CPU_MODEL_EZR32WG330F128R61
    bool
    select CPU_FAM_EZR32WG

config CPU_MODEL_EZR32WG230F64R69
    bool
    select CPU_FAM_EZR32WG

config CPU_MODEL_EZR32WG330F256R61
    bool
    select CPU_FAM_EZR32WG

config CPU_MODEL_EZR32WG230F64R63
    bool
    select CPU_FAM_EZR32WG

config CPU_MODEL_EZR32WG230F64R67
    bool
    select CPU_FAM_EZR32WG

## Common CPU symbols
config CPU_FAM
    default "ezr32wg" if CPU_FAM_EZR32WG

config CPU_MODEL
    default "ezr32wg230f128r68" if CPU_MODEL_EZR32WG230F128R68
    default "ezr32wg230f256r68" if CPU_MODEL_EZR32WG230F256R68
    default "ezr32wg330f128r55" if CPU_MODEL_EZR32WG330F128R55
    default "ezr32wg330f256r55" if CPU_MODEL_EZR32WG330F256R55
    default "ezr32wg330f64r61"  if CPU_MODEL_EZR32WG330F64R61
    default "ezr32wg330f256r60" if CPU_MODEL_EZR32WG330F256R60
    default "ezr32wg230f64r68"  if CPU_MODEL_EZR32WG230F64R68
    default "ezr32wg330f128r60" if CPU_MODEL_EZR32WG330F128R60
    default "ezr32wg230f128r61" if CPU_MODEL_EZR32WG230F128R61
    default "ezr32wg230f256r61" if CPU_MODEL_EZR32WG230F256R61
    default "ezr32wg330f256r69" if CPU_MODEL_EZR32WG330F256R69
    default "ezr32wg230f64r61"  if CPU_MODEL_EZR32WG230F64R61
    default "ezr32wg330f128r69" if CPU_MODEL_EZR32WG330F128R69
    default "ezr32wg330f256r63" if CPU_MODEL_EZR32WG330F256R63
    default "ezr32wg330f128r63" if CPU_MODEL_EZR32WG330F128R63
    default "ezr32wg330f64r68"  if CPU_MODEL_EZR32WG330F64R68
    default "ezr32wg330f256r67" if CPU_MODEL_EZR32WG330F256R67
    default "ezr32wg330f128r67" if CPU_MODEL_EZR32WG330F128R67
    default "ezr32wg230f256r60" if CPU_MODEL_EZR32WG230F256R60
    default "ezr32wg230f128r60" if CPU_MODEL_EZR32WG230F128R60
    default "ezr32wg230f64r55"  if CPU_MODEL_EZR32WG230F64R55
    default "ezr32wg330f128r68" if CPU_MODEL_EZR32WG330F128R68
    default "ezr32wg230f64r60"  if CPU_MODEL_EZR32WG230F64R60
    default "ezr32wg330f256r68" if CPU_MODEL_EZR32WG330F256R68
    default "ezr32wg330f64r63"  if CPU_MODEL_EZR32WG330F64R63
    default "ezr32wg330f64r69"  if CPU_MODEL_EZR32WG330F64R69
    default "ezr32wg230f128r55" if CPU_MODEL_EZR32WG230F128R55
    default "ezr32wg230f256r55" if CPU_MODEL_EZR32WG230F256R55
    default "ezr32wg330f64r67"  if CPU_MODEL_EZR32WG330F64R67
    default "ezr32wg230f256r63" if CPU_MODEL_EZR32WG230F256R63
    default "ezr32wg230f128r63" if CPU_MODEL_EZR32WG230F128R63
    default "ezr32wg230f256r69" if CPU_MODEL_EZR32WG230F256R69
    default "ezr32wg230f128r69" if CPU_MODEL_EZR32WG230F128R69
    default "ezr32wg330f64r55"  if CPU_MODEL_EZR32WG330F64R55
    default "ezr32wg230f256r67" if CPU_MODEL_EZR32WG230F256R67
    default "ezr32wg230f128r67" if CPU_MODEL_EZR32WG230F128R67
    default "ezr32wg330f64r60"  if CPU_MODEL_EZR32WG330F64R60
    default "ezr32wg330f128r61" if CPU_MODEL_EZR32WG330F128R61
    default "ezr32wg230f64r69"  if CPU_MODEL_EZR32WG230F64R69
    default "ezr32wg330f256r61" if CPU_MODEL_EZR32WG330F256R61
    default "ezr32wg230f64r63"  if CPU_MODEL_EZR32WG230F64R63
    default "ezr32wg230f64r67"  if CPU_MODEL_EZR32WG230F64R67
```

## cpu/efm32/periph/Kconfig
```kconfig
# Copyright (c) 2021 HAW Hamburg
#
# This file is subject to the terms and conditions of the GNU Lesser
# General Public License v2.1. See the file LICENSE in the top level
# directory for more details.
#

config MODULE_PERIPH
    bool
    default y

if MODULE_PERIPH

config MODULE_PERIPH_WDT_SERIES0
    bool
    depends on CPU_EFM32_SERIES0
    default MODULE_PERIPH_WDT
    help
        WDT driver implementation for EFM32 series 0.

config MODULE_PERIPH_WDT_SERIES1
    bool
    depends on CPU_EFM32_SERIES1
    default MODULE_PERIPH_WDT
        help
        WDT driver implementation for EFM32 series 1.

config MODULE_PERIPH_RTC_SERIES0
    bool
    depends on CPU_EFM32_SERIES0
    default MODULE_PERIPH_RTC
    help
        RTC driver implementation for EFM32 series 0.

config MODULE_PERIPH_RTC_SERIES1
    bool
    depends on CPU_EFM32_SERIES1
    default MODULE_PERIPH_RTC
        help
        RTC driver implementation for EFM32 series 1.

config MODULE_PERIPH_RTT_SERIES0
    bool
    depends on CPU_EFM32_SERIES0
    default MODULE_PERIPH_RTT
    help
        RTT driver implementation for EFM32 series 0.

config MODULE_PERIPH_RTT_SERIES1
    bool
    depends on CPU_EFM32_SERIES1
    default MODULE_PERIPH_RTT
        help
        RTT driver implementation for EFM32 series 1.

endif # MODULE_PERIPH
```
