## cpu/esp32/esp-ble-nimble/Kconfig
```kconfig
# Copyright (c) 2022 HAW Hamburg
#
# This file is subject to the terms and conditions of the GNU Lesser
# General Public License v2.1. See the file LICENSE in the top level
# directory for more details.
#

config MODULE_ESP_BLE_NIMBLE
    bool "ESP32 Bluetooth LE HCI for NimBLE host"
    depends on TEST_KCONFIG
    depends on CPU_FAM_ESP32
    depends on HAS_ESP_BLE
    default y if TEST_KCONFIG && MODULE_NIMBLE
    select MODULE_ESP_BLE
    select MODULE_NIMBLE_HOST
    select MODULE_NIMBLE_TRANSPORT_HCI_H4
    select MODULE_ZTIMER_MSEC

config HAS_ESP_BLE
    bool
    help
        Indicates that a ESP32 Buetooth LE controller.
```

## cpu/esp32/esp-eth/Kconfig
```kconfig
# Copyright (c) 2022 HAW Hamburg
#
# This file is subject to the terms and conditions of the GNU Lesser
# General Public License v2.1. See the file LICENSE in the top level
# directory for more details.
#

config MODULE_ESP_ETH
    bool "ESP32 Ethernet device"
    depends on TEST_KCONFIG
    depends on CPU_FAM_ESP32
    depends on HAS_ESP_ETH
    select MODULE_ESP_IDF_ETH
    select MODULE_ESP_IDF_EVENT
    select MODULE_ESP_IDF_SPI_FLASH
    select MODULE_NETDEV_ETH
    select MODULE_NETOPT
    select MODULE_ZTIMER
    select MODULE_ZTIMER_MSEC

config HAS_ESP_ETH
    bool
    select MODULE_ESP_ETH if MODULE_NETDEV_DEFAULT
    help
        Indicates that a ESP32 ethernet device is present.
```

## cpu/esp32/esp-idf/Kconfig
```kconfig
# Copyright (c) 2021 HAW Hamburg
#               2022 Gunar Schorcht
#
# This file is subject to the terms and conditions of the GNU Lesser
# General Public License v2.1. See the file LICENSE in the top level
# directory for more details.
#

config MODULE_ESP_IDF
    bool
    depends on TEST_KCONFIG
    depends on HAS_ARCH_ESP32
    default y
    select MODULE_ESP_IDF_COMMON
    select MODULE_ESP_IDF_EFUSE
    select MODULE_ESP_IDF_SPI_FLASH if MODULE_MTD || MODULE_PERIPH_FLASHPAGE
    select MODULE_ESP_IDF_USB if MODULE_TINYUSB_PORTABLE_ESPRESSIF
    help
      Espressif IoT Development Framework.

rsource "adc/Kconfig"
rsource "ble/Kconfig"
rsource "common/Kconfig"
rsource "efuse/Kconfig"
rsource "eth/Kconfig"
rsource "event/Kconfig"
rsource "gpio/Kconfig"
rsource "heap/Kconfig"
rsource "nvs_flash/Kconfig"
rsource "rmt/Kconfig"
rsource "spi_flash/Kconfig"
rsource "spi_ram/Kconfig"
rsource "usb/Kconfig"
rsource "wifi/Kconfig"
rsource "wpa_supplicant/Kconfig"
```

## cpu/esp32/esp-idf/efuse/Kconfig
```kconfig
# Copyright (c) 2022 Gunar Schorcht
#
# This file is subject to the terms and conditions of the GNU Lesser
# General Public License v2.1. See the file LICENSE in the top level
# directory for more details.
#

config MODULE_ESP_IDF_EFUSE
    bool
    depends on TEST_KCONFIG
    depends on MODULE_ESP_IDF
    help
        ESP-IDF code for accessing eFuse bits of ESP32 SoCs, as required for
        accessing the MAC addresses of network devices or accessing the
        external SPI RAM.
```

## cpu/esp32/esp-idf/event/Kconfig
```kconfig
# Copyright (c) 2022 Gunar Schorcht
#
# This file is subject to the terms and conditions of the GNU Lesser
# General Public License v2.1. See the file LICENSE in the top level
# directory for more details.
#

config MODULE_ESP_IDF_EVENT
    bool
    depends on TEST_KCONFIG
    depends on MODULE_ESP_IDF
    help
        ESP-IDF code for event handling as required for network devices.
```

## cpu/esp32/esp-idf/gpio/Kconfig
```kconfig
# Copyright (c) 2022 Gunar Schorcht
#
# This file is subject to the terms and conditions of the GNU Lesser
# General Public License v2.1. See the file LICENSE in the top level
# directory for more details.
#

config MODULE_ESP_IDF_GPIO
    bool
    depends on TEST_KCONFIG
    depends on MODULE_ESP_IDF

    default y if MODULE_PERIPH_GPIO

    help
        ESP-IDF code for peripheral GPIO.

config MODULE_ESP_IDF_GPIO_HAL
    bool "Use ESP-IDF GPIO Hardware Abstraction Layer"
    depends on TEST_KCONFIG
```

## cpu/esp32/esp-idf/lcd/Kconfig
```kconfig
# Copyright (c) 2022 Gunar Schorcht
#
# This file is subject to the terms and conditions of the GNU Lesser
# General Public License v2.1. See the file LICENSE in the top level
# directory for more details.
#

config MODULE_ESP_IDF_LCD
    bool
    depends on TEST_KCONFIG
    depends on MODULE_ESP_IDF

    default y if MODULE_LCD_PARALLEL_LL_MCU

    help
        ESP-IDF code for peripheral GPIO.
```

## cpu/esp32/esp-idf/rmt/Kconfig
```kconfig
# Copyright (c) 2022 Gunar Schorcht
#
# This file is subject to the terms and conditions of the GNU Lesser
# General Public License v2.1. See the file LICENSE in the top level
# directory for more details.
#

config MODULE_ESP_IDF_RMT
    bool
    depends on TEST_KCONFIG
    depends on MODULE_ESP_IDF && HAS_ESP_RMT

    default y if MODULE_WS281X_ESP32 && MODULE_WS281X_ESP32_HW

    help
        ESP-IDF code for peripheral GPIO.
```

## cpu/esp32/esp-idf/sdmmc/Kconfig
```kconfig
# Copyright (c) 2021 HAW Hamburg
#               2022 Gunar Schorcht
#
# This file is subject to the terms and conditions of the GNU Lesser
# General Public License v2.1. See the file LICENSE in the top level
# directory for more details.
#

config MODULE_ESP_IDF_SDMMC
    bool
    depends on TEST_KCONFIG
    depends on MODULE_ESP_IDF
    default y if MODULE_PERIPH_SDMMC
    select PACKAGE_TLSF
    help
        ESP-IDF heap library. This library is required if external SPI RAM
        or the WiFi interface is used.
```
