## cpu/esp32/Kconfig.esp32s2
```kconfig
# SPDX-FileCopyrightText: 2020 HAW Hamburg
# SPDX-FileCopyrightText: 2022 Gunar Schorcht
# SPDX-License-Identifier: LGPL-2.1-only

config CPU_FAM_ESP32S2
    bool
    select CPU_COMMON_ESP32X
    select CPU_CORE_XTENSA_LX7

config CPU_FAM
    default "esp32s2" if CPU_FAM_ESP32S2

## CPU Models
config CPU_MODEL_ESP32S2
    bool
    select CPU_FAM_ESP32S2
    help
        Indicates that CPU version ESP32-S2 is used.

config CPU_MODEL_ESP32S2_FH2
    bool
    select CPU_FAM_ESP32S2
    help
        Indicates that CPU version ESP32-S2FH2 with 2 MB embedded Flash is used.

config CPU_MODEL_ESP32S2_FH4
    bool
    select CPU_FAM_ESP32S2
    help
        Indicates that CPU version ESP32-S2FN4R2 with 4 MB embedded Flash is used.

config CPU_MODEL_ESP32S2_FN4R2
    bool
    select CPU_FAM_ESP32S2
    help
        Indicates that CPU version ESP32-S2FN4R2 with 4 MB embedded Flash and
        2 MB embedded SPI RAM is used.

config CPU_MODEL_ESP32S2_R2
    bool
    select CPU_FAM_ESP32S2
    help
        Indicates that CPU version ESP32-S2R2 with 2 MB embedded SPI RAM is used.

config CPU_MODEL_ESP32S2_MINI_1X_H4
    bool
    select CPU_FAM_ESP32S2
    help
        Indicates that ESP32-S2-MINI-1-H4 or ESP32-S2-MINI-1U-H4 module
        with 8 MB Flash is used.

config CPU_MODEL_ESP32S2_MINI_1X_N4
    bool
    select CPU_FAM_ESP32S2
    help
        Indicates that ESP32-S2-MINI-1-N4 or ESP32-S2-MINI-1U-N4 module
        with 8 MB Flash is used.

config CPU_MODEL_ESP32S2_MINI_1X_N4R2
    bool
    select CPU_FAM_ESP32S2
    help
        Indicates that ESP32-S2-MINI-1-N4R2 or ESP32-S2-MINI-1U-N4R2 module
        with 4 MB Flash and 2 MB SPI RAM is used.

config CPU_MODEL_ESP32S2_MINI_2X_H4
    bool
    select CPU_FAM_ESP32S2
    help
        Indicates that ESP32-S2-MINI-2-H4 or ESP32-S2-MINI-2U-H4 module
        with 4 MB Flash is used.

config CPU_MODEL_ESP32S2_MINI_2X_N4
    bool
    select CPU_FAM_ESP32S2
    help
        Indicates that ESP32-S2-MINI-2-N4 or ESP32-S2-MINI-2U-N4 module
        with 4 MB Flash is used.

config CPU_MODEL_ESP32S2_MINI_2X_N4R2
    bool
    select CPU_FAM_ESP32S2
    help
        Indicates that ESP32-S2-MINI-2-N4R2 or ESP32-S2-MINI-2U-N4R2 module
        with 4 MB Flash and 2 MB SPI RAM is used.

config CPU_MODEL_ESP32S2_SOLO_H4
    bool
    select CPU_FAM_ESP32S2
    help
        Indicates that ESP32-S2-SOLO-H4 or ESP32-S2-SOLO-U-H4 module with
        4 MB Flash.

config CPU_MODEL_ESP32S2_SOLO_N4
    bool
    select CPU_FAM_ESP32S2
    help
        Indicates that ESP32-S2-SOLO-N4 or ESP32-S2-SOLO-U-N4 module with
        4 MB Flash.

config CPU_MODEL_ESP32S2_SOLO_N8
    bool
    select CPU_FAM_ESP32S2
    help
        Indicates that ESP32-S2-SOLO-N4 or ESP32-S2-SOLO-U-N4 module with
        4 MB Flash.

config CPU_MODEL_ESP32S2_SOLO_N16
    bool
    select CPU_FAM_ESP32S2
    help
        Indicates that ESP32-S2-SOLO-N4 or ESP32-S2-SOLO-U-N4 module with
        4 MB Flash.

config CPU_MODEL_ESP32S2_SOLO_N4R2
    bool
    select CPU_FAM_ESP32S2
    help
        Indicates that ESP32-S2-SOLO-N4R2 or ESP32-S2-SOLO-U-N4R2 module with
        4 MB Flash and 2 MB SPI RAM is used.

config CPU_MODEL_ESP32S2_SOLO_2X_H4
    bool
    select CPU_FAM_ESP32S2
    help
        Indicates that ESP32-S2-SOLO-2-H4 or ESP32-S2-SOLO-2U-H4 module with
        4 MB Flash.

config CPU_MODEL_ESP32S2_SOLO_2X_N4
    bool
    select CPU_FAM_ESP32S2
    help
        Indicates that ESP32-S2-SOLO-2-N4 or ESP32-S2-SOLO-2U-N4 module with
        4 MB Flash.

config CPU_MODEL_ESP32S2_SOLO_2X_N4R2
    bool
    select CPU_FAM_ESP32S2
    help
        Indicates that ESP32-S2-SOLO-2-N4R2 or ESP32-S2-SOLO-2U-N4R2 module with
        4 MB Flash and 2 MB SPI RAM is used.

config CPU_MODEL_ESP32S2_WROOM
    bool
    select CPU_FAM_ESP32S2
    help
        Indicates that ESP32-S2-WROOM or ESP32-S2-WROOM-I module with
        4 MB Flash is used.

config CPU_MODEL_ESP32S2_WROVER_N4R2
    bool
    select CPU_FAM_ESP32S2
    help
        Indicates that ESP32-S2-WROVER-N4R2 or ESP32-S2-WROVER-I-N4R2 module with
        4 MB Flash and 2 MB SPI RAM is used.

config CPU_MODEL_ESP32S2_WROVER_N8R2
    bool
    select CPU_FAM_ESP32S2
    help
        Indicates that ESP32-S2-WROVER-N8R2 or ESP32-S2-WROVER-I-N8R2 module with
        8 MB Flash and 2 MB SPI RAM is used.

config CPU_MODEL_ESP32S2_WROVER_N16R2
    bool
    select CPU_FAM_ESP32S2
    help
        Indicates that ESP32-S2-WROVER-N16R2 or ESP32-S2-WROVER-I-N16R2 module with
        16 MB Flash and 2 MB SPI RAM is used.

config CPU_MODEL
    depends on CPU_FAM_ESP32S2
    default "esp32s2" if CPU_MODEL_ESP32S2
    default "esp32s2_fh2" if CPU_MODEL_ESP32S2_FH2
    default "esp32s2_fh4" if CPU_MODEL_ESP32S2_FH4
    default "esp32s2_fn4r2" if CPU_MODEL_ESP32S2_FN4R2
    default "esp32s2_r2" if CPU_MODEL_ESP32S2_R2
    default "esp32s2_mini_1x_h4" if CPU_MODEL_ESP32S2_MINI_1X_H4
    default "esp32s2_mini_1x_n4" if CPU_MODEL_ESP32S2_MINI_1X_N4
    default "esp32s2_mini_1x_n4r2" if CPU_MODEL_ESP32S2_MINI_1X_N4R2
    default "esp32s2_mini_2x_h4" if CPU_MODEL_ESP32S2_MINI_2X_H4
    default "esp32s2_mini_2x_n4" if CPU_MODEL_ESP32S2_MINI_2X_N4
    default "esp32s2_mini_2x_n4r2" if CPU_MODEL_ESP32S2_MINI_2X_N4R2
    default "esp32s2_solo_h4" if CPU_MODEL_ESP32S2_SOLO_H4
    default "esp32s2_solo_n4" if CPU_MODEL_ESP32S2_SOLO_N4
    default "esp32s2_solo_n8" if CPU_MODEL_ESP32S2_SOLO_N8
    default "esp32s2_solo_n16" if CPU_MODEL_ESP32S2_SOLO_N16
    default "esp32s2_solo_n4r2" if CPU_MODEL_ESP32S2_SOLO_N4R2
    default "esp32s2_solo_2x_h4" if CPU_MODEL_ESP32S2_SOLO_2X_H4
    default "esp32s2_solo_2x_n4" if CPU_MODEL_ESP32S2_SOLO_2X_N4
    default "esp32s2_solo_2x_n4r2" if CPU_MODEL_ESP32S2_SOLO_2X_N4R2
    default "esp32s2_wroom" if CPU_MODEL_ESP32S2_WROOM
    default "esp32s2_wrover_n4r2" if CPU_MODEL_ESP32S2_WROVER_N4R2
    default "esp32s2_wrover_n8r2" if CPU_MODEL_ESP32S2_WROVER_N8R2
    default "esp32s2_wrover_n16r2" if CPU_MODEL_ESP32S2_WROVER_N16R2

if CPU_FAM_ESP32S2

menu "ESP32-S2 specific configurations"
    depends on HAS_ARCH_ESP32

    # define configuration menu entries for ESP32-S3 variant (family)

    choice
        bool "CPU clock frequency"
        default ESP32S2_DEFAULT_CPU_FREQ_MHZ_80
        help
            CPU clock frequency used (default 80 MHz).
            Please note that peripherals such as I2C or SPI might not work at
            the specified clock frequency if the selected CPU clock frequency
            is too low. These peripherals are clocked by the APB clock, which
            has a clock rate of 80 MHz for CPU clock frequencies greater than
            or equal to 80 MHz, but is equal to the CPU clock frequency for
            CPU clock frequencies less than 80 MHz. Thus, for SPI, the APB
            clock rate must be at least five times the SPI clock rate. For the
            I2C hardware implementation, the APB clock rate must be at least
            40 times the I2C clock rate. For the I2C software implementation,
            the maximum I2C clock rate is 1/200 times the CPU clock rate.

        config ESP32S2_DEFAULT_CPU_FREQ_MHZ_2
            bool "2 MHz"
        config ESP32S2_DEFAULT_CPU_FREQ_MHZ_5
            bool "5 MHz"
        config ESP32S2_DEFAULT_CPU_FREQ_MHZ_10
            bool "10 MHz"
        config ESP32S2_DEFAULT_CPU_FREQ_MHZ_20
            bool "20 MHz"
        config ESP32S2_DEFAULT_CPU_FREQ_MHZ_40
            bool "40 MHz"
        config ESP32S2_DEFAULT_CPU_FREQ_MHZ_80
            bool "80 MHz"
        config ESP32S2_DEFAULT_CPU_FREQ_MHZ_160
            bool "160 MHz"
        config ESP32S2_DEFAULT_CPU_FREQ_MHZ_240
            bool "240 MHz"
    endchoice

    # import configuration menu entries that are common for all ESP32x SoCs
    rsource "Kconfig.common"

endmenu

endif # CPU_FAM_ESP32S2
```

## cpu/esp32/Kconfig.esp32s3
```kconfig
# SPDX-FileCopyrightText: 2020 HAW Hamburg
# SPDX-FileCopyrightText: 2022 Gunar Schorcht
# SPDX-License-Identifier: LGPL-2.1-only

config CPU_FAM_ESP32S3
    bool
    select CPU_COMMON_ESP32X
    select CPU_CORE_XTENSA_LX7

config CPU_FAM
    default "esp32s3" if CPU_FAM_ESP32S3

## CPU Models
config CPU_MODEL_ESP32S3
    bool
    select CPU_FAM_ESP32S3
    help
        Indicates that CPU version ESP32-S3 is used.

config CPU_MODEL_ESP32S3_FN8
    bool
    select CPU_FAM_ESP32S3
    help
        Indicates that CPU version ESP32-S3FN8 with 8 MB embedded Flash is used.

config CPU_MODEL_ESP32S3_R2
    bool
    select CPU_FAM_ESP32S3
    help
        Indicates that CPU version ESP32-S3R2 with 2 MB embedded SPI RAM is used.

config CPU_MODEL_ESP32S3_R8
    bool
    select CPU_FAM_ESP32S3
    help
        Indicates that CPU version ESP32-S3R8 with 8 MB embedded SPI RAM
        and SPI voltage 3.3 V is used.

config CPU_MODEL_ESP32S3_R8V
    bool
    select CPU_FAM_ESP32S3
    help
        Indicates that CPU version ESP32-S3R8V with 8 MB embedded SPI RAM
        and SPI voltage 1.8 V  is used.

config CPU_MODEL_ESP32S3_FH4R2
    bool
    select CPU_FAM_ESP32S3
    help
        Indicates that CPU version ESP32-S3FH4R2 with 4 MB embedded Flash and
        2 MB embedded SPI RAM is used.

config CPU_MODEL_ESP32S3_WROOM_1X_N4
    bool
    select CPU_FAM_ESP32S3
    help
        Indicates that ESP32-S3-WROOM-1-N4 or ESP32-S3-WROOM-1U-N4 module
        with 4 MB Flash is used.

config CPU_MODEL_ESP32S3_WROOM_1X_N8
    bool
    select CPU_FAM_ESP32S3
    help
        Indicates that ESP32-S3-WROOM-1-N8 or ESP32-S3-WROOM-1U-N8 module
        with 8 MB Flash is used.

config CPU_MODEL_ESP32S3_WROOM_1X_N16
    bool
    select CPU_FAM_ESP32S3
    help
        Indicates that ESP32-S3-WROOM-1-N16 or ESP32-S3-WROOM-1U-N16 module
        with 16 MB Flash is used.

config CPU_MODEL_ESP32S3_WROOM_1X_H4
    bool
    select CPU_FAM_ESP32S3
    help
        Indicates that ESP32-S3-WROOM-1-H4 or ESP32-S3-WROOM-1U-H4 module
        with 4 MB Flash is used.

config CPU_MODEL_ESP32S3_WROOM_1X_N4R2
    bool
    select CPU_FAM_ESP32S3
    help
        Indicates that ESP32-S3-WROOM-1-N4R2 or ESP32-S3-WROOM-1U-N4R2 module
        with 4 MB Flash and 2 MB SPI RAM is used.

config CPU_MODEL_ESP32S3_WROOM_1X_N8R2
    bool
    select CPU_FAM_ESP32S3
    help
        Indicates that ESP32-S3-WROOM-1-N8R2 or ESP32-S3-WROOM-1U-N8R2 module
        with 8 MB Flash and 2 MB SPI RAM is used.

config CPU_MODEL_ESP32S3_WROOM_1X_N16R2
    bool
    select CPU_FAM_ESP32S3
    help
        Indicates that ESP32-S3-WROOM-1-N16R2 or ESP32-S3-WROOM-1U-N16R2 module
        with 16 MB Flash and 2 MB SPI RAM is used.

config CPU_MODEL_ESP32S3_WROOM_1X_N4R8
    bool
    select CPU_FAM_ESP32S3
    help
        Indicates that ESP32-S3-WROOM-1-N4R8 or ESP32-S3-WROOM-1U-N4R8 module
        with 4 MB Flash and 8 MB SPI RAM (Octal SPI mode) is used.

config CPU_MODEL_ESP32S3_WROOM_1X_N8R8
    bool
    select CPU_FAM_ESP32S3
    help
        Indicates that ESP32-S3-WROOM-1-N8R8 or ESP32-S3-WROOM-1U-N8R8 module
        with 8 MB Flash and 8 MB SPI RAM (Octal SPI mode) is used.

config CPU_MODEL_ESP32S3_WROOM_1X_N16R8
    bool
    select CPU_FAM_ESP32S3
    help
        Indicates that ESP32-S3-WROOM-1-N16R8 or ESP32-S3-WROOM-1U-N16R8 module
        with 16 MB Flash and 8 MB SPI RAM (Octal SPI mode) is used.

config CPU_MODEL_ESP32S3_WROOM_2_N16R8V
    bool
    select CPU_FAM_ESP32S3
    help
        Indicates that ESP32-S3-WROOM-2-N16R8V module with 16 MB Flash and
        8 MB SPI RAM (Octal SPI mode) and 1.8 V SPI voltage is used.

config CPU_MODEL_ESP32S3_WROOM_2_N32R8V
    bool
    select CPU_FAM_ESP32S3
    help
        Indicates that ESP32-S3-WROOM-2-N16R8V module with 32 MB Flash and
        8 MB SPI RAM (Octal SPI mode) and 1.8 V SPI voltage is used.

config CPU_MODEL_ESP32S3_MINI_1X_N8
    bool
    select CPU_FAM_ESP32S3
    help
        Indicates that ESP32-S3-MINI-1-N8 or ESP32-S3-MINI-1U-N8 module
        with 8 MB Flash is used.

config CPU_MODEL_ESP32S3_MINI_1X_N4R2
    bool
    select CPU_FAM_ESP32S3
    help
        Indicates that ESP32-S3-MINI-1-N4R2 or ESP32-S3-MINI-1U-N4R2 module
        with 4 MB Flash and 2 MB SPI RAM is used.

config CPU_MODEL_ESP32S3_MINI_1X_H4R2
    bool
    select CPU_FAM_ESP32S3
    help
        Indicates that ESP32-S3-MINI-1-H4R2 or ESP32-S3-MINI-1U-H4R2 module
        with 4 MB Flash and 2 MB SPI RAM is used.

config CPU_MODEL
    depends on CPU_FAM_ESP32S3
    default "esp32s3" if CPU_MODEL_ESP32S3
    default "esp32s3_fn8" if CPU_MODEL_ESP32S3_FN8
    default "esp32s3_r2" if CPU_MODEL_ESP32S3_R2
    default "esp32s3_r8" if CPU_MODEL_ESP32S3_R8
    default "esp32s3_r8v" if CPU_MODEL_ESP32S3_R3V
    default "esp32s3_fh4r2" if CPU_MODEL_ESP32S3_FH4R2
    default "esp32s3_wroom_1x_n4" if CPU_MODEL_ESP32S3_WROOM_1X_N4
    default "esp32s3_wroom_1x_n8" if CPU_MODEL_ESP32S3_WROOM_1X_N8
    default "esp32s3_wroom_1x_n16" if CPU_MODEL_ESP32S3_WROOM_1X_N16
    default "esp32s3_wroom_1x_h4" if CPU_MODEL_ESP32S3_WROOM_1X_H4
    default "esp32s3_wroom_1x_n4r2" if CPU_MODEL_ESP32S3_WROOM_1X_N4R2
    default "esp32s3_wroom_1x_n8r2" if CPU_MODEL_ESP32S3_WROOM_1X_N8R2
    default "esp32s3_wroom_1x_n16r2" if CPU_MODEL_ESP32S3_WROOM_1X_N16R2
    default "esp32s3_wroom_1x_n4r8" if CPU_MODEL_ESP32S3_WROOM_1X_N4R8
    default "esp32s3_wroom_1x_n8r8" if CPU_MODEL_ESP32S3_WROOM_1X_N8R8
    default "esp32s3_wroom_1x_n16r8" if CPU_MODEL_ESP32S3_WROOM_1X_N16R8
    default "esp32s3_wroom_2_n16r8v" if CPU_MODEL_ESP32S3_WROOM_2_N16R8V
    default "esp32s3_wroom_2_n32r8v" if CPU_MODEL_ESP32S3_WROOM_2_N32R8V
    default "esp32s3_mini_1x_n8" if CPU_MODEL_ESP32S3_MINI_1X_N8
    default "esp32s3_mini_1x_n4r2" if CPU_MODEL_ESP32S3_MINI_1X_N4R2
    default "esp32s3_mini_1x_h4r2" if CPU_MODEL_ESP32S3_MINI_1X_H4R2

if CPU_FAM_ESP32S3

menu "ESP32-S3 specific configurations"
    depends on HAS_ARCH_ESP32

    # define configuration menu entries for ESP32-S3 variant (family)

    choice
        bool "CPU clock frequency"
        default ESP32S3_DEFAULT_CPU_FREQ_MHZ_80
        help
            CPU clock frequency used (default 80 MHz).
            Please note that peripherals such as I2C or SPI might not work at
            the specified clock frequency if the selected CPU clock frequency
            is too low. These peripherals are clocked by the APB clock, which
            has a clock rate of 80 MHz for CPU clock frequencies greater than
            or equal to 80 MHz, but is equal to the CPU clock frequency for
            CPU clock frequencies less than 80 MHz. Thus, for SPI, the APB
            clock rate must be at least five times the SPI clock rate. For the
            I2C hardware implementation, the APB clock rate must be at least
            40 times the I2C clock rate. For the I2C software implementation,
            the maximum I2C clock rate is 1/200 times the CPU clock rate.

        config ESP32S3_DEFAULT_CPU_FREQ_MHZ_2
            bool "2 MHz"
        config ESP32S3_DEFAULT_CPU_FREQ_MHZ_5
            bool "5 MHz"
        config ESP32S3_DEFAULT_CPU_FREQ_MHZ_10
            bool "10 MHz"
        config ESP32S3_DEFAULT_CPU_FREQ_MHZ_20
            bool "20 MHz"
        config ESP32S3_DEFAULT_CPU_FREQ_MHZ_40
            bool "40 MHz"
        config ESP32S3_DEFAULT_CPU_FREQ_MHZ_80
            bool "80 MHz"
        config ESP32S3_DEFAULT_CPU_FREQ_MHZ_160
            bool "160 MHz"
        config ESP32S3_DEFAULT_CPU_FREQ_MHZ_240
            bool "240 MHz"
    endchoice

    # import configuration menu entries that are common for all ESP32x SoCs
    rsource "Kconfig.common"

endmenu

endif # CPU_FAM_ESP32S3
```

## cpu/esp32/Kconfig.esp32x
```kconfig
# SPDX-FileCopyrightText: 2023 Gunar Schorcht
# SPDX-License-Identifier: LGPL-2.1-only

# define a CPU configurationthat common is common for all ESP32x SoC variants

config CPU_COMMON_ESP32X
    bool
    select CPU_COMMON_ESP

    help
        Selects all features, modules and packages that are common for
        all ESP32x SoC variants.
```
