## cpu/efm32/periph/Kconfig.eth
```kconfig
# SPDX-FileCopyrightText: 2026 Bas Stottelaar <basstottelaar@gmail.com>
# SPDX-License-Identifier: LGPL-2.1-only

config EFM32_ETH_AN_TIMEOUT_MS
    int "Auto-negotiation timeout"
    depends on CPU_COMMON_EFM32 && USEMODULE_EFM32_ETH_AUTO
    default 5000
    help
        Timeout for PHY auto-negotiation completion, in milliseconds.

config EFM32_ETH_LINK_POLL_MS
    int "Link state poll interval"
    depends on CPU_COMMON_EFM32 && USEMODULE_EFM32_ETH_LINK_UP
    default 1000
    help
        Poll interval for checking the link state, in milliseconds.

config EFM32_ETH_PHY_TIMEOUT_US
    int "PHY operations timeout"
    depends on CPU_COMMON_EFM32 && USEMODULE_EFM32_ETH
    default 1000
    help
        Timeout for PHY operations, in microseconds.

config EFM32_ETH_RX_BUF_NUMOF
    int "Receive buffers"
    depends on CPU_COMMON_EFM32 && USEMODULE_EFM32_ETH
    default 4
    help
        Number of receive buffers. The combination of this and the number of
        transmit buffers must fit in memory.

config EFM32_ETH_TX_BUF_NUMOF
    int "Transmit buffers"
    depends on CPU_COMMON_EFM32 && USEMODULE_EFM32_ETH
    default 4
    help
        Number of transmit buffers. The combination of this and the number of
        receive buffers must fit in memory.
```

## cpu/efm32/periph/Kconfig.timer
```kconfig
# Copyright (c) 2020 Inria
#
# This file is subject to the terms and conditions of the GNU Lesser
# General Public License v2.1. See the file LICENSE in the top level
# directory for more details.

config EFM32_XTIMER_USE_LETIMER
    bool "xtimer uses LETIMER (effectively ztimer)"
    depends on CPU_COMMON_EFM32 && USEMODULE_ZTIMER
    default n
    help
        xtimer (effectively ztimer) will use EFM32 Low Energy Timer (LETIMER)
        as its low level timer.

config EFM32_ZTIMER_USE_LETIMER
    bool "ztimer uses LETIMER"
    depends on CPU_COMMON_EFM32 && USEMODULE_ZTIMER
    default n
    help
        ztimer will use EFM32 Low Energy Timer (LETIMER) as its low level
        timer.
```

## cpu/esp32/Kconfig
```kconfig
# Copyright (c) 2020 HAW Hamburg
#               2022 Gunar Schorcht
#
# This file is subject to the terms and conditions of the GNU Lesser
# General Public License v2.1. See the file LICENSE in the top level
# directory for more details.

config CPU
    default "esp32" if HAS_CPU_ESP32

config CPU_CORE_XTENSA_LX6
    bool
    select CPU_ARCH_XTENSA
    help
        CPU core of the ESP32x SoC is a Xtensa LX6.

config CPU_CORE_XTENSA_LX7
    bool
    select CPU_ARCH_XTENSA
    help
        CPU core of the ESP32x SoC is a Xtensa LX7.

config CPU_CORE_RV32IMC
    bool
    select CPU_ARCH_RISCV
    help
        CPU core of the ESP32x SoC is a RISC-V core.

config CPU_CORE
    default "xtensa-lx6" if CPU_CORE_XTENSA_LX6
    default "xtensa-lx7" if CPU_CORE_XTENSA_LX7
    default "rv32imc" if CPU_CORE_RV32IMC

rsource "Kconfig.esp32x"
rsource "Kconfig.esp32"
rsource "Kconfig.esp32c3"
rsource "Kconfig.esp32s3"
rsource "Kconfig.esp32s2"

source "$(RIOTCPU)/esp_common/Kconfig"
```

## cpu/esp32/Kconfig.common
```kconfig
# Copyright (c) 2020 HAW Hamburg
#               2022 Gunar Schorcht
#
# This file is subject to the terms and conditions of the GNU Lesser
# General Public License v2.1. See the file LICENSE in the top level
# directory for more details.

if HAS_ARCH_ESP32

# define configuration menu entries that common for all ESP32x SoC variants

rsource "esp-lcd/Kconfig"
rsource "periph/Kconfig"

endif
```

## cpu/esp32/Kconfig.esp32
```kconfig
# Copyright (c) 2020 HAW Hamburg
#               2022 Gunar Schorcht
#
# This file is subject to the terms and conditions of the GNU Lesser
# General Public License v2.1. See the file LICENSE in the top level
# directory for more details.

config CPU_FAM_ESP32
    bool
    select CPU_COMMON_ESP32X
    select CPU_CORE_XTENSA_LX6

config CPU_FAM
    default "esp32" if CPU_FAM_ESP32

## CPU Models
config CPU_MODEL_ESP32_WROOM_32
    bool
    select CPU_FAM_ESP32

config CPU_MODEL_ESP32_WROVER
    bool
    select CPU_FAM_ESP32

config CPU_MODEL_ESP32_WROVER_B
    bool
    select CPU_FAM_ESP32

config CPU_MODEL_ESP32_WROVER_E
    bool
    select CPU_FAM_ESP32

config CPU_MODEL_ESP32_D0WD
    bool
    select CPU_FAM_ESP32

config CPU_MODEL
    depends on CPU_FAM_ESP32
    default "esp32-wroom_32" if CPU_MODEL_ESP32_WROOM_32
    default "esp32-wrover" if CPU_MODEL_ESP32_WROVER
    default "esp32-wrover" if CPU_MODEL_ESP32_WROVER_B
    default "esp32-wrover" if CPU_MODEL_ESP32_WROVER_E
    default "esp32-d0wd" if CPU_MODEL_ESP32_D0WD
```

## cpu/esp32/Kconfig.esp32c3
```kconfig
# Copyright (c) 2020 HAW Hamburg
#               2022 Gunar Schorcht
#
# This file is subject to the terms and conditions of the GNU Lesser
# General Public License v2.1. See the file LICENSE in the top level
# directory for more details.

config CPU_FAM_ESP32C3
    bool
    select CPU_COMMON_ESP32X
    select CPU_CORE_RV32IMC

config CPU_FAM
    default "esp32c3" if CPU_FAM_ESP32C3

## CPU Models
config CPU_MODEL_ESP32C3_WROOM_02X
    bool
    select CPU_FAM_ESP32C3

config CPU_MODEL_ESP32C3_MINI_1X
    bool
    select CPU_FAM_ESP32C3

config CPU_MODEL_ESP32C3
    bool
    select CPU_FAM_ESP32C3

config CPU_MODEL_ESP32C3_FN4
    bool
    select CPU_FAM_ESP32C3

config CPU_MODEL_ESP32C3_FH4
    bool
    select CPU_FAM_ESP32C3

config CPU_MODEL
    depends on CPU_FAM_ESP32C3
    default "esp32c3_wroom_02x" if CPU_MODEL_ESP32C3_WROOM_02X
    default "esp32c3_mini_1x" if CPU_MODEL_ESP32C3_MINI_1X
    default "esp32c3" if CPU_MODEL_ESP32C3
    default "esp32c3_fn4" if CPU_MODEL_ESP32C3_FN4
    default "esp32c3_fh4" if CPU_MODEL_ESP32C3_FH4
```

## cpu/esp32/Kconfig.esp32c6
```kconfig
# SPDX-FileCopyrightText: 2025 Gunar Schorcht
# SPDX-License-Identifier: LGPL-2.1-only

config CPU_FAM_ESP32C6
    bool
    select CPU_COMMON_ESP32X
    select CPU_CORE_RV32IMAC

config CPU_FAM
    default "esp32c6" if CPU_FAM_ESP32C6

## CPU Models
config CPU_MODEL_ESP32C6
    bool
    select CPU_FAM_ESP32C6
    help
        ESP32-C6 CPU without internal Flash

config CPU_MODEL_ESP32C6_FH4
    bool
    select CPU_FAM_ESP32C6
    help
        ESP32-C6 CPU with 4 MB Flash

config CPU_MODEL_ESP32C6_FH8
    bool
    select CPU_FAM_ESP32C6
    help
        ESP32-C6 CPU with 8 MB Flash

## CPU Modules
config CPU_MODEL_ESP32C6_MINI_1X_X4
    bool
    select CPU_MODEL_ESP32C6
    help
        ESP32-C6-MINI-1-N4, ESP32-C6-MINI-1U-N4, ESP32-C6-MINI-1-H4 or
        ESP32-C6-MINI-1U-H4 module with 4 MB Flash

config CPU_MODEL_ESP32C6_WROOM_1X_X4
    bool
    select CPU_MODEL_ESP32C6
    help
        ESP32-C6-WROOM-1-N4, ESP32-C6-WROOM-1U-N4, ESP32-C6-WROOM-1-H4 or
        ESP32-C6-WROOM-1U-H4 module with 4 MB Flash

config CPU_MODEL_ESP32C6_WROOM_1X_N8
    bool
    select CPU_MODEL_ESP32C6
    help
        ESP32-C6-WROOM-1-N8 or ESP32-C6-WROOM-1U-N8 module with 8 MB Flash

config CPU_MODEL_ESP32C6_WROOM_1X_N16
    bool
    select CPU_MODEL_ESP32C6
    help
        ESP32-C6-WROOM-1-N16 or ESP32-C6-WROOM-1U-N16 module with 16 MB Flash

## Choice
config CPU_MODEL
    depends on CPU_FAM_ESP32C6
    default "esp32c6_mini_1x_x4" if CPU_MODEL_ESP32C6_MINI_1X_X4
    default "esp32c6_wroom_1x_x4" if CPU_MODEL_ESP32C6_WROOM_1X_X4
    default "esp32c6_wroom_1x_n8" if CPU_MODEL_ESP32C6_WROOM_1X_N8
    default "esp32c6_wroom_1x_n16" if CPU_MODEL_ESP32C6_WROOM_1X_N16
    default "esp32c6" if CPU_MODEL_ESP32C6
    default "esp32c6_fh4" if CPU_MODEL_ESP32C6_FH4
    default "esp32c6_fh8" if CPU_MODEL_ESP32C6_FH8

if CPU_FAM_ESP32C6

menu "ESP32-C6 specific configurations"
    depends on HAS_ARCH_ESP32

    # define configuration menu entries for ESP32-C6 variant (family)

    choice
        bool "CPU clock frequency"
        default ESP32C6_DEFAULT_CPU_FREQ_MHZ_80
        help
            CPU clock frequency used (default 80 MHz).
            Please note that peripherals such as I2C or SPI might not work at
            the specified clock frequency if the selected CPU clock frequency
            is too low. These peripherals are clocked by the APB clock, which
            has a clock rate of 40 MHz for CPU clock frequencies greater than
            or equal to 40 MHz, but is equal to the CPU clock frequency for
            CPU clock frequencies less than 40 MHz. Thus, for SPI, the APB
            clock rate must be at least five times the SPI clock rate. For the
            I2C hardware implementation, the APB clock rate must be at least
            3 MHZ to use I2C in fast mode with a I2C clock rate of 400 kHz.
            For the I2C software implementation, the maximum I2C clock rate
            is 1/130 times the CPU clock rate.

        config ESP32C6_DEFAULT_CPU_FREQ_MHZ_20
            bool "20 MHz"
        config ESP32C6_DEFAULT_CPU_FREQ_MHZ_40
            bool "40 MHz"
        config ESP32C6_DEFAULT_CPU_FREQ_MHZ_80
            bool "80 MHz"
        config ESP32C6_DEFAULT_CPU_FREQ_MHZ_120
            bool "120 MHz"
        config ESP32C6_DEFAULT_CPU_FREQ_MHZ_160
            bool "160 MHz"
    endchoice

    # import configuration menu entries that are common for all ESP32x SoCs
    rsource "Kconfig.common"

endmenu

endif # CPU_FAM_ESP32C6
```

## cpu/esp32/Kconfig.esp32h2
```kconfig
# SPDX-FileCopyrightText: 2025 Gunar Schorcht
# SPDX-License-Identifier: LGPL-2.1-only

config CPU_FAM_ESP32H2
    bool
    select CPU_COMMON_ESP32X
    select CPU_CORE_RV32IMAC

config CPU_FAM
    default "esp32h2" if CPU_FAM_ESP32H2

## CPU Models
config CPU_MODEL_ESP32H2_FH2S
    bool
    select CPU_FAM_ESP32H2
    help
        ESP32-H2 CPU with 2 MB Flash

config CPU_MODEL_ESP32H2_FH4S
    bool
    select CPU_FAM_ESP32H2
    help
        ESP32-H2 CPU with 4 MB Flash

## CPU Modules
config CPU_MODEL_ESP32H2_MINI_1X_H2S
    bool
    select CPU_MODEL_ESP32H2_FH2S
    help
        ESP32-H2-MINI-1-H2S or ESP32-H2-MINI-1U-H2S module with 2 MB Flash

config CPU_MODEL_ESP32H2_MINI_1X_H4S
    bool
    select CPU_MODEL_ESP32H2_FH4S
    help
        ESP32-H2-MINI-1-H4S or ESP32-H2-MINI-1U-H4S module with 4 MB Flash

config CPU_MODEL_ESP32H2_WROOM_02C_H2S
    bool
    select CPU_MODEL_ESP32H2_FH2S
    help
        ESP32-H2-WROOM-02C-H2S module with 2 MB Flash

config CPU_MODEL_ESP32H2_WROOM_02C_H4S
    bool
    select CPU_MODEL_ESP32H2_FH4S
    help
        ESP32-H2-WROOM-02C-H4S module with 2 MB Flash

## Choice
config CPU_MODEL
    depends on CPU_FAM_ESP32H2
    default "esp32h2_mini_1x_h2s" if CPU_MODEL_ESP32H2_MINI_1X_H2S
    default "esp32h2_mini_1x_h4s" if CPU_MODEL_ESP32H2_MINI_1X_H4S
    default "esp32h2_wroom_02c_h2s" if CPU_MODEL_ESP32H2_WROOM_02C_H2S
    default "esp32h2_wroom_02c_h4s" if CPU_MODEL_ESP32H2_WROOM_02C_H4S
    default "esp32h2_fh2s" if CPU_MODEL_ESP32H2_FH2S
    default "esp32h2_fh4s" if CPU_MODEL_ESP32H2_FH4S

if CPU_FAM_ESP32H2

menu "ESP32-H2 specific configurations"
    depends on HAS_ARCH_ESP32

    # define configuration menu entries for ESP32-H2 variant (family)

    choice
        bool "CPU clock frequency"
        default ESP32H2_DEFAULT_CPU_FREQ_MHZ_96
        help
            CPU clock frequency used (default 96 MHz).
            Please note that peripherals such as I2C or SPI might not work at
            the specified clock frequency if the selected CPU clock frequency
            is too low. These peripherals are clocked by the APB clock, which
            has a clock rate of 32 MHz for CPU clock frequencies greater than
            or equal to 32 MHz, but is equal to the CPU clock frequency for
            CPU clock frequencies less than 32 MHz. Thus, for SPI, the APB
            clock rate must be at least five times the SPI clock rate. For the
            I2C hardware implementation, the APB clock rate must be at least
            3 MHZ to use I2C in fast mode with a I2C clock rate of 400 kHz.
            For the I2C software implementation, the maximum I2C clock rate
            is 1/130 times the CPU clock rate.

        config ESP32H2_DEFAULT_CPU_FREQ_MHZ_16
            bool "16 MHz"
        config ESP32H2_DEFAULT_CPU_FREQ_MHZ_32
            bool "32 MHz"
        config ESP32H2_DEFAULT_CPU_FREQ_MHZ_48
            bool "48 MHz"
        config ESP32H2_DEFAULT_CPU_FREQ_MHZ_64
            bool "64 MHz"
        config ESP32H2_DEFAULT_CPU_FREQ_MHZ_96
            bool "96 MHz"
    endchoice

    # import configuration menu entries that are common for all ESP32x SoCs
    rsource "Kconfig.common"

endmenu

endif # CPU_FAM_ESP32H2
```
