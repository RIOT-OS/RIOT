## cpu/efm32/families/efm32tg11b/Kconfig
```kconfig
# SPDX-FileCopyrightText: 2020 HAW Hamburg
# SPDX-License-Identifier: LGPL-2.1-only

config CPU_FAM_EFM32TG11B
    bool
    select CPU_CORE_CORTEX_M0PLUS
    select CPU_COMMON_EFM32
    select CPU_EFM32_SERIES1
    select HAS_PERIPH_HWRNG
    select HAS_CORTEXM_MPU

## CPU Models
config CPU_MODEL_EFM32TG11B120F128GQ64
    bool
    select CPU_FAM_EFM32TG11B

config CPU_MODEL_EFM32TG11B120F128IM64
    bool
    select CPU_FAM_EFM32TG11B

config CPU_MODEL_EFM32TG11B540F64GQ48
    bool
    select CPU_FAM_EFM32TG11B

config CPU_MODEL_EFM32TG11B340F64IQ48
    bool
    select CPU_FAM_EFM32TG11B

config CPU_MODEL_EFM32TG11B140F64GM64
    bool
    select CPU_FAM_EFM32TG11B

config CPU_MODEL_EFM32TG11B140F64IQ64
    bool
    select CPU_FAM_EFM32TG11B

config CPU_MODEL_EFM32TG11B540F64GQ80
    bool
    select CPU_FAM_EFM32TG11B

config CPU_MODEL_EFM32TG11B540F64IM80
    bool
    select CPU_FAM_EFM32TG11B

config CPU_MODEL_EFM32TG11B520F128IQ48
    bool
    select CPU_FAM_EFM32TG11B

config CPU_MODEL_EFM32TG11B520F128IQ80
    bool
    select CPU_FAM_EFM32TG11B

config CPU_MODEL_EFM32TG11B320F128IQ64
    bool
    select CPU_FAM_EFM32TG11B

config CPU_MODEL_EFM32TG11B320F128GM64
    bool
    select CPU_FAM_EFM32TG11B

config CPU_MODEL_EFM32TG11B520F128GM80
    bool
    select CPU_FAM_EFM32TG11B

config CPU_MODEL_EFM32TG11B540F64GM32
    bool
    select CPU_FAM_EFM32TG11B

config CPU_MODEL_EFM32TG11B520F128IM32
    bool
    select CPU_FAM_EFM32TG11B

config CPU_MODEL_EFM32TG11B340F64GM64
    bool
    select CPU_FAM_EFM32TG11B

config CPU_MODEL_EFM32TG11B340F64IQ64
    bool
    select CPU_FAM_EFM32TG11B

config CPU_MODEL_EFM32TG11B540F64GQ64
    bool
    select CPU_FAM_EFM32TG11B

config CPU_MODEL_EFM32TG11B540F64IM64
    bool
    select CPU_FAM_EFM32TG11B

config CPU_MODEL_EFM32TG11B120F128GQ48
    bool
    select CPU_FAM_EFM32TG11B

config CPU_MODEL_EFM32TG11B140F64IQ48
    bool
    select CPU_FAM_EFM32TG11B

config CPU_MODEL_EFM32TG11B520F128IQ64
    bool
    select CPU_FAM_EFM32TG11B

config CPU_MODEL_EFM32TG11B520F128GM64
    bool
    select CPU_FAM_EFM32TG11B

config CPU_MODEL_EFM32TG11B320F128IQ48
    bool
    select CPU_FAM_EFM32TG11B

config CPU_MODEL_EFM32TG11B140F64IM32
    bool
    select CPU_FAM_EFM32TG11B

config CPU_MODEL_EFM32TG11B120F128GM32
    bool
    select CPU_FAM_EFM32TG11B

config CPU_MODEL_EFM32TG11B320F128GQ48
    bool
    select CPU_FAM_EFM32TG11B

config CPU_MODEL_EFM32TG11B520F128GQ64
    bool
    select CPU_FAM_EFM32TG11B

config CPU_MODEL_EFM32TG11B520F128IM64
    bool
    select CPU_FAM_EFM32TG11B

config CPU_MODEL_EFM32TG11B140F64GQ48
    bool
    select CPU_FAM_EFM32TG11B

config CPU_MODEL_EFM32TG11B540F64IQ64
    bool
    select CPU_FAM_EFM32TG11B

config CPU_MODEL_EFM32TG11B120F128IQ48
    bool
    select CPU_FAM_EFM32TG11B

config CPU_MODEL_EFM32TG11B540F64GM64
    bool
    select CPU_FAM_EFM32TG11B

config CPU_MODEL_EFM32TG11B340F64IM64
    bool
    select CPU_FAM_EFM32TG11B

config CPU_MODEL_EFM32TG11B340F64GQ64
    bool
    select CPU_FAM_EFM32TG11B

config CPU_MODEL_EFM32TG11B120F128IM32
    bool
    select CPU_FAM_EFM32TG11B

config CPU_MODEL_EFM32TG11B140F64GM32
    bool
    select CPU_FAM_EFM32TG11B

config CPU_MODEL_EFM32TG11B520F128GQ80
    bool
    select CPU_FAM_EFM32TG11B

config CPU_MODEL_EFM32TG11B320F128GQ64
    bool
    select CPU_FAM_EFM32TG11B

config CPU_MODEL_EFM32TG11B320F128IM64
    bool
    select CPU_FAM_EFM32TG11B

config CPU_MODEL_EFM32TG11B520F128IM80
    bool
    select CPU_FAM_EFM32TG11B

config CPU_MODEL_EFM32TG11B520F128GQ48
    bool
    select CPU_FAM_EFM32TG11B

config CPU_MODEL_EFM32TG11B540F64IQ80
    bool
    select CPU_FAM_EFM32TG11B

config CPU_MODEL_EFM32TG11B540F64GM80
    bool
    select CPU_FAM_EFM32TG11B

config CPU_MODEL_EFM32TG11B140F64IM64
    bool
    select CPU_FAM_EFM32TG11B

config CPU_MODEL_EFM32TG11B140F64GQ64
    bool
    select CPU_FAM_EFM32TG11B

config CPU_MODEL_EFM32TG11B340F64GQ48
    bool
    select CPU_FAM_EFM32TG11B

config CPU_MODEL_EFM32TG11B120F128IQ64
    bool
    select CPU_FAM_EFM32TG11B

config CPU_MODEL_EFM32TG11B540F64IQ48
    bool
    select CPU_FAM_EFM32TG11B

config CPU_MODEL_EFM32TG11B120F128GM64
    bool
    select CPU_FAM_EFM32TG11B

config CPU_MODEL_EFM32TG11B520F128GM32
    bool
    select CPU_FAM_EFM32TG11B

config CPU_MODEL_EFM32TG11B540F64IM32
    bool
    select CPU_FAM_EFM32TG11B

## Common CPU symbols
config CPU_FAM
    default "efm32tg11b" if CPU_FAM_EFM32TG11B

config CPU_MODEL
    default "efm32tg11b120f128gq64" if CPU_MODEL_EFM32TG11B120F128GQ64
    default "efm32tg11b120f128im64" if CPU_MODEL_EFM32TG11B120F128IM64
    default "efm32tg11b540f64gq48"  if CPU_MODEL_EFM32TG11B540F64GQ48
    default "efm32tg11b340f64iq48"  if CPU_MODEL_EFM32TG11B340F64IQ48
    default "efm32tg11b140f64gm64"  if CPU_MODEL_EFM32TG11B140F64GM64
    default "efm32tg11b140f64iq64"  if CPU_MODEL_EFM32TG11B140F64IQ64
    default "efm32tg11b540f64gq80"  if CPU_MODEL_EFM32TG11B540F64GQ80
    default "efm32tg11b540f64im80"  if CPU_MODEL_EFM32TG11B540F64IM80
    default "efm32tg11b520f128iq48" if CPU_MODEL_EFM32TG11B520F128IQ48
    default "efm32tg11b520f128iq80" if CPU_MODEL_EFM32TG11B520F128IQ80
    default "efm32tg11b320f128iq64" if CPU_MODEL_EFM32TG11B320F128IQ64
    default "efm32tg11b320f128gm64" if CPU_MODEL_EFM32TG11B320F128GM64
    default "efm32tg11b520f128gm80" if CPU_MODEL_EFM32TG11B520F128GM80
    default "efm32tg11b540f64gm32"  if CPU_MODEL_EFM32TG11B540F64GM32
    default "efm32tg11b520f128im32" if CPU_MODEL_EFM32TG11B520F128IM32
    default "efm32tg11b340f64gm64"  if CPU_MODEL_EFM32TG11B340F64GM64
    default "efm32tg11b340f64iq64"  if CPU_MODEL_EFM32TG11B340F64IQ64
    default "efm32tg11b540f64gq64"  if CPU_MODEL_EFM32TG11B540F64GQ64
    default "efm32tg11b540f64im64"  if CPU_MODEL_EFM32TG11B540F64IM64
    default "efm32tg11b120f128gq48" if CPU_MODEL_EFM32TG11B120F128GQ48
    default "efm32tg11b140f64iq48"  if CPU_MODEL_EFM32TG11B140F64IQ48
    default "efm32tg11b520f128iq64" if CPU_MODEL_EFM32TG11B520F128IQ64
    default "efm32tg11b520f128gm64" if CPU_MODEL_EFM32TG11B520F128GM64
    default "efm32tg11b320f128iq48" if CPU_MODEL_EFM32TG11B320F128IQ48
    default "efm32tg11b140f64im32"  if CPU_MODEL_EFM32TG11B140F64IM32
    default "efm32tg11b120f128gm32" if CPU_MODEL_EFM32TG11B120F128GM32
    default "efm32tg11b320f128gq48" if CPU_MODEL_EFM32TG11B320F128GQ48
    default "efm32tg11b520f128gq64" if CPU_MODEL_EFM32TG11B520F128GQ64
    default "efm32tg11b520f128im64" if CPU_MODEL_EFM32TG11B520F128IM64
    default "efm32tg11b140f64gq48"  if CPU_MODEL_EFM32TG11B140F64GQ48
    default "efm32tg11b540f64iq64"  if CPU_MODEL_EFM32TG11B540F64IQ64
    default "efm32tg11b120f128iq48" if CPU_MODEL_EFM32TG11B120F128IQ48
    default "efm32tg11b540f64gm64"  if CPU_MODEL_EFM32TG11B540F64GM64
    default "efm32tg11b340f64im64"  if CPU_MODEL_EFM32TG11B340F64IM64
    default "efm32tg11b340f64gq64"  if CPU_MODEL_EFM32TG11B340F64GQ64
    default "efm32tg11b120f128im32" if CPU_MODEL_EFM32TG11B120F128IM32
    default "efm32tg11b140f64gm32"  if CPU_MODEL_EFM32TG11B140F64GM32
    default "efm32tg11b520f128gq80" if CPU_MODEL_EFM32TG11B520F128GQ80
    default "efm32tg11b320f128gq64" if CPU_MODEL_EFM32TG11B320F128GQ64
    default "efm32tg11b320f128im64" if CPU_MODEL_EFM32TG11B320F128IM64
    default "efm32tg11b520f128im80" if CPU_MODEL_EFM32TG11B520F128IM80
    default "efm32tg11b520f128gq48" if CPU_MODEL_EFM32TG11B520F128GQ48
    default "efm32tg11b540f64iq80"  if CPU_MODEL_EFM32TG11B540F64IQ80
    default "efm32tg11b540f64gm80"  if CPU_MODEL_EFM32TG11B540F64GM80
    default "efm32tg11b140f64im64"  if CPU_MODEL_EFM32TG11B140F64IM64
    default "efm32tg11b140f64gq64"  if CPU_MODEL_EFM32TG11B140F64GQ64
    default "efm32tg11b340f64gq48"  if CPU_MODEL_EFM32TG11B340F64GQ48
    default "efm32tg11b120f128iq64" if CPU_MODEL_EFM32TG11B120F128IQ64
    default "efm32tg11b540f64iq48"  if CPU_MODEL_EFM32TG11B540F64IQ48
    default "efm32tg11b120f128gm64" if CPU_MODEL_EFM32TG11B120F128GM64
    default "efm32tg11b520f128gm32" if CPU_MODEL_EFM32TG11B520F128GM32
    default "efm32tg11b540f64im32"  if CPU_MODEL_EFM32TG11B540F64IM32
```

## cpu/efm32/families/efm32zg/Kconfig
```kconfig
# Copyright (c) 2020 HAW Hamburg
#
# This file is subject to the terms and conditions of the GNU Lesser
# General Public License v2.1. See the file LICENSE in the top level
# directory for more details.

config CPU_FAM_EFM32ZG
    bool
    select CPU_CORE_CORTEX_M0PLUS
    select CPU_COMMON_EFM32
    select CPU_EFM32_SERIES0

## CPU Models
config CPU_MODEL_EFM32ZG222F16
    bool
    select CPU_FAM_EFM32ZG

config CPU_MODEL_EFM32ZG108F8
    bool
    select CPU_FAM_EFM32ZG

config CPU_MODEL_EFM32ZG110F16
    bool
    select CPU_FAM_EFM32ZG

config CPU_MODEL_EFM32ZG108F32
    bool
    select CPU_FAM_EFM32ZG

config CPU_MODEL_EFM32ZG210F4
    bool
    select CPU_FAM_EFM32ZG

config CPU_MODEL_EFM32ZG210F32
    bool
    select CPU_FAM_EFM32ZG

config CPU_MODEL_EFM32ZG222F8
    bool
    select CPU_FAM_EFM32ZG

config CPU_MODEL_EFM32ZG110F4
    bool
    select CPU_FAM_EFM32ZG

config CPU_MODEL_EFM32ZG210F16
    bool
    select CPU_FAM_EFM32ZG

config CPU_MODEL_EFM32ZG108F4
    bool
    select CPU_FAM_EFM32ZG

config CPU_MODEL_EFM32ZG210F8
    bool
    select CPU_FAM_EFM32ZG

config CPU_MODEL_EFM32ZG222F32
    bool
    select CPU_FAM_EFM32ZG

config CPU_MODEL_EFM32ZG222F4
    bool
    select CPU_FAM_EFM32ZG

config CPU_MODEL_EFM32ZG110F32
    bool
    select CPU_FAM_EFM32ZG

config CPU_MODEL_EFM32ZG110F8
    bool
    select CPU_FAM_EFM32ZG

config CPU_MODEL_EFM32ZG108F16
    bool
    select CPU_FAM_EFM32ZG

## Common CPU symbols
config CPU_FAM
    default "efm32zg" if CPU_FAM_EFM32ZG

config CPU_MODEL
    default "efm32zg222f16" if CPU_MODEL_EFM32ZG222F16
    default "efm32zg108f8" if CPU_MODEL_EFM32ZG108F8
    default "efm32zg110f16" if CPU_MODEL_EFM32ZG110F16
    default "efm32zg108f32" if CPU_MODEL_EFM32ZG108F32
    default "efm32zg210f4" if CPU_MODEL_EFM32ZG210F4
    default "efm32zg210f32" if CPU_MODEL_EFM32ZG210F32
    default "efm32zg222f8" if CPU_MODEL_EFM32ZG222F8
    default "efm32zg110f4" if CPU_MODEL_EFM32ZG110F4
    default "efm32zg210f16" if CPU_MODEL_EFM32ZG210F16
    default "efm32zg108f4" if CPU_MODEL_EFM32ZG108F4
    default "efm32zg210f8" if CPU_MODEL_EFM32ZG210F8
    default "efm32zg222f32" if CPU_MODEL_EFM32ZG222F32
    default "efm32zg222f4" if CPU_MODEL_EFM32ZG222F4
    default "efm32zg110f32" if CPU_MODEL_EFM32ZG110F32
    default "efm32zg110f8" if CPU_MODEL_EFM32ZG110F8
    default "efm32zg108f16" if CPU_MODEL_EFM32ZG108F16
```

## cpu/efm32/families/efr32mg12p/Kconfig
```kconfig
# SPDX-FileCopyrightText: 2020 HAW Hamburg
# SPDX-License-Identifier: LGPL-2.1-only

config CPU_FAM_EFR32MG12P
    bool
    select CPU_CORE_CORTEX_M4F
    select CPU_COMMON_EFM32
    select CPU_EFM32_SERIES1

## CPU Models
config CPU_MODEL_EFR32MG12P432F1024GM68
    bool
    select CPU_FAM_EFR32MG12P

config CPU_MODEL_EFR32MG12P332F1024IM48
    bool
    select CPU_FAM_EFR32MG12P

config CPU_MODEL_EFR32MG12P432F1024IM48
    bool
    select CPU_FAM_EFR32MG12P

config CPU_MODEL_EFR32MG12P231F1024GM48
    bool
    select CPU_FAM_EFR32MG12P

config CPU_MODEL_EFR32MG12P432F1024GL125
    bool
    select CPU_FAM_EFR32MG12P

config CPU_MODEL_EFR32MG12P232F512GM68
    bool
    select CPU_FAM_EFR32MG12P

config CPU_MODEL_EFR32MG12P332F1024GL125
    bool
    select CPU_FAM_EFR32MG12P

config CPU_MODEL_EFR32MG12P232F1024GM68
    bool
    select CPU_FAM_EFR32MG12P

config CPU_MODEL_EFR32MG12P132F1024GM48
    bool
    select CPU_FAM_EFR32MG12P

config CPU_MODEL_EFR32MG12P431F1024GM48
    bool
    select CPU_FAM_EFR32MG12P

config CPU_MODEL_EFR32MG12P433F1024IL125
    bool
    select CPU_FAM_EFR32MG12P

config CPU_MODEL_EFR32MG12P132F512GM68
    bool
    select CPU_FAM_EFR32MG12P

config CPU_MODEL_EFR32MG12P433F1024GM48
    bool
    select CPU_FAM_EFR32MG12P

config CPU_MODEL_EFR32MG12P433F1024GM68
    bool
    select CPU_FAM_EFR32MG12P

config CPU_MODEL_EFR32MG12P433F1024GL125
    bool
    select CPU_FAM_EFR32MG12P

config CPU_MODEL_EFR32MG12P433F1024IM48
    bool
    select CPU_FAM_EFR32MG12P

config CPU_MODEL_EFR32MG12P231F1024GM68
    bool
    select CPU_FAM_EFR32MG12P

config CPU_MODEL_EFR32MG12P232F1024GL125
    bool
    select CPU_FAM_EFR32MG12P

config CPU_MODEL_EFR32MG12P432F1024GM48
    bool
    select CPU_FAM_EFR32MG12P

config CPU_MODEL_EFR32MG12P332F1024GM48
    bool
    select CPU_FAM_EFR32MG12P

config CPU_MODEL_EFR32MG12P431F1024GM68
    bool
    select CPU_FAM_EFR32MG12P

config CPU_MODEL_EFR32MG12P132F1024GL125
    bool
    select CPU_FAM_EFR32MG12P

config CPU_MODEL_EFR32MG12P232F1024GM48
    bool
    select CPU_FAM_EFR32MG12P

## Common CPU symbols
config CPU_FAM
    default "efr32mg12p" if CPU_FAM_EFR32MG12P

config CPU_MODEL
    default "efr32mg12p432f1024gm68"  if CPU_MODEL_EFR32MG12P432F1024GM68
    default "efr32mg12p332f1024im48"  if CPU_MODEL_EFR32MG12P332F1024IM48
    default "efr32mg12p432f1024im48"  if CPU_MODEL_EFR32MG12P432F1024IM48
    default "efr32mg12p231f1024gm48"  if CPU_MODEL_EFR32MG12P231F1024GM48
    default "efr32mg12p432f1024gl125" if CPU_MODEL_EFR32MG12P432F1024GL125
    default "efr32mg12p232f512gm68"   if CPU_MODEL_EFR32MG12P232F512GM68
    default "efr32mg12p332f1024gl125" if CPU_MODEL_EFR32MG12P332F1024GL125
    default "efr32mg12p232f1024gm68"  if CPU_MODEL_EFR32MG12P232F1024GM68
    default "efr32mg12p132f1024gm48"  if CPU_MODEL_EFR32MG12P132F1024GM48
    default "efr32mg12p431f1024gm48"  if CPU_MODEL_EFR32MG12P431F1024GM48
    default "efr32mg12p433f1024il125" if CPU_MODEL_EFR32MG12P433F1024IL125
    default "efr32mg12p132f512gm68"   if CPU_MODEL_EFR32MG12P132F512GM68
    default "efr32mg12p433f1024gm48"  if CPU_MODEL_EFR32MG12P433F1024GM48
    default "efr32mg12p433f1024gm68"  if CPU_MODEL_EFR32MG12P433F1024GM68
    default "efr32mg12p433f1024gl125" if CPU_MODEL_EFR32MG12P433F1024GL125
    default "efr32mg12p433f1024im48"  if CPU_MODEL_EFR32MG12P433F1024IM48
    default "efr32mg12p231f1024gm68"  if CPU_MODEL_EFR32MG12P231F1024GM68
    default "efr32mg12p232f1024gl125" if CPU_MODEL_EFR32MG12P232F1024GL125
    default "efr32mg12p432f1024gm48"  if CPU_MODEL_EFR32MG12P432F1024GM48
    default "efr32mg12p332f1024gm48"  if CPU_MODEL_EFR32MG12P332F1024GM48
    default "efr32mg12p431f1024gm68"  if CPU_MODEL_EFR32MG12P431F1024GM68
    default "efr32mg12p132f1024gl125" if CPU_MODEL_EFR32MG12P132F1024GL125
    default "efr32mg12p232f1024gm48"  if CPU_MODEL_EFR32MG12P232F1024GM48
```
