## cpu/avr8_common/Kconfig
```kconfig
# Copyright (c) 2020 HAW Hamburg
#               2021 Gerson Fernando Budke
#
# This file is subject to the terms and conditions of the GNU Lesser
# General Public License v2.1. See the file LICENSE in the top level
# directory for more details.
#

config CPU_ARCH_AVR8
    bool

## Common CPU symbols
config CPU_ARCH
    default "avr8" if CPU_ARCH_AVR8

config CPU_CORE
    default "avr" if CPU_CORE_AVR
```

## cpu/avr8_common/avr_libc_extra/Kconfig
```kconfig
# Copyright (c) 2021 HAW Hamburg
#
# This file is subject to the terms and conditions of the GNU Lesser
# General Public License v2.1. See the file LICENSE in the top level
# directory for more details.
#

config MODULE_AVR_LIBC_EXTRA
    bool
    depends on TEST_KCONFIG
    depends on CPU_ARCH_AVR8
    default y
    help
        AVR libc RIOT-specific support code.
```

## cpu/avr8_common/periph/Kconfig
```kconfig
config MODULE_AVR8_COMMON_PERIPH
    bool
    depends on TEST_KCONFIG
    depends on CPU_COMMON_ATXMEGA
    default y
    help
        AVR8 common peripheral drivers.
```

## cpu/cc2538/Kconfig
```kconfig
# SPDX-FileCopyrightText: 2020 HAW Hamburg
# SPDX-License-Identifier: LGPL-2.1-only

config CPU_FAM_CC2538
    bool
    select CPU_CORE_CORTEX_M3

## CPU Models
config CPU_MODEL_CC2538NF53
    bool
    select CPU_FAM_CC2538

config CPU_MODEL_CC2538SF53
    bool
    select CPU_FAM_CC2538

## Common CPU symbols
config CPU_FAM
    default "cc2538" if CPU_FAM_CC2538

config CPU_MODEL
    default "cc2538nf53" if CPU_MODEL_CC2538NF53
    default "cc2538sf53" if CPU_MODEL_CC2538SF53

config CPU
    default "cc2538" if CPU_FAM_CC2538

source "$(RIOTCPU)/cortexm_common/Kconfig"
```

## cpu/cc2538/radio/Kconfig
```kconfig
# Copyright (c) 2021 HAW Hamburg
#
# This file is subject to the terms and conditions of the GNU Lesser
# General Public License v2.1. See the file LICENSE in the top level
# directory for more details.
#

menuconfig MODULE_CC2538_RF
    bool
    prompt "CC2538 IEEE 802.15.4 radio" if !(MODULE_NETDEV_DEFAULT && HAVE_CC2538_RF)
    default (MODULE_NETDEV_DEFAULT && HAVE_CC2538_RF)
    depends on TEST_KCONFIG
    depends on CPU_FAM_CC2538
    select HAVE_IEEE802154_RADIO_HAL_INTERFACE

if MODULE_CC2538_RF

config MODULE_CC2538_RF_OBS_SIG
    bool "Output observation signals"
    help
        Say y to output different observation signals from the RF Core
        to GPIO pins. These signals can be useful for debugging of
        low-level protocols or control of external PA, LNA, or switches.

        For more information check section 9.2.4 of the CC2538 User's Manual.

endif # MODULE_CC2538_RF

config HAVE_CC2538_RF
    bool
    help
        Indicates that a cc2538 radio is present.
```

## cpu/cc26x0/Kconfig
```kconfig
# Copyright (c) 2020 Locha Inc
#
# This file is subject to the terms and conditions of the GNU Lesser
# General Public License v2.1. See the file LICENSE in the top level
# directory for more details.
#

config CPU_FAMILY_CC26X0_CC13X0
    bool
    select CPU_CORE_CORTEX_M3
    select CPU_COMMON_CC26XX_CC13XX
    select HAS_CPU_CC26X0
    select HAS_CORTEXM_MPU

config CPU_SERIES_CC26X0
    bool
    select CPU_FAMILY_CC26X0_CC13X0

## CPU Models
config CPU_MODEL_CC26X0F128
    bool
    select CPU_SERIES_CC26X0

## Definition of specific features
config HAS_CPU_CC26X0
    bool
    help
        Indicates that a 'cc26x0' cpu is being used.

## Common CPU symbols
config CPU_FAMILY
    default "cc26x0_cc13x0" if CPU_FAMILY_CC26X0_CC13X0

config CPU_SERIES
    default "cc26x0" if CPU_SERIES_CC26X0

config CPU_MODEL
    default "cc26x0f128" if CPU_MODEL_CC26X0F128

source "$(RIOTCPU)/cc26xx_cc13xx/Kconfig"
```

## cpu/cc26x0_cc13x0/Kconfig
```kconfig
# Copyright (c) 2020 Locha Inc
#
# This file is subject to the terms and conditions of the GNU Lesser
# General Public License v2.1. See the file LICENSE in the top level
# directory for more details.
#

config CPU_FAM_CC26X0
    bool
    select CPU_CORE_CORTEX_M3
    select CPU_COMMON_CC26XX_CC13XX

config CPU_FAM_CC13X0
    bool
    select CPU_CORE_CORTEX_M3
    select CPU_COMMON_CC26XX_CC13XX

## CPU Models
config CPU_MODEL_CC26X0F128
    bool
    select CPU_FAM_CC26X0

config CPU_MODEL_CC13X0F128
    bool
    select CPU_FAM_CC13X0

## Common CPU symbols
config CPU_FAM
    default "cc26x0" if CPU_FAM_CC26X0
    default "cc13x0" if CPU_FAM_CC13X0

config CPU_MODEL
    default "cc26x0f128" if CPU_MODEL_CC26X0F128
    default "cc13x0f128" if CPU_MODEL_CC13X0F128

config CPU
    default "cc26x0_cc13x0"

source "$(RIOTCPU)/cc26xx_cc13xx/Kconfig"
```

## cpu/cc26x2_cc13x2/Kconfig
```kconfig
# Copyright (c) 2020 Locha Inc
#
# This file is subject to the terms and conditions of the GNU Lesser
# General Public License v2.1. See the file LICENSE in the top level
# directory for more details.
#

config CPU_FAM_CC13X2
    bool
    select CPU_COMMON_CC26XX_CC13XX
    select CPU_FAM_CC13XX
    select CPU_CORE_CORTEX_M4F

## CPU Models
config CPU_MODEL_CC1312R1F3
    bool
    select CPU_FAM_CC13X2

config CPU_MODEL_CC1352R1
    bool
    select CPU_FAM_CC13X2

config CPU_MODEL_CC1352P1
    bool
    select CPU_FAM_CC13X2

## Common CPU symbols
config CPU_FAM
    default "cc13x2" if CPU_FAM_CC13X2

config CPU_MODEL
    default "cc1312r1f3" if CPU_MODEL_CC1312R1F3
    default "cc1352r1" if CPU_MODEL_CC1352R1
    default "cc1352p1" if CPU_MODEL_CC1352P1

config CPU
    default "cc26x2_cc13x2"

source "$(RIOTCPU)/cc26xx_cc13xx/Kconfig"
```

## cpu/cc26xx_cc13xx/Kconfig
```kconfig
# Copyright (c) 2020 Locha Inc
#
# This file is subject to the terms and conditions of the GNU Lesser
# General Public License v2.1. See the file LICENSE in the top level
# directory for more details.
#

config CPU_COMMON_CC26XX_CC13XX
    bool
    select HAS_PERIPH_CPUID
    select HAS_PERIPH_UART
    select HAS_PERIPH_UART_MODECFG

config CPU_FAM_CC13XX
    bool

menuconfig CC26XX_CC13XX_UPDATE_CCFG
    bool "Update CCFG"
    help
        This includes the CCFG configuration in the binary for flashing
        onto the micro-controller.

        CCFG stands for Customer Configueration, it's different from the
        FCFG which is the Factory Configuration of the device.

if CC26XX_CC13XX_UPDATE_CCFG

config CC26XX_CC13XX_FORCE_VDDR_HH
    bool "Force VDDR high"
    depends on CPU_FAM_CC13XX
    help
        Force VDDR high setting, enables higher output power but also higher
        power consumption.

        This is also called "boost mode".

config CC26XX_CC13XX_GPRAM
    bool "Enable GPRAM"
    help
        Enable GPRAM and use 8K VIMS RAM as GPRAM (instead of cache).

        Notes:
            - Enabling GPRAM disables CACHE and will reduce CPU execution speed
            (up to 60%).
            - GPRAM is 8KB in size and located at 0x11000000-0x11001FFF if
            enabled.

menuconfig CC26XX_CC13XX_ROM_BOOTLOADER
    bool "Enable ROM bootloader"
    help
        Enables the ROM bootloader and the bootloader backdoor to
        read/write flash memory using a serial interface.

if CC26XX_CC13XX_ROM_BOOTLOADER

choice
    bool "Bootloader backdoor DIO level"
    default CC26XX_CC13XX_BL_LEVEL_ACTIVE_HIGH
    help
        This configures the level need to enter the bootloader backdoor at boot
        time.

config CC26XX_CC13XX_BL_LEVEL_ACTIVE_HIGH
    bool "Active high"

config CC26XX_CC13XX_BL_LEVEL_ACTIVE_LOW
    bool "Active low"

endchoice

config CC26XX_CC13XX_BL_PIN_EN
    bool "Enable bootloader backdoor DIO"

config CC26XX_CC13XX_BL_PIN
    int "Bootloader backdoor DIO number"
    range 0 31
    depends on CC26XX_CC13XX_BL_PIN_EN
    help
        DIO (pin) number used to enter the bootloader backdoor at
        boot time.

endif # CC26XX_CC13XX_ROM_BOOTLOADER

endif # CC26XX_CC13XX_UPDATE_CCFG

source "$(RIOTCPU)/cortexm_common/Kconfig"

config MODULE_CC26XX_CC13XX
    bool
    depends on TEST_KCONFIG
    depends on CPU_COMMON_CC26XX_CC13XX
    select MODULE_PERIPH_COMMON
    select MODULE_CC26XX_CC13XX_PERIPH
    default y
    help
      Common code for TI cc26xx/cc13xx family.

rsource "periph/Kconfig"
```

## cpu/cc26xx_cc13xx/periph/Kconfig
```kconfig
# Copyright (c) 2021 HAW Hamburg
#
# This file is subject to the terms and conditions of the GNU Lesser
# General Public License v2.1. See the file LICENSE in the top level
# directory for more details.
#

config MODULE_CC26XX_CC13XX_PERIPH
    bool
    depends on TEST_KCONFIG
    depends on CPU_COMMON_CC26XX_CC13XX
    help
      Common peripheral drivers for TI cc26xx/cc13xx family.
```

## cpu/cc430/Kconfig
```kconfig
# Copyright (c) 2020 Freie Universität Berlin
#               2020 HAW Hamburg
#
# This file is subject to the terms and conditions of the GNU Lesser
# General Public License v2.1. See the file LICENSE in the top level
# directory for more details.
#

config CPU_FAM_CC430
    bool
    select CPU_CORE_MSP430
    select HAS_CPU_CC430

## CPU Models
config CPU_MODEL_CC430F6137
    bool
    select CPU_FAM_CC430

## Definition of specific features
config HAS_CPU_CC430
    bool
    help
        Indicates that a 'cc430' cpu is being used.

## Common CPU symbols
config CPU_FAM
    default "cc430" if CPU_FAM_CC430

config CPU_MODEL
    default "cc430f6137" if CPU_MODEL_CC430F6137

config CPU
    default "cc430" if CPU_FAM_CC430

source "$(RIOTCPU)/msp430_common/Kconfig"
```

## cpu/cortexm_common/Kconfig
```kconfig
# SPDX-FileCopyrightText: 2020 HAW Hamburg
# SPDX-License-Identifier: LGPL-2.1-only

config CPU_ARCH_ARMV6M
    bool

config CPU_ARCH_ARMV7M
    bool

config CPU_ARCH_ARMV8M
    bool

config CPU_ARCH
    default "armv6m" if CPU_ARCH_ARMV6M
    default "armv7m" if CPU_ARCH_ARMV7M
    default "armv8m" if CPU_ARCH_ARMV8M

config CPU_CORE_CORTEX_M
    bool

## Common CPU symbols
config CPU_CORE
    default "cortex-m0" if CPU_CORE_CORTEX_M0
    default "cortex-m0plus" if CPU_CORE_CORTEX_M0PLUS
    default "cortex-m23" if CPU_CORE_CORTEX_M23
    default "cortex-m3" if CPU_CORE_CORTEX_M3
    default "cortex-m33" if CPU_CORE_CORTEX_M33
    default "cortex-m4" if CPU_CORE_CORTEX_M4
    default "cortex-m4f" if CPU_CORE_CORTEX_M4F
    default "cortex-m7" if CPU_CORE_CORTEX_M7

config CPU_CORE_CORTEX_M0
    bool
    select CPU_ARCH_ARMV6M
    select CPU_CORE_CORTEX_M

config CPU_CORE_CORTEX_M0PLUS
    bool
    select CPU_ARCH_ARMV6M
    select CPU_CORE_CORTEX_M

config CPU_CORE_CORTEX_M23
    bool
    select CPU_ARCH_ARMV8M
    select CPU_CORE_CORTEX_M

config CPU_CORE_CORTEX_M3
    bool
    select CPU_ARCH_ARMV7M
    select CPU_CORE_CORTEX_M

config CPU_CORE_CORTEX_M33
    bool
    select CPU_ARCH_ARMV8M
    select CPU_CORE_CORTEX_M

config CPU_CORE_CORTEX_M4
    bool
    select CPU_ARCH_ARMV7M
    select CPU_CORE_CORTEX_M

config CPU_CORE_CORTEX_M4F
    bool
    select CPU_ARCH_ARMV7M
    select CPU_CORE_CORTEX_M

config CPU_CORE_CORTEX_M7
    bool
    select CPU_ARCH_ARMV7M
    select CPU_CORE_CORTEX_M
```

## cpu/cortexm_common/periph/Kconfig
```kconfig
# Copyright (c) 2020 HAW Hamburg
#
# This file is subject to the terms and conditions of the GNU Lesser
# General Public License v2.1. See the file LICENSE in the top level
# directory for more details.
#

config MODULE_CORTEXM_COMMON_PERIPH
    bool
    default y if CPU_CORE_CORTEX_M
    depends on TEST_KCONFIG
    help
        Common code for Cortex-M core peripherals.
```

## cpu/efm32/Kconfig
```kconfig
# Copyright (c) 2020 HAW Hamburg
#
# This file is subject to the terms and conditions of the GNU Lesser
# General Public License v2.1. See the file LICENSE in the top level
# directory for more details.

config CPU_COMMON_EFM32
    bool

config CPU_EFM32_SERIES0
    bool

config CPU_EFM32_SERIES1
    bool

config CPU_EFM32_SERIES2
    bool

## Common CPU symbols
config CPU
    default "efm32" if CPU_COMMON_EFM32

orsource "families/*/Kconfig"
source "$(RIOTCPU)/cortexm_common/Kconfig"
```

## cpu/efm32/drivers/coretemp/Kconfig
```kconfig
# Copyright (c) 2021 HAW Hamburg
#
# This file is subject to the terms and conditions of the GNU Lesser
# General Public License v2.1. See the file LICENSE in the top level
# directory for more details.
#

config MODULE_EFM32_CORETEMP
    bool "EFM32 internal temperature sensor driver"
    depends on TEST_KCONFIG
    depends on HAS_EFM32_CORETEMP
    depends on HAS_PERIPH_ADC
    select MODULE_PERIPH_ADC

config HAS_EFM32_CORETEMP
    bool
    select MODULE_EFM32_CORETEMP if MODULE_SAUL_DEFAULT && HAS_PERIPH_ADC
    help
        Indicates that the EFM32 coretemp driver is being used.
```
