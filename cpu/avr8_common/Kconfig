## cpu/efm32/families/efm32gg/Kconfig
```kconfig
# Copyright (c) 2020 HAW Hamburg
#
# This file is subject to the terms and conditions of the GNU Lesser
# General Public License v2.1. See the file LICENSE in the top level
# directory for more details.

config CPU_FAM_EFM32GG
    bool
    select CPU_CORE_CORTEX_M3
    select CPU_COMMON_EFM32
    select CPU_EFM32_SERIES0
    select HAS_CORTEXM_MPU

## CPU Models
config CPU_MODEL_EFM32GG330F512
    bool
    select CPU_FAM_EFM32GG

config CPU_MODEL_EFM32GG295F512
    bool
    select CPU_FAM_EFM32GG

config CPU_MODEL_EFM32GG940F1024
    bool
    select CPU_FAM_EFM32GG

config CPU_MODEL_EFM32GG840F1024
    bool
    select CPU_FAM_EFM32GG

config CPU_MODEL_EFM32GG332F512
    bool
    select CPU_FAM_EFM32GG

config CPU_MODEL_EFM32GG990F512
    bool
    select CPU_FAM_EFM32GG

config CPU_MODEL_EFM32GG890F512
    bool
    select CPU_FAM_EFM32GG

config CPU_MODEL_EFM32GG232F512
    bool
    select CPU_FAM_EFM32GG

config CPU_MODEL_EFM32GG942F1024
    bool
    select CPU_FAM_EFM32GG

config CPU_MODEL_EFM32GG842F1024
    bool
    select CPU_FAM_EFM32GG

config CPU_MODEL_EFM32GG395F1024
    bool
    select CPU_FAM_EFM32GG

config CPU_MODEL_EFM32GG295F1024
    bool
    select CPU_FAM_EFM32GG

config CPU_MODEL_EFM32GG995F1024
    bool
    select CPU_FAM_EFM32GG

config CPU_MODEL_EFM32GG895F1024
    bool
    select CPU_FAM_EFM32GG

config CPU_MODEL_EFM32GG395F512
    bool
    select CPU_FAM_EFM32GG

config CPU_MODEL_EFM32GG230F512
    bool
    select CPU_FAM_EFM32GG

config CPU_MODEL_EFM32GG895F512
    bool
    select CPU_FAM_EFM32GG

config CPU_MODEL_EFM32GG390F512
    bool
    select CPU_FAM_EFM32GG

config CPU_MODEL_EFM32GG290F512
    bool
    select CPU_FAM_EFM32GG

config CPU_MODEL_EFM32GG995F512
    bool
    select CPU_FAM_EFM32GG

config CPU_MODEL_EFM32GG980F512
    bool
    select CPU_FAM_EFM32GG

config CPU_MODEL_EFM32GG940F512
    bool
    select CPU_FAM_EFM32GG

config CPU_MODEL_EFM32GG942F512
    bool
    select CPU_FAM_EFM32GG

config CPU_MODEL_EFM32GG330F1024
    bool
    select CPU_FAM_EFM32GG

config CPU_MODEL_EFM32GG230F1024
    bool
    select CPU_FAM_EFM32GG

config CPU_MODEL_EFM32GG842F512
    bool
    select CPU_FAM_EFM32GG

config CPU_MODEL_EFM32GG332F1024
    bool
    select CPU_FAM_EFM32GG

config CPU_MODEL_EFM32GG232F1024
    bool
    select CPU_FAM_EFM32GG

config CPU_MODEL_EFM32GG880F512
    bool
    select CPU_FAM_EFM32GG

config CPU_MODEL_EFM32GG840F512
    bool
    select CPU_FAM_EFM32GG

config CPU_MODEL_EFM32GG380F512
    bool
    select CPU_FAM_EFM32GG

config CPU_MODEL_EFM32GG890F1024
    bool
    select CPU_FAM_EFM32GG

config CPU_MODEL_EFM32GG990F1024
    bool
    select CPU_FAM_EFM32GG

config CPU_MODEL_EFM32GG290F1024
    bool
    select CPU_FAM_EFM32GG

config CPU_MODEL_EFM32GG390F1024
    bool
    select CPU_FAM_EFM32GG

config CPU_MODEL_EFM32GG900F1024
    bool
    select CPU_FAM_EFM32GG

config CPU_MODEL_EFM32GG900F512
    bool
    select CPU_FAM_EFM32GG

config CPU_MODEL_EFM32GG380F1024
    bool
    select CPU_FAM_EFM32GG

config CPU_MODEL_EFM32GG280F1024
    bool
    select CPU_FAM_EFM32GG

config CPU_MODEL_EFM32GG280F512
    bool
    select CPU_FAM_EFM32GG

config CPU_MODEL_EFM32GG980F1024
    bool
    select CPU_FAM_EFM32GG

config CPU_MODEL_EFM32GG880F1024
    bool
    select CPU_FAM_EFM32GG

## Common CPU symbols
config CPU_FAM
    default "efm32gg" if CPU_FAM_EFM32GG

config CPU_MODEL
    default "efm32gg330f512"  if CPU_MODEL_EFM32GG330F512
    default "efm32gg295f512"  if CPU_MODEL_EFM32GG295F512
    default "efm32gg940f1024" if CPU_MODEL_EFM32GG940F1024
    default "efm32gg840f1024" if CPU_MODEL_EFM32GG840F1024
    default "efm32gg332f512"  if CPU_MODEL_EFM32GG332F512
    default "efm32gg990f512"  if CPU_MODEL_EFM32GG990F512
    default "efm32gg890f512"  if CPU_MODEL_EFM32GG890F512
    default "efm32gg232f512"  if CPU_MODEL_EFM32GG232F512
    default "efm32gg942f1024" if CPU_MODEL_EFM32GG942F1024
    default "efm32gg842f1024" if CPU_MODEL_EFM32GG842F1024
    default "efm32gg395f1024" if CPU_MODEL_EFM32GG395F1024
    default "efm32gg295f1024" if CPU_MODEL_EFM32GG295F1024
    default "efm32gg995f1024" if CPU_MODEL_EFM32GG995F1024
    default "efm32gg895f1024" if CPU_MODEL_EFM32GG895F1024
    default "efm32gg395f512"  if CPU_MODEL_EFM32GG395F512
    default "efm32gg230f512"  if CPU_MODEL_EFM32GG230F512
    default "efm32gg895f512"  if CPU_MODEL_EFM32GG895F512
    default "efm32gg390f512"  if CPU_MODEL_EFM32GG390F512
    default "efm32gg290f512"  if CPU_MODEL_EFM32GG290F512
    default "efm32gg995f512"  if CPU_MODEL_EFM32GG995F512
    default "efm32gg980f512"  if CPU_MODEL_EFM32GG980F512
    default "efm32gg940f512"  if CPU_MODEL_EFM32GG940F512
    default "efm32gg942f512"  if CPU_MODEL_EFM32GG942F512
    default "efm32gg330f1024" if CPU_MODEL_EFM32GG330F1024
    default "efm32gg230f1024" if CPU_MODEL_EFM32GG230F1024
    default "efm32gg842f512"  if CPU_MODEL_EFM32GG842F512
    default "efm32gg332f1024" if CPU_MODEL_EFM32GG332F1024
    default "efm32gg232f1024" if CPU_MODEL_EFM32GG232F1024
    default "efm32gg880f512"  if CPU_MODEL_EFM32GG880F512
    default "efm32gg840f512"  if CPU_MODEL_EFM32GG840F512
    default "efm32gg380f512"  if CPU_MODEL_EFM32GG380F512
    default "efm32gg890f1024" if CPU_MODEL_EFM32GG890F1024
    default "efm32gg990f1024" if CPU_MODEL_EFM32GG990F1024
    default "efm32gg290f1024" if CPU_MODEL_EFM32GG290F1024
    default "efm32gg390f1024" if CPU_MODEL_EFM32GG390F1024
    default "efm32gg900f1024" if CPU_MODEL_EFM32GG900F1024
    default "efm32gg900f512"  if CPU_MODEL_EFM32GG900F512
    default "efm32gg380f1024" if CPU_MODEL_EFM32GG380F1024
    default "efm32gg280f1024" if CPU_MODEL_EFM32GG280F1024
    default "efm32gg280f512"  if CPU_MODEL_EFM32GG280F512
    default "efm32gg980f1024" if CPU_MODEL_EFM32GG980F1024
    default "efm32gg880f1024" if CPU_MODEL_EFM32GG880F1024
```

## cpu/efm32/families/efm32gg11b/Kconfig
```kconfig
# SPDX-FileCopyrightText: 2020 HAW Hamburg
# SPDX-License-Identifier: LGPL-2.1-only

config CPU_FAM_EFM32GG11B
    bool
    select CPU_CORE_CORTEX_M4F
    select CPU_COMMON_EFM32
    select CPU_EFM32_SERIES1

## CPU Models
config CPU_MODEL_EFM32GG11B510F2048IL120
    bool
    select CPU_FAM_EFM32GG11B

config CPU_MODEL_EFM32GG11B120F2048GM64
    bool
    select CPU_FAM_EFM32GG11B

config CPU_MODEL_EFM32GG11B120F2048IQ64
    bool
    select CPU_FAM_EFM32GG11B

config CPU_MODEL_EFM32GG11B820F2048GL152
    bool
    select CPU_FAM_EFM32GG11B

config CPU_MODEL_EFM32GG11B520F2048IM64
    bool
    select CPU_FAM_EFM32GG11B

config CPU_MODEL_EFM32GG11B520F2048GQ64
    bool
    select CPU_FAM_EFM32GG11B

config CPU_MODEL_EFM32GG11B840F1024GL120
    bool
    select CPU_FAM_EFM32GG11B

config CPU_MODEL_EFM32GG11B420F2048IL120
    bool
    select CPU_FAM_EFM32GG11B

config CPU_MODEL_EFM32GG11B520F2048GL120
    bool
    select CPU_FAM_EFM32GG11B

config CPU_MODEL_EFM32GG11B840F1024GQ64
    bool
    select CPU_FAM_EFM32GG11B

config CPU_MODEL_EFM32GG11B840F1024IM64
    bool
    select CPU_FAM_EFM32GG11B

config CPU_MODEL_EFM32GG11B820F2048GQ100
    bool
    select CPU_FAM_EFM32GG11B

config CPU_MODEL_EFM32GG11B420F2048GQ64
    bool
    select CPU_FAM_EFM32GG11B

config CPU_MODEL_EFM32GG11B420F2048IM64
    bool
    select CPU_FAM_EFM32GG11B

config CPU_MODEL_EFM32GG11B420F2048IL112
    bool
    select CPU_FAM_EFM32GG11B

config CPU_MODEL_EFM32GG11B510F2048IQ100
    bool
    select CPU_FAM_EFM32GG11B

config CPU_MODEL_EFM32GG11B310F2048GL112
    bool
    select CPU_FAM_EFM32GG11B

config CPU_MODEL_EFM32GG11B840F1024GL152
    bool
    select CPU_FAM_EFM32GG11B

config CPU_MODEL_EFM32GG11B310F2048GQ100
    bool
    select CPU_FAM_EFM32GG11B

config CPU_MODEL_EFM32GG11B510F2048GQ64
    bool
    select CPU_FAM_EFM32GG11B

config CPU_MODEL_EFM32GG11B510F2048IM64
    bool
    select CPU_FAM_EFM32GG11B

config CPU_MODEL_EFM32GG11B820F2048GQ64
    bool
    select CPU_FAM_EFM32GG11B

config CPU_MODEL_EFM32GG11B820F2048GL120
    bool
    select CPU_FAM_EFM32GG11B

config CPU_MODEL_EFM32GG11B820F2048IM64
    bool
    select CPU_FAM_EFM32GG11B

config CPU_MODEL_EFM32GG11B420F2048IQ100
    bool
    select CPU_FAM_EFM32GG11B

config CPU_MODEL_EFM32GG11B840F1024GQ100
    bool
    select CPU_FAM_EFM32GG11B

config CPU_MODEL_EFM32GG11B110F2048IQ64
    bool
    select CPU_FAM_EFM32GG11B

config CPU_MODEL_EFM32GG11B110F2048GM64
    bool
    select CPU_FAM_EFM32GG11B

config CPU_MODEL_EFM32GG11B520F2048GQ100
    bool
    select CPU_FAM_EFM32GG11B

config CPU_MODEL_EFM32GG11B820F2048IL120
    bool
    select CPU_FAM_EFM32GG11B

config CPU_MODEL_EFM32GG11B840F1024IQ100
    bool
    select CPU_FAM_EFM32GG11B

config CPU_MODEL_EFM32GG11B420F2048GQ100
    bool
    select CPU_FAM_EFM32GG11B

config CPU_MODEL_EFM32GG11B820F2048GL192
    bool
    select CPU_FAM_EFM32GG11B

config CPU_MODEL_EFM32GG11B320F2048GL112
    bool
    select CPU_FAM_EFM32GG11B

config CPU_MODEL_EFM32GG11B520F2048IQ100
    bool
    select CPU_FAM_EFM32GG11B

config CPU_MODEL_EFM32GG11B110F2048GQ64
    bool
    select CPU_FAM_EFM32GG11B

config CPU_MODEL_EFM32GG11B110F2048IM64
    bool
    select CPU_FAM_EFM32GG11B

config CPU_MODEL_EFM32GG11B320F2048GQ100
    bool
    select CPU_FAM_EFM32GG11B

config CPU_MODEL_EFM32GG11B420F2048GL112
    bool
    select CPU_FAM_EFM32GG11B

config CPU_MODEL_EFM32GG11B510F2048GQ100
    bool
    select CPU_FAM_EFM32GG11B

config CPU_MODEL_EFM32GG11B820F2048IQ64
    bool
    select CPU_FAM_EFM32GG11B

config CPU_MODEL_EFM32GG11B820F2048GM64
    bool
    select CPU_FAM_EFM32GG11B

config CPU_MODEL_EFM32GG11B510F2048IQ64
    bool
    select CPU_FAM_EFM32GG11B

config CPU_MODEL_EFM32GG11B510F2048GM64
    bool
    select CPU_FAM_EFM32GG11B

config CPU_MODEL_EFM32GG11B840F1024IL152
    bool
    select CPU_FAM_EFM32GG11B

config CPU_MODEL_EFM32GG11B420F2048GL120
    bool
    select CPU_FAM_EFM32GG11B

config CPU_MODEL_EFM32GG11B840F1024IL120
    bool
    select CPU_FAM_EFM32GG11B

config CPU_MODEL_EFM32GG11B520F2048GM64
    bool
    select CPU_FAM_EFM32GG11B

config CPU_MODEL_EFM32GG11B520F2048IQ64
    bool
    select CPU_FAM_EFM32GG11B

config CPU_MODEL_EFM32GG11B520F2048IL120
    bool
    select CPU_FAM_EFM32GG11B

config CPU_MODEL_EFM32GG11B840F1024GL192
    bool
    select CPU_FAM_EFM32GG11B

config CPU_MODEL_EFM32GG11B120F2048IM64
    bool
    select CPU_FAM_EFM32GG11B

config CPU_MODEL_EFM32GG11B120F2048GQ64
    bool
    select CPU_FAM_EFM32GG11B

config CPU_MODEL_EFM32GG11B820F2048IQ100
    bool
    select CPU_FAM_EFM32GG11B

config CPU_MODEL_EFM32GG11B420F2048IQ64
    bool
    select CPU_FAM_EFM32GG11B

config CPU_MODEL_EFM32GG11B420F2048GM64
    bool
    select CPU_FAM_EFM32GG11B

config CPU_MODEL_EFM32GG11B510F2048GL120
    bool
    select CPU_FAM_EFM32GG11B

config CPU_MODEL_EFM32GG11B840F1024IQ64
    bool
    select CPU_FAM_EFM32GG11B

config CPU_MODEL_EFM32GG11B840F1024GM64
    bool
    select CPU_FAM_EFM32GG11B

config CPU_MODEL_EFM32GG11B820F2048IL152
    bool
    select CPU_FAM_EFM32GG11B

## Common CPU symbols
config CPU_FAM
    default "efm32gg11b" if CPU_FAM_EFM32GG11B

config CPU_MODEL
    default "efm32gg11b510f2048il120" if CPU_MODEL_EFM32GG11B510F2048IL120
    default "efm32gg11b120f2048gm64"  if CPU_MODEL_EFM32GG11B120F2048GM64
    default "efm32gg11b120f2048iq64"  if CPU_MODEL_EFM32GG11B120F2048IQ64
    default "efm32gg11b820f2048gl152" if CPU_MODEL_EFM32GG11B820F2048GL152
    default "efm32gg11b520f2048im64"  if CPU_MODEL_EFM32GG11B520F2048IM64
    default "efm32gg11b520f2048gq64"  if CPU_MODEL_EFM32GG11B520F2048GQ64
    default "efm32gg11b840f1024gl120" if CPU_MODEL_EFM32GG11B840F1024GL120
    default "efm32gg11b420f2048il120" if CPU_MODEL_EFM32GG11B420F2048IL120
    default "efm32gg11b520f2048gl120" if CPU_MODEL_EFM32GG11B520F2048GL120
    default "efm32gg11b840f1024gq64"  if CPU_MODEL_EFM32GG11B840F1024GQ64
    default "efm32gg11b840f1024im64"  if CPU_MODEL_EFM32GG11B840F1024IM64
    default "efm32gg11b820f2048gq100" if CPU_MODEL_EFM32GG11B820F2048GQ100
    default "efm32gg11b420f2048gq64"  if CPU_MODEL_EFM32GG11B420F2048GQ64
    default "efm32gg11b420f2048im64"  if CPU_MODEL_EFM32GG11B420F2048IM64
    default "efm32gg11b420f2048il112" if CPU_MODEL_EFM32GG11B420F2048IL112
    default "efm32gg11b510f2048iq100" if CPU_MODEL_EFM32GG11B510F2048IQ100
    default "efm32gg11b310f2048gl112" if CPU_MODEL_EFM32GG11B310F2048GL112
    default "efm32gg11b840f1024gl152" if CPU_MODEL_EFM32GG11B840F1024GL152
    default "efm32gg11b310f2048gq100" if CPU_MODEL_EFM32GG11B310F2048GQ100
    default "efm32gg11b510f2048gq64"  if CPU_MODEL_EFM32GG11B510F2048GQ64
    default "efm32gg11b510f2048im64"  if CPU_MODEL_EFM32GG11B510F2048IM64
    default "efm32gg11b820f2048gq64"  if CPU_MODEL_EFM32GG11B820F2048GQ64
    default "efm32gg11b820f2048gl120" if CPU_MODEL_EFM32GG11B820F2048GL120
    default "efm32gg11b820f2048im64"  if CPU_MODEL_EFM32GG11B820F2048IM64
    default "efm32gg11b420f2048iq100" if CPU_MODEL_EFM32GG11B420F2048IQ100
    default "efm32gg11b840f1024gq100" if CPU_MODEL_EFM32GG11B840F1024GQ100
    default "efm32gg11b110f2048iq64"  if CPU_MODEL_EFM32GG11B110F2048IQ64
    default "efm32gg11b110f2048gm64"  if CPU_MODEL_EFM32GG11B110F2048GM64
    default "efm32gg11b520f2048gq100" if CPU_MODEL_EFM32GG11B520F2048GQ100
    default "efm32gg11b820f2048il120" if CPU_MODEL_EFM32GG11B820F2048IL120
    default "efm32gg11b840f1024iq100" if CPU_MODEL_EFM32GG11B840F1024IQ100
    default "efm32gg11b420f2048gq100" if CPU_MODEL_EFM32GG11B420F2048GQ100
    default "efm32gg11b820f2048gl192" if CPU_MODEL_EFM32GG11B820F2048GL192
    default "efm32gg11b320f2048gl112" if CPU_MODEL_EFM32GG11B320F2048GL112
    default "efm32gg11b520f2048iq100" if CPU_MODEL_EFM32GG11B520F2048IQ100
    default "efm32gg11b110f2048gq64"  if CPU_MODEL_EFM32GG11B110F2048GQ64
    default "efm32gg11b110f2048im64"  if CPU_MODEL_EFM32GG11B110F2048IM64
    default "efm32gg11b320f2048gq100" if CPU_MODEL_EFM32GG11B320F2048GQ100
    default "efm32gg11b420f2048gl112" if CPU_MODEL_EFM32GG11B420F2048GL112
    default "efm32gg11b510f2048gq100" if CPU_MODEL_EFM32GG11B510F2048GQ100
    default "efm32gg11b820f2048iq64"  if CPU_MODEL_EFM32GG11B820F2048IQ64
    default "efm32gg11b820f2048gm64"  if CPU_MODEL_EFM32GG11B820F2048GM64
    default "efm32gg11b510f2048iq64"  if CPU_MODEL_EFM32GG11B510F2048IQ64
    default "efm32gg11b510f2048gm64"  if CPU_MODEL_EFM32GG11B510F2048GM64
    default "efm32gg11b840f1024il152" if CPU_MODEL_EFM32GG11B840F1024IL152
    default "efm32gg11b420f2048gl120" if CPU_MODEL_EFM32GG11B420F2048GL120
    default "efm32gg11b840f1024il120" if CPU_MODEL_EFM32GG11B840F1024IL120
    default "efm32gg11b520f2048gm64"  if CPU_MODEL_EFM32GG11B520F2048GM64
    default "efm32gg11b520f2048iq64"  if CPU_MODEL_EFM32GG11B520F2048IQ64
    default "efm32gg11b520f2048il120" if CPU_MODEL_EFM32GG11B520F2048IL120
    default "efm32gg11b840f1024gl192" if CPU_MODEL_EFM32GG11B840F1024GL192
    default "efm32gg11b120f2048im64"  if CPU_MODEL_EFM32GG11B120F2048IM64
    default "efm32gg11b120f2048gq64"  if CPU_MODEL_EFM32GG11B120F2048GQ64
    default "efm32gg11b820f2048iq100" if CPU_MODEL_EFM32GG11B820F2048IQ100
    default "efm32gg11b420f2048iq64"  if CPU_MODEL_EFM32GG11B420F2048IQ64
    default "efm32gg11b420f2048gm64"  if CPU_MODEL_EFM32GG11B420F2048GM64
    default "efm32gg11b510f2048gl120" if CPU_MODEL_EFM32GG11B510F2048GL120
    default "efm32gg11b840f1024iq64"  if CPU_MODEL_EFM32GG11B840F1024IQ64
    default "efm32gg11b840f1024gm64"  if CPU_MODEL_EFM32GG11B840F1024GM64
    default "efm32gg11b820f2048il152" if CPU_MODEL_EFM32GG11B820F2048IL152
```
