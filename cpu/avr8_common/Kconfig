## cpu/efm32/families/efm32gg12b/Kconfig
```kconfig
# SPDX-FileCopyrightText: 2020 HAW Hamburg
# SPDX-License-Identifier: LGPL-2.1-only

config CPU_FAM_EFM32GG12B
    bool
    select CPU_CORE_CORTEX_M4F
    select CPU_COMMON_EFM32
    select CPU_EFM32_SERIES1

## CPU Models
config CPU_MODEL_EFM32GG12B810F1024GL112
    bool
    select CPU_FAM_EFM32GG12B

config CPU_MODEL_EFM32GG12B830F512GM64
    bool
    select CPU_FAM_EFM32GG12B

config CPU_MODEL_EFM32GG12B430F512IQ100
    bool
    select CPU_FAM_EFM32GG12B

config CPU_MODEL_EFM32GG12B830F512IQ64
    bool
    select CPU_FAM_EFM32GG12B

config CPU_MODEL_EFM32GG12B830F512IL120
    bool
    select CPU_FAM_EFM32GG12B

config CPU_MODEL_EFM32GG12B390F1024GL112
    bool
    select CPU_FAM_EFM32GG12B

config CPU_MODEL_EFM32GG12B410F1024IM64
    bool
    select CPU_FAM_EFM32GG12B

config CPU_MODEL_EFM32GG12B410F1024GQ64
    bool
    select CPU_FAM_EFM32GG12B

config CPU_MODEL_EFM32GG12B130F512IQ64
    bool
    select CPU_FAM_EFM32GG12B

config CPU_MODEL_EFM32GG12B130F512GM64
    bool
    select CPU_FAM_EFM32GG12B

config CPU_MODEL_EFM32GG12B530F512IL112
    bool
    select CPU_FAM_EFM32GG12B

config CPU_MODEL_EFM32GG12B110F1024IQ64
    bool
    select CPU_FAM_EFM32GG12B

config CPU_MODEL_EFM32GG12B110F1024GM64
    bool
    select CPU_FAM_EFM32GG12B

config CPU_MODEL_EFM32GG12B530F512IQ100
    bool
    select CPU_FAM_EFM32GG12B

config CPU_MODEL_EFM32GG12B410F1024IL120
    bool
    select CPU_FAM_EFM32GG12B

config CPU_MODEL_EFM32GG12B510F1024GL120
    bool
    select CPU_FAM_EFM32GG12B

config CPU_MODEL_EFM32GG12B430F512GM64
    bool
    select CPU_FAM_EFM32GG12B

config CPU_MODEL_EFM32GG12B430F512IQ64
    bool
    select CPU_FAM_EFM32GG12B

config CPU_MODEL_EFM32GG12B510F1024GQ64
    bool
    select CPU_FAM_EFM32GG12B

config CPU_MODEL_EFM32GG12B510F1024IM64
    bool
    select CPU_FAM_EFM32GG12B

config CPU_MODEL_EFM32GG12B430F512IL112
    bool
    select CPU_FAM_EFM32GG12B

config CPU_MODEL_EFM32GG12B810F1024GQ100
    bool
    select CPU_FAM_EFM32GG12B

config CPU_MODEL_EFM32GG12B510F1024GL112
    bool
    select CPU_FAM_EFM32GG12B

config CPU_MODEL_EFM32GG12B530F512GQ64
    bool
    select CPU_FAM_EFM32GG12B

config CPU_MODEL_EFM32GG12B530F512IM64
    bool
    select CPU_FAM_EFM32GG12B

config CPU_MODEL_EFM32GG12B410F1024IL112
    bool
    select CPU_FAM_EFM32GG12B

config CPU_MODEL_EFM32GG12B810F1024IM64
    bool
    select CPU_FAM_EFM32GG12B

config CPU_MODEL_EFM32GG12B810F1024GQ64
    bool
    select CPU_FAM_EFM32GG12B

config CPU_MODEL_EFM32GG12B830F512IQ100
    bool
    select CPU_FAM_EFM32GG12B

config CPU_MODEL_EFM32GG12B430F512IL120
    bool
    select CPU_FAM_EFM32GG12B

config CPU_MODEL_EFM32GG12B830F512IL112
    bool
    select CPU_FAM_EFM32GG12B

config CPU_MODEL_EFM32GG12B810F1024GL120
    bool
    select CPU_FAM_EFM32GG12B

config CPU_MODEL_EFM32GG12B530F512IL120
    bool
    select CPU_FAM_EFM32GG12B

config CPU_MODEL_EFM32GG12B410F1024IQ100
    bool
    select CPU_FAM_EFM32GG12B

config CPU_MODEL_EFM32GG12B510F1024GQ100
    bool
    select CPU_FAM_EFM32GG12B

config CPU_MODEL_EFM32GG12B830F512GL112
    bool
    select CPU_FAM_EFM32GG12B

config CPU_MODEL_EFM32GG12B810F1024IL120
    bool
    select CPU_FAM_EFM32GG12B

config CPU_MODEL_EFM32GG12B530F512GL120
    bool
    select CPU_FAM_EFM32GG12B

config CPU_MODEL_EFM32GG12B310F1024GL112
    bool
    select CPU_FAM_EFM32GG12B

config CPU_MODEL_EFM32GG12B810F1024GM64
    bool
    select CPU_FAM_EFM32GG12B

config CPU_MODEL_EFM32GG12B810F1024IQ64
    bool
    select CPU_FAM_EFM32GG12B

config CPU_MODEL_EFM32GG12B530F512IQ64
    bool
    select CPU_FAM_EFM32GG12B

config CPU_MODEL_EFM32GG12B530F512GM64
    bool
    select CPU_FAM_EFM32GG12B

config CPU_MODEL_EFM32GG12B410F1024GQ100
    bool
    select CPU_FAM_EFM32GG12B

config CPU_MODEL_EFM32GG12B510F1024IQ100
    bool
    select CPU_FAM_EFM32GG12B

config CPU_MODEL_EFM32GG12B510F1024IL112
    bool
    select CPU_FAM_EFM32GG12B

config CPU_MODEL_EFM32GG12B410F1024GL112
    bool
    select CPU_FAM_EFM32GG12B

config CPU_MODEL_EFM32GG12B310F1024GQ100
    bool
    select CPU_FAM_EFM32GG12B

config CPU_MODEL_EFM32GG12B390F512GL112
    bool
    select CPU_FAM_EFM32GG12B

config CPU_MODEL_EFM32GG12B430F512GL120
    bool
    select CPU_FAM_EFM32GG12B

config CPU_MODEL_EFM32GG12B830F512GQ100
    bool
    select CPU_FAM_EFM32GG12B

config CPU_MODEL_EFM32GG12B530F512GQ100
    bool
    select CPU_FAM_EFM32GG12B

config CPU_MODEL_EFM32GG12B130F512GQ64
    bool
    select CPU_FAM_EFM32GG12B

config CPU_MODEL_EFM32GG12B410F1024GL120
    bool
    select CPU_FAM_EFM32GG12B

config CPU_MODEL_EFM32GG12B130F512IM64
    bool
    select CPU_FAM_EFM32GG12B

config CPU_MODEL_EFM32GG12B410F1024GM64
    bool
    select CPU_FAM_EFM32GG12B

config CPU_MODEL_EFM32GG12B410F1024IQ64
    bool
    select CPU_FAM_EFM32GG12B

config CPU_MODEL_EFM32GG12B510F1024IL120
    bool
    select CPU_FAM_EFM32GG12B

config CPU_MODEL_EFM32GG12B430F512GL112
    bool
    select CPU_FAM_EFM32GG12B

config CPU_MODEL_EFM32GG12B830F512IM64
    bool
    select CPU_FAM_EFM32GG12B

config CPU_MODEL_EFM32GG12B330F512GL112
    bool
    select CPU_FAM_EFM32GG12B

config CPU_MODEL_EFM32GG12B830F512GQ64
    bool
    select CPU_FAM_EFM32GG12B

config CPU_MODEL_EFM32GG12B810F1024IQ100
    bool
    select CPU_FAM_EFM32GG12B

config CPU_MODEL_EFM32GG12B810F1024IL112
    bool
    select CPU_FAM_EFM32GG12B

config CPU_MODEL_EFM32GG12B830F512GL120
    bool
    select CPU_FAM_EFM32GG12B

config CPU_MODEL_EFM32GG12B430F512GQ100
    bool
    select CPU_FAM_EFM32GG12B

config CPU_MODEL_EFM32GG12B330F512GQ100
    bool
    select CPU_FAM_EFM32GG12B

config CPU_MODEL_EFM32GG12B510F1024IQ64
    bool
    select CPU_FAM_EFM32GG12B

config CPU_MODEL_EFM32GG12B510F1024GM64
    bool
    select CPU_FAM_EFM32GG12B

config CPU_MODEL_EFM32GG12B430F512IM64
    bool
    select CPU_FAM_EFM32GG12B

config CPU_MODEL_EFM32GG12B430F512GQ64
    bool
    select CPU_FAM_EFM32GG12B

config CPU_MODEL_EFM32GG12B110F1024GQ64
    bool
    select CPU_FAM_EFM32GG12B

config CPU_MODEL_EFM32GG12B110F1024IM64
    bool
    select CPU_FAM_EFM32GG12B

config CPU_MODEL_EFM32GG12B530F512GL112
    bool
    select CPU_FAM_EFM32GG12B

## Common CPU symbols
config CPU_FAM
    default "efm32gg12b" if CPU_FAM_EFM32GG12B

config CPU_MODEL
    default "efm32gg12b810f1024gl112" if CPU_MODEL_EFM32GG12B810F1024GL112
    default "efm32gg12b830f512gm64"   if CPU_MODEL_EFM32GG12B830F512GM64
    default "efm32gg12b430f512iq100"  if CPU_MODEL_EFM32GG12B430F512IQ100
    default "efm32gg12b830f512iq64"   if CPU_MODEL_EFM32GG12B830F512IQ64
    default "efm32gg12b830f512il120"  if CPU_MODEL_EFM32GG12B830F512IL120
    default "efm32gg12b390f1024gl112" if CPU_MODEL_EFM32GG12B390F1024GL112
    default "efm32gg12b410f1024im64"  if CPU_MODEL_EFM32GG12B410F1024IM64
    default "efm32gg12b410f1024gq64"  if CPU_MODEL_EFM32GG12B410F1024GQ64
    default "efm32gg12b130f512iq64"   if CPU_MODEL_EFM32GG12B130F512IQ64
    default "efm32gg12b130f512gm64"   if CPU_MODEL_EFM32GG12B130F512GM64
    default "efm32gg12b530f512il112"  if CPU_MODEL_EFM32GG12B530F512IL112
    default "efm32gg12b110f1024iq64"  if CPU_MODEL_EFM32GG12B110F1024IQ64
    default "efm32gg12b110f1024gm64"  if CPU_MODEL_EFM32GG12B110F1024GM64
    default "efm32gg12b530f512iq100"  if CPU_MODEL_EFM32GG12B530F512IQ100
    default "efm32gg12b410f1024il120" if CPU_MODEL_EFM32GG12B410F1024IL120
    default "efm32gg12b510f1024gl120" if CPU_MODEL_EFM32GG12B510F1024GL120
    default "efm32gg12b430f512gm64"   if CPU_MODEL_EFM32GG12B430F512GM64
    default "efm32gg12b430f512iq64"   if CPU_MODEL_EFM32GG12B430F512IQ64
    default "efm32gg12b510f1024gq64"  if CPU_MODEL_EFM32GG12B510F1024GQ64
    default "efm32gg12b510f1024im64"  if CPU_MODEL_EFM32GG12B510F1024IM64
    default "efm32gg12b430f512il112"  if CPU_MODEL_EFM32GG12B430F512IL112
    default "efm32gg12b810f1024gq100" if CPU_MODEL_EFM32GG12B810F1024GQ100
    default "efm32gg12b510f1024gl112" if CPU_MODEL_EFM32GG12B510F1024GL112
    default "efm32gg12b530f512gq64"   if CPU_MODEL_EFM32GG12B530F512GQ64
    default "efm32gg12b530f512im64"   if CPU_MODEL_EFM32GG12B530F512IM64
    default "efm32gg12b410f1024il112" if CPU_MODEL_EFM32GG12B410F1024IL112
    default "efm32gg12b810f1024im64"  if CPU_MODEL_EFM32GG12B810F1024IM64
    default "efm32gg12b810f1024gq64"  if CPU_MODEL_EFM32GG12B810F1024GQ64
    default "efm32gg12b830f512iq100"  if CPU_MODEL_EFM32GG12B830F512IQ100
    default "efm32gg12b430f512il120"  if CPU_MODEL_EFM32GG12B430F512IL120
    default "efm32gg12b830f512il112"  if CPU_MODEL_EFM32GG12B830F512IL112
    default "efm32gg12b810f1024gl120" if CPU_MODEL_EFM32GG12B810F1024GL120
    default "efm32gg12b530f512il120"  if CPU_MODEL_EFM32GG12B530F512IL120
    default "efm32gg12b410f1024iq100" if CPU_MODEL_EFM32GG12B410F1024IQ100
    default "efm32gg12b510f1024gq100" if CPU_MODEL_EFM32GG12B510F1024GQ100
    default "efm32gg12b830f512gl112"  if CPU_MODEL_EFM32GG12B830F512GL112
    default "efm32gg12b810f1024il120" if CPU_MODEL_EFM32GG12B810F1024IL120
    default "efm32gg12b530f512gl120"  if CPU_MODEL_EFM32GG12B530F512GL120
    default "efm32gg12b310f1024gl112" if CPU_MODEL_EFM32GG12B310F1024GL112
    default "efm32gg12b810f1024gm64"  if CPU_MODEL_EFM32GG12B810F1024GM64
    default "efm32gg12b810f1024iq64"  if CPU_MODEL_EFM32GG12B810F1024IQ64
    default "efm32gg12b530f512iq64"   if CPU_MODEL_EFM32GG12B530F512IQ64
    default "efm32gg12b530f512gm64"   if CPU_MODEL_EFM32GG12B530F512GM64
    default "efm32gg12b410f1024gq100" if CPU_MODEL_EFM32GG12B410F1024GQ100
    default "efm32gg12b510f1024iq100" if CPU_MODEL_EFM32GG12B510F1024IQ100
    default "efm32gg12b510f1024il112" if CPU_MODEL_EFM32GG12B510F1024IL112
    default "efm32gg12b410f1024gl112" if CPU_MODEL_EFM32GG12B410F1024GL112
    default "efm32gg12b310f1024gq100" if CPU_MODEL_EFM32GG12B310F1024GQ100
    default "efm32gg12b390f512gl112"  if CPU_MODEL_EFM32GG12B390F512GL112
    default "efm32gg12b430f512gl120"  if CPU_MODEL_EFM32GG12B430F512GL120
    default "efm32gg12b830f512gq100"  if CPU_MODEL_EFM32GG12B830F512GQ100
    default "efm32gg12b530f512gq100"  if CPU_MODEL_EFM32GG12B530F512GQ100
    default "efm32gg12b130f512gq64"   if CPU_MODEL_EFM32GG12B130F512GQ64
    default "efm32gg12b410f1024gl120" if CPU_MODEL_EFM32GG12B410F1024GL120
    default "efm32gg12b130f512im64"   if CPU_MODEL_EFM32GG12B130F512IM64
    default "efm32gg12b410f1024gm64"  if CPU_MODEL_EFM32GG12B410F1024GM64
    default "efm32gg12b410f1024iq64"  if CPU_MODEL_EFM32GG12B410F1024IQ64
    default "efm32gg12b510f1024il120" if CPU_MODEL_EFM32GG12B510F1024IL120
    default "efm32gg12b430f512gl112"  if CPU_MODEL_EFM32GG12B430F512GL112
    default "efm32gg12b830f512im64"   if CPU_MODEL_EFM32GG12B830F512IM64
    default "efm32gg12b330f512gl112"  if CPU_MODEL_EFM32GG12B330F512GL112
    default "efm32gg12b830f512gq64"   if CPU_MODEL_EFM32GG12B830F512GQ64
    default "efm32gg12b810f1024iq100" if CPU_MODEL_EFM32GG12B810F1024IQ100
    default "efm32gg12b810f1024il112" if CPU_MODEL_EFM32GG12B810F1024IL112
    default "efm32gg12b830f512gl120"  if CPU_MODEL_EFM32GG12B830F512GL120
    default "efm32gg12b430f512gq100"  if CPU_MODEL_EFM32GG12B430F512GQ100
    default "efm32gg12b330f512gq100"  if CPU_MODEL_EFM32GG12B330F512GQ100
    default "efm32gg12b510f1024iq64"  if CPU_MODEL_EFM32GG12B510F1024IQ64
    default "efm32gg12b510f1024gm64"  if CPU_MODEL_EFM32GG12B510F1024GM64
    default "efm32gg12b430f512im64"   if CPU_MODEL_EFM32GG12B430F512IM64
    default "efm32gg12b430f512gq64"   if CPU_MODEL_EFM32GG12B430F512GQ64
    default "efm32gg12b110f1024gq64"  if CPU_MODEL_EFM32GG12B110F1024GQ64
    default "efm32gg12b110f1024im64"  if CPU_MODEL_EFM32GG12B110F1024IM64
    default "efm32gg12b530f512gl112"  if CPU_MODEL_EFM32GG12B530F512GL112
```

## cpu/efm32/families/efm32hg/Kconfig
```kconfig
# Copyright (c) 2020 HAW Hamburg
#
# This file is subject to the terms and conditions of the GNU Lesser
# General Public License v2.1. See the file LICENSE in the top level
# directory for more details.

config CPU_FAM_EFM32HG
    bool
    select CPU_CORE_CORTEX_M0PLUS
    select CPU_COMMON_EFM32
    select CPU_EFM32_SERIES0

config MODULE_CPU_EFM32HG
    bool
    depends on CPU_FAM_EFM32HG
    depends on TEST_KCONFIG
    default y
    help
        EFM32HG family-specific code.

## CPU Models
config CPU_MODEL_EFM32HG210F32
    bool
    select CPU_FAM_EFM32HG

config CPU_MODEL_EFM32HG322F32
    bool
    select CPU_FAM_EFM32HG

config CPU_MODEL_EFM32HG110F64
    bool
    select CPU_FAM_EFM32HG

config CPU_MODEL_EFM32HG350F64
    bool
    select CPU_FAM_EFM32HG

config CPU_MODEL_EFM32HG310F64
    bool
    select CPU_FAM_EFM32HG

config CPU_MODEL_EFM32HG222F64
    bool
    select CPU_FAM_EFM32HG

config CPU_MODEL_EFM32HG308F32
    bool
    select CPU_FAM_EFM32HG

config CPU_MODEL_EFM32HG321F64
    bool
    select CPU_FAM_EFM32HG

config CPU_MODEL_EFM32HG309F32
    bool
    select CPU_FAM_EFM32HG

config CPU_MODEL_EFM32HG108F32
    bool
    select CPU_FAM_EFM32HG

config CPU_MODEL_EFM32HG222F32
    bool
    select CPU_FAM_EFM32HG

config CPU_MODEL_EFM32HG310F32
    bool
    select CPU_FAM_EFM32HG

config CPU_MODEL_EFM32HG322F64
    bool
    select CPU_FAM_EFM32HG

config CPU_MODEL_EFM32HG110F32
    bool
    select CPU_FAM_EFM32HG

config CPU_MODEL_EFM32HG350F32
    bool
    select CPU_FAM_EFM32HG

config CPU_MODEL_EFM32HG210F64
    bool
    select CPU_FAM_EFM32HG

config CPU_MODEL_EFM32HG309F64
    bool
    select CPU_FAM_EFM32HG

config CPU_MODEL_EFM32HG108F64
    bool
    select CPU_FAM_EFM32HG

config CPU_MODEL_EFM32HG321F32
    bool
    select CPU_FAM_EFM32HG

config CPU_MODEL_EFM32HG308F64
    bool
    select CPU_FAM_EFM32HG

## Common CPU symbols
config CPU_FAM
    default "efm32hg" if CPU_FAM_EFM32HG

config CPU_MODEL
    default "efm32hg210f32" if CPU_MODEL_EFM32HG210F32
    default "efm32hg322f32" if CPU_MODEL_EFM32HG322F32
    default "efm32hg110f64" if CPU_MODEL_EFM32HG110F64
    default "efm32hg350f64" if CPU_MODEL_EFM32HG350F64
    default "efm32hg310f64" if CPU_MODEL_EFM32HG310F64
    default "efm32hg222f64" if CPU_MODEL_EFM32HG222F64
    default "efm32hg308f32" if CPU_MODEL_EFM32HG308F32
    default "efm32hg321f64" if CPU_MODEL_EFM32HG321F64
    default "efm32hg309f32" if CPU_MODEL_EFM32HG309F32
    default "efm32hg108f32" if CPU_MODEL_EFM32HG108F32
    default "efm32hg222f32" if CPU_MODEL_EFM32HG222F32
    default "efm32hg310f32" if CPU_MODEL_EFM32HG310F32
    default "efm32hg322f64" if CPU_MODEL_EFM32HG322F64
    default "efm32hg110f32" if CPU_MODEL_EFM32HG110F32
    default "efm32hg350f32" if CPU_MODEL_EFM32HG350F32
    default "efm32hg210f64" if CPU_MODEL_EFM32HG210F64
    default "efm32hg309f64" if CPU_MODEL_EFM32HG309F64
    default "efm32hg108f64" if CPU_MODEL_EFM32HG108F64
    default "efm32hg321f32" if CPU_MODEL_EFM32HG321F32
    default "efm32hg308f64" if CPU_MODEL_EFM32HG308F64
```
