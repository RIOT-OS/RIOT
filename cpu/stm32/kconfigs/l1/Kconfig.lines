## cpu/stm32/kconfigs/l4/Kconfig
```kconfig
# Copyright (c) 2020 Inria
#
# This file is subject to the terms and conditions of the GNU Lesser
# General Public License v2.1. See the file LICENSE in the top level
# directory for more details.
#

config CPU_FAM_L4
    bool
    select CPU_STM32
    select CPU_CORE_CORTEX_M4F

config CPU_FAM
    default "l4" if CPU_FAM_L4
```

## cpu/stm32/kconfigs/l4/Kconfig.clk
```kconfig
# SPDX-FileCopyrightText: 2022 HAW Hamburg
# SPDX-License-Identifier: LGPL-2.1-only

rsource '../g4l4l5/Kconfig.clk'
rsource '../l4l5wx/Kconfig.clk'

if CPU_FAM_L4

config CLOCK_PLL_M
    int "M: PLLIN division factor" if CUSTOM_PLL_PARAMS
    default 6 if CLOCK_PLL_SRC_MSI
    default 2
    range 1 8

config CLOCK_PLL_N
    int "N: PLLIN multiply factor" if CUSTOM_PLL_PARAMS
    default 30 if CPU_LINE_STM32L4A6XX || CPU_LINE_STM32L4P5XX || CPU_LINE_STM32L4Q5XX || CPU_LINE_STM32L4R5XX || CPU_LINE_STM32L4R7XX || CPU_LINE_STM32L4R9XX || CPU_LINE_STM32L4S5XX || CPU_LINE_STM32L4S7XX || CPU_LINE_STM32L4S9XX
    default 20
    range 8 86

endif # CPU_FAM_L4
```

## cpu/stm32/kconfigs/l4l5wx/Kconfig.clk
```kconfig
# Copyright (c) 2022 HAW Hamburg
#
# This file is subject to the terms and conditions of the GNU Lesser
# General Public License v2.1. See the file LICENSE in the top level
# directory for more details.
#

if CPU_FAM_L4 || CPU_FAM_L5 || CPU_FAM_WB || CPU_FAM_WL

config USE_CLOCK_MSI
    bool "Use direct multi-speed frequency internal oscillator (MSI)"

choice
bool "Desired MSI clock frequency" if USE_CLOCK_MSI || (USE_CLOCK_PLL && CLOCK_PLL_SRC_MSI)
default CLOCK_MSI_48MHZ

config CLOCK_MSI_100KHZ
    bool "100kHz"

config CLOCK_MSI_200KHZ
    bool "200kHz"

config CLOCK_MSI_400KHZ
    bool "400kHz"

config CLOCK_MSI_800KHZ
    bool "800kHz"

config CLOCK_MSI_1MHZ
    bool
    prompt "1MHz"

config CLOCK_MSI_2MHZ
    bool
    prompt "2MHz"

config CLOCK_MSI_4MHZ
    bool
    prompt "4MHz"

config CLOCK_MSI_8MHZ
    bool "8MHz"

config CLOCK_MSI_16MHZ
    bool "16MHz"

config CLOCK_MSI_24MHZ
    bool "24MHz"

config CLOCK_MSI_32MHZ
    bool "32MHz"

config CLOCK_MSI_48MHZ
    bool "48MHz"

endchoice

config CLOCK_MSI
    int
    default 65536 if CLOCK_MSI_65KHZ
    default 131072 if CLOCK_MSI_130KHZ
    default 262144 if CLOCK_MSI_260KHZ
    default 524288 if CLOCK_MSI_520KHZ
    default 100000 if CLOCK_MSI_100KHZ
    default 200000 if CLOCK_MSI_200KHZ
    default 400000 if CLOCK_MSI_400KHZ
    default 800000 if CLOCK_MSI_800KHZ
    default 1000000 if CLOCK_MSI_1MHZ
    default 2000000 if CLOCK_MSI_2MHZ
    default 4000000 if CLOCK_MSI_4MHZ
    default 8000000 if CLOCK_MSI_8MHZ
    default 16000000 if CLOCK_MSI_16MHZ
    default 24000000 if CLOCK_MSI_24MHZ
    default 32000000 if CLOCK_MSI_32MHZ
    default 48000000 if CLOCK_MSI_48MHZ


choice
bool "Source clock for PLL" if USE_CLOCK_PLL
default CLOCK_PLL_SRC_HSE if BOARD_HAS_HSE
default CLOCK_PLL_SRC_MSI

config CLOCK_PLL_SRC_MSI
    bool "Use MSI source clock"

config CLOCK_PLL_SRC_HSE
    bool "Use HSE source clock"
    depends on BOARD_HAS_HSE

config CLOCK_PLL_SRC_HSI
    bool "Use HSI16 source clock"
endchoice

endif # CPU_FAM_L4 || CPU_FAM_L5 || CPU_FAM_WB || CPU_FAM_WL
```

## cpu/stm32/kconfigs/l5/Kconfig
```kconfig
# Copyright (c) 2020 Inria
#
# This file is subject to the terms and conditions of the GNU Lesser
# General Public License v2.1. See the file LICENSE in the top level
# directory for more details.
#

config CPU_FAM_L5
    bool
    select CPU_STM32
    select CPU_CORE_CORTEX_M33
    select HAS_CPU_STM32L5
    select HAS_PERIPH_FLASHPAGE
    select HAS_PERIPH_FLASHPAGE_PAGEWISE
    select HAS_PERIPH_HWRNG

config CPU_FAM
    default "l5" if CPU_FAM_L5

config HAS_CPU_STM32L5
    bool
    help
        Indicates that the cpu being used belongs to the 'stm32l5' family.
```

## cpu/stm32/kconfigs/l5/Kconfig.clk
```kconfig
# SPDX-FileCopyrightText: 2022 HAW Hamburg
# SPDX-License-Identifier: LGPL-2.1-only

rsource '../g4l4l5/Kconfig.clk'
rsource '../l4l5wx/Kconfig.clk'

if CPU_FAM_L5

config CLOCK_PLL_M
    int "M: PLLIN division factor" if CUSTOM_PLL_PARAMS
    default 6 if CLOCK_PLL_SRC_MSI
    default 2
    range 1 8

config CLOCK_PLL_N
    int "N: PLLIN multiply factor" if CUSTOM_PLL_PARAMS
    default 27 if CPU_FAM_L5
    range 8 86

endif # CPU_FAM_L5
```

## cpu/stm32/kconfigs/l5/Kconfig.lines
```kconfig
# SPDX-FileCopyrightText: 2020 Inria
# SPDX-License-Identifier: LGPL-2.1-only

# CPU lines
config CPU_LINE_STM32L552XX
    bool
    select CPU_FAM_L5

config CPU_LINE_STM32L562XX
    bool
    select CPU_FAM_L5
```

## cpu/stm32/kconfigs/mp1/Kconfig
```kconfig
# SPDX-FileCopyrightText: 2020 Savoir-faire Linux
# SPDX-License-Identifier: LGPL-2.1-only

config CPU_FAM_MP1
    bool
    select CPU_STM32
    select CPU_CORE_CORTEX_M4F

config CPU_FAM
    default "mp1" if CPU_FAM_MP1
```

## cpu/stm32/kconfigs/mp1/Kconfig.clk
```kconfig
# SPDX-FileCopyrightText: 2022 HAW Hamburg
# SPDX-License-Identifier: LGPL-2.1-only

rsource '../f2f4f7mp1/Kconfig.clk'
rsource '../g0wxmp1/Kconfig.clk'

if CPU_FAM_MP1

config CLOCK_PLL_M
    int "M: PLLIN division factor" if CUSTOM_PLL_PARAMS
    default 2
    range 1 64

config CLOCK_PLL_N
    int "N: PLLIN multiply factor" if CUSTOM_PLL_PARAMS
    default 52 if BOARD_HAS_HSE
    default 78
    range 4 512

endif # CPU_FAM_MP1
```

## cpu/stm32/kconfigs/mp1/Kconfig.lines
```kconfig
# SPDX-FileCopyrightText: 2020 Savoir-faire Linux
# SPDX-License-Identifier: LGPL-2.1-only

# CPU lines
config CPU_LINE_STM32MP157CXX
    bool
    select CPU_FAM_MP1
```

## cpu/stm32/kconfigs/mp1/Kconfig.models
```kconfig
# SPDX-FileCopyrightText: 2020 Savoir-faire Linux
# SPDX-License-Identifier: LGPL-2.1-only

# CPU models
config CPU_MODEL_STM32MP157CAC
    bool
    select CPU_LINE_STM32MP157CXX

# Configure CPU model
config CPU_MODEL
    default "stm32mp157cac" if CPU_MODEL_STM32MP157CAC
```

## cpu/stm32/kconfigs/u3/Kconfig
```kconfig
# SPDX-FileCopyrightText: 2026 Technische Universität Hamburg
# SPDX-License-Identifier: LGPL-2.1-only

config CPU_FAM_U3
    bool
    select CPU_STM32
    select CPU_CORE_CORTEX_M33

config CPU_FAM
    default "u3" if CPU_FAM_U3
```

## cpu/stm32/kconfigs/u3/Kconfig.lines
```kconfig
/*
 * SPDX-FileCopyrightText: 2026 Adarsh Nair Mullachery
 * SPDX-License-Identifier: LGPL-2.1-only
 */


# CPU lines
config CPU_LINE_STM32U385XX
    bool
    select CPU_FAM_U3
```

## cpu/stm32/kconfigs/u3/Kconfig.models
```kconfig
# SPDX-FileCopyrightText: 2026 Technische Universität Hamburg
# SPDX-License-Identifier: LGPL-2.1-only

# CPU models

config CPU_MODEL_STM32U385CG
    bool
    select CPU_LINE_STM32U385XX

config CPU_MODEL_STM32U385KG
    bool
    select CPU_LINE_STM32U385XX

config CPU_MODEL_STM32U385RG
    bool
    select CPU_LINE_STM32U385XX

config CPU_MODEL_STM32U385VG
    bool
    select CPU_LINE_STM32U385XX

# Configure CPU model

config CPU_MODEL
    default "stm32u385cg" if CPU_MODEL_STM32U385CG
    default "stm32u385kg" if CPU_MODEL_STM32U385KG
    default "stm32u385rg" if CPU_MODEL_STM32U385RG
    default "stm32u385vg" if CPU_MODEL_STM32U385VG
```

## cpu/stm32/kconfigs/u5/Kconfig
```kconfig
# SPDX-FileCopyrightText: 2021 Inria
# SPDX-License-Identifier: LGPL-2.1-only

config CPU_FAM_U5
    bool
    select CPU_STM32
    select CPU_CORE_CORTEX_M33

config CPU_FAM
    default "u5" if CPU_FAM_U5
```

## cpu/stm32/kconfigs/wb/Kconfig
```kconfig
# SPDX-FileCopyrightText: 2020 Inria
# SPDX-License-Identifier: LGPL-2.1-only

config CPU_FAM_WB
    bool
    select CPU_STM32
    select CPU_CORE_CORTEX_M4

config CPU_FAM
    default "wb" if CPU_FAM_WB
```

## cpu/stm32/kconfigs/wb/Kconfig.clk
```kconfig
# SPDX-FileCopyrightText: 2022 HAW Hamburg
# SPDX-License-Identifier: LGPL-2.1-only

rsource '../l4l5wx/Kconfig.clk'
rsource '../g0wxmp1/Kconfig.clk'

if CPU_FAM_WB

config CLOCK_PLL_M
    int "M: PLLIN division factor" if CUSTOM_PLL_PARAMS
    default 6 if CLOCK_PLL_SRC_MSI
    default 4 if CLOCK_PLL_SRC_HSE
    default 2
    range 1 8

config CLOCK_PLL_N
    int "N: PLLIN multiply factor" if CUSTOM_PLL_PARAMS
    default 16
    range 6 127

endif # CPU_FAM_WB
```

## cpu/stm32/kconfigs/wl/Kconfig
```kconfig
# SPDX-FileCopyrightText: 2021 Inria
# SPDX-FileCopyrightText: 2021 Freie Universität Berlin
# SPDX-License-Identifier: LGPL-2.1-only

config CPU_FAM_WL
    bool
    select CPU_STM32
    select CPU_CORE_CORTEX_M4

config CPU_FAM
    default "wl" if CPU_FAM_WL

config STM32_WL55JC_SUBGHZ_DEBUG
     bool "STM32WL->Enable Hardware Debugging"
     help
        Enable Hardware debug pins. This would affect onboard peripherals such as SPI
        as the pins are multiplexed. For more information check Alternate Functions
        column in Table 19 : STM32WL55/54xx pin definition in STM32WL55/54xx
        datasheet.
```
