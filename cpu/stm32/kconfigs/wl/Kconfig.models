## cpu/stm32/lcd_fmc/Kconfig
```kconfig
# Copyright (c) 2023 Gunar Schorcht
#
# This file is subject to the terms and conditions of the GNU Lesser
# General Public License v2.1. See the file LICENSE in the top level
# directory for more details.
#

config MODULE_LCD_FMC
    bool
    depends on MODULE_LCD
    select MODULE_PERIPH_FMC
    select MODULE_PERIPH_FMC_NOR_SRAM
    default y if HAVE_LCD_PARALLEL_LL_MCU
```

## cpu/stm32/periph/Kconfig
```kconfig
# Copyright (c) 2021 HAW Hamburg
#
# This file is subject to the terms and conditions of the GNU Lesser
# General Public License v2.1. See the file LICENSE in the top level
# directory for more details.
#

config MODULE_PERIPH
    bool
    default y
    select MODULE_ZTIMER if MODULE_PERIPH_USBDEV
    select MODULE_ZTIMER_MSEC if MODULE_PERIPH_USBDEV
    # Whole STM32 families F2, F4, F7, H7 and U5 use the Synopsys DWC2 USB OTG core
    select MODULE_USBDEV_SYNOPSYS_DWC2 if MODULE_PERIPH_USBDEV && HAS_CPU_STM32F2
    select MODULE_USBDEV_SYNOPSYS_DWC2 if MODULE_PERIPH_USBDEV && HAS_CPU_STM32F4
    select MODULE_USBDEV_SYNOPSYS_DWC2 if MODULE_PERIPH_USBDEV && HAS_CPU_STM32F7
    select MODULE_USBDEV_SYNOPSYS_DWC2 if MODULE_PERIPH_USBDEV && HAS_CPU_STM32H7
    select MODULE_USBDEV_SYNOPSYS_DWC2 if MODULE_PERIPH_USBDEV && HAS_CPU_STM32U5
    # STM32F105xx and STM32F107xx lines also use the Synopsys DWC2 USB OTG core
    select MODULE_USBDEV_SYNOPSYS_DWC2 if MODULE_PERIPH_USBDEV && CPU_LINE_STM32F105XC
    select MODULE_USBDEV_SYNOPSYS_DWC2 if MODULE_PERIPH_USBDEV && CPU_LINE_STM32F107XC
    # Several lines of STM32L4 family also use the Synopsys DWC2 USB OTG core
    select MODULE_USBDEV_SYNOPSYS_DWC2 if MODULE_PERIPH_USBDEV && CPU_LINE_STM32L475XX
    select MODULE_USBDEV_SYNOPSYS_DWC2 if MODULE_PERIPH_USBDEV && CPU_LINE_STM32L476XX
    select MODULE_USBDEV_SYNOPSYS_DWC2 if MODULE_PERIPH_USBDEV && CPU_LINE_STM32L485XX
    select MODULE_USBDEV_SYNOPSYS_DWC2 if MODULE_PERIPH_USBDEV && CPU_LINE_STM32L486XX
    select MODULE_USBDEV_SYNOPSYS_DWC2 if MODULE_PERIPH_USBDEV && CPU_LINE_STM32L496XX
    select MODULE_USBDEV_SYNOPSYS_DWC2 if MODULE_PERIPH_USBDEV && CPU_LINE_STM32L4A6XX
    select MODULE_USBDEV_SYNOPSYS_DWC2 if MODULE_PERIPH_USBDEV && CPU_LINE_STM32L4P5XX
    select MODULE_USBDEV_SYNOPSYS_DWC2 if MODULE_PERIPH_USBDEV && CPU_LINE_STM32L4Q5XX
    select MODULE_USBDEV_SYNOPSYS_DWC2 if MODULE_PERIPH_USBDEV && CPU_LINE_STM32L4R5XX
    select MODULE_USBDEV_SYNOPSYS_DWC2 if MODULE_PERIPH_USBDEV && CPU_LINE_STM32L4R7XX
    select MODULE_USBDEV_SYNOPSYS_DWC2 if MODULE_PERIPH_USBDEV && CPU_LINE_STM32L4R9XX
    select MODULE_USBDEV_SYNOPSYS_DWC2 if MODULE_PERIPH_USBDEV && CPU_LINE_STM32L4S5XX
    select MODULE_USBDEV_SYNOPSYS_DWC2 if MODULE_PERIPH_USBDEV && CPU_LINE_STM32L4S7XX
    select MODULE_USBDEV_SYNOPSYS_DWC2 if MODULE_PERIPH_USBDEV && CPU_LINE_STM32L4S9XX
    help
        stm32 common peripheral code.

config MODULE_PERIPH_UART_NONBLOCKING
    depends on HAS_PERIPH_UART_NONBLOCKING
    depends on MODULE_PERIPH_UART
    select MODULE_TSRB

config MODULE_PERIPH_CAN
    bool
    depends on HAS_PERIPH_CAN
    depends on HAS_PERIPH_GPIO
    depends on HAS_PERIPH_GPIO_IRQ
    select MODULE_PERIPH_GPIO_IRQ
    select MODULE_PERIPH_I2C
    help
        STM32 CAN peripheral controller.

config MODULE_PERIPH_ADC
    bool "ADC peripheral driver"
    depends on HAS_PERIPH_ADC
    select MODULE_ZTIMER if HAS_CPU_STM32F3 || HAS_CPU_STM32L4 || HAS_CPU_STM32WL
    select MODULE_ZTIMER_MSEC if HAS_CPU_STM32F3 || HAS_CPU_STM32L4 || HAS_CPU_STM32WL
    select MODULE_PERIPH_COMMON

config MODULE_PERIPH_LTDC
    bool "LTDC peripheral driver"
    depends on HAS_PERIPH_LTDC
    help
        STM32 LCD-TFT Display controller
```

## cpu/stm32/periph/Kconfig.eth
```kconfig
# Copyright (c) 2022 HAW Hamburg
#
# This file is subject to the terms and conditions of the GNU Lesser
# General Public License v2.1. See the file LICENSE in the top level
# directory for more details.
#

menuconfig MODULE_STM32_ETH
    bool
    prompt "STM32 ethernet peripheral" if !(HAVE_STM32_ETH && MODULE_NETDEV_DEFAULT)
    default (HAVE_STM32_ETH && MODULE_NETDEV_DEFAULT)
    depends on TEST_KCONFIG
    depends on CPU_STM32
    depends on HAS_PERIPH_ETH
    select MODULE_PERIPH_ETH
    select MODULE_NETDEV_ETH
    select MODULE_NETDEV_LEGACY_API
    select MODULE_IOLIST
    select MODULE_ZTIMER
    select MODULE_ZTIMER_MSEC

if MODULE_STM32_ETH

config MODULE_STM32_ETH_AUTO
    bool "Link auto-negotiation"
    select MODULE_STM32_ETH_LINK_UP
    help
        Say y to enable link auto-negotiation. In general, it is highly
        recommended to use auto-negotiation, as this can avoid various
        communication issues on the PHY layer due to configuration mismatch of
        the link partners. Note that this feature depends on the link state
        events feature.

config MODULE_STM32_ETH_LINK_UP
    bool "Link state events"
    help
        Say y to enable link events.

endif # MODULE_STM32_ETH

config MODULE_PERIPH_ETH
    bool
    depends on HAS_PERIPH_ETH
    select MODULE_PERIPH_ETH_COMMON if CPU_STM32

config MODULE_PERIPH_ETH_COMMON
    bool

config HAVE_STM32_ETH
    bool
    help
        Indicates that a stm32 ethernet peripheral is present.
```

## cpu/stm32/periph/Kconfig.fmc
```kconfig
# Copyright (c) 2023 Gunar Schorcht
#
# This file is subject to the terms and conditions of the GNU Lesser
# General Public License v2.1. See the file LICENSE in the top level
# directory for more details.
#

menuconfig MODULE_PERIPH_FMC
    bool "FMC/FSMC peripheral driver"
    depends on TEST_KCONFIG
    depends on HAS_PERIPH_FMC
    help
        STM32 FMC/FSMC controller

if MODULE_PERIPH_FMC

config MODULE_PERIPH_FMC_NOR_SRAM
    bool "NOR/PSRAM/SRAM support"
    depends on HAS_PERIPH_FMC_NOR_SRAM
    help
        Enables NOR Flash, PSRAM and SRAM support of the STM32 FMC/FSMC
        driver.

config MODULE_PERIPH_FMC_SDRAM
    bool "SDRAM support"
    depends on HAS_PERIPH_FMC_SDRAM
    help
        Enables SDRAM support of the STM32 FMC/FSMC driver.

config MODULE_PERIPH_FMC_16BIT
    bool
    default y if HAS_PERIPH_FMC_16BIT
    help
        Enables 16-bit data bus support of the STM32 FMC/FSMC driver.

config MODULE_PERIPH_FMC_32BIT
    bool
    default y if HAS_PERIPH_FMC_32BIT
    help
        Enables 32-bit data bus support of the STM32 FMC/FSMC driver.

config MODULE_PERIPH_INIT_FMC
    bool "Auto initialize STM32 FMC/FMSC peripheral"
    default y if MODULE_PERIPH_INIT

config MODULE_PERIPH_INIT_FMC_NOR_SRAM
    bool "Auto initialize NOR/PSRAM/SRAM support"
    default y if MODULE_PERIPH_INIT
    depends on MODULE_PERIPH_FMC_NOR_SRAM

config MODULE_PERIPH_INIT_FMC_SDRAM
    bool "Auto initialize SDRAM support"
    default y if MODULE_PERIPH_INIT
    depends on MODULE_PERIPH_FMC_SDRAM

config MODULE_PERIPH_INIT_FMC_16BIT
    bool "Auto initialize 16-bit data bus"
    default y if MODULE_PERIPH_INIT
    depends on MODULE_PERIPH_FMC_16BIT

config MODULE_PERIPH_INIT_FMC_32BIT
    bool "Auto initialize 32-bit data bus"
    default y if MODULE_PERIPH_INIT
    depends on MODULE_PERIPH_FMC_32BIT

endif

config HAS_PERIPH_FMC
    bool
    help
        Indicates that a STM32 FMC/FSMC peripheral is present.

config HAS_PERIPH_FMC_NOR_SRAM
    bool
    select HAS_PERIPH_FMC
    help
        Indicates that a NOR Flash, PSRAM or SRAM connected to the
        STM32 FMC/FSMC peripheral is present.

config HAS_PERIPH_FMC_SDRAM
    bool
    select HAS_PERIPH_FMC
    help
        Indicates that a SDRAM connected to the STM32 FMC/FSMC peripheral
        is present.

config HAS_PERIPH_FMC_16BIT
    bool
    select HAS_PERIPH_FMC
    help
        Indicates that the STM32 FMC/FSMC peripheral uses a 16-bit data bus.

config HAS_PERIPH_FMC_32BIT
    bool
    select HAS_PERIPH_FMC
    help
        Indicates that the STM32 FMC/FSMC peripheral uses a 32-bit data bus.
```

## dist/tools/kconfiglib/examples/disable_external_default/Kconfig
```kconfig
config MODULE_FOO
    bool "Foo"
    depends on FOO_DEP

module = FOO
rsource "Kconfig.template.disable_default"

config MODULE_DEFAULT_FOO
    bool "Enable FOO by default"
    select DEFAULT_FOO

config MODULE_OTHER_DEFAULT_FOO
    bool "Another module that enables FOO by default"
    select DEFAULT_FOO

config MODULE_DISABLE_FOO
    bool "Disable FOO defaults"
    select DISABLE_FOO

config FOO_DEP
    bool "Foo dependency"
```

## dist/tools/kconfiglib/examples/disable_external_default/Kconfig.template.disable_default_module
```kconfig
config DISABLE_$(module)
    bool

config DEFAULT_$(module)
    bool
    imply MODULE_$(module) if !DISABLE_$(module)
```

## dist/tools/kconfiglib/examples/disable_external_default/Kconfig.template.disable_default_package
```kconfig
config DISABLE_$(module)
    bool

config DEFAULT_$(module)
    bool
    imply PACKAGE_$(module) if !DISABLE_$(module)
```

## dist/tools/kconfiglib/examples/select_specific_implementation_from_module/Kconfig
```kconfig
config MODULE_BAR_0
    bool "Module Bar 0"
    select MODULE_FOO
    select REQUIRES_FOO_0
    help
        This specifically brings in the 0 implementation of FOO.

config MODULE_BAR_1
    bool "Module Bar 1"
    select MODULE_FOO
    select REQUIRES_FOO_1
    help
        This specifically brings in the 1 implementation of FOO.

config MODULE_BAR_1_2
    bool "Module Bar 1 2"
    select MODULE_FOO
    select REQUIRES_FOO_1_2
    help
        This specifically brings in the 1 or 2 implementation of FOO.

config BOARD_HAS_FOO_2
    bool "Example of HAS_FOO_2"
    select HAS_FOO_2

menuconfig MODULE_FOO
    bool "Module FOO"

if MODULE_FOO

config ERROR_FOO
    bool
    default y if !MODULE_FOO_0 && REQUIRES_FOO_0
    default y if !MODULE_FOO_1 && REQUIRES_FOO_1
    default y if !MODULE_FOO_2 && REQUIRES_FOO_2
    default y if !PROVIDES_FOO && REQUIRES_FOO_1_2

choice FOO_IMPLEMENTATION
    bool
    prompt "FOO Implementation"
    default MODULE_FOO_0 if REQUIRES_FOO_0
    default MODULE_FOO_1 if REQUIRES_FOO_1 || REQUIRES_FOO_1_2
    default MODULE_FOO_2 if REQUIRES_FOO_2 || REQUIRES_FOO_1_2
    default MODULE_FOO_0 if HAS_FOO_0
    default MODULE_FOO_1 if HAS_FOO_1
    default MODULE_FOO_2 if HAS_FOO_2

config MODULE_FOO_0
    bool "Implementation 0"

config MODULE_FOO_1
    bool "Implementation 1"
    select PROVIDES_FOO

config MODULE_FOO_2
    bool "Implementation 2"
    select PROVIDES_FOO

endchoice # FOO_IMPLEMENTATION
endif # MODULE_FOO

# All REQUIRES_*, HAS_* and PROVIDES_* should be defined outside of the module
# so anything can select it

# If multiple implementations can provide a feature we can use PROVIDE instead
# of a long list of A && B && ...
config PROVIDE_FOO
    bool

config REQUIRES_FOO_0
    bool

config REQUIRES_FOO_1
    bool

config REQUIRES_FOO_2
    bool

config REQUIRES_FOO_1_2
    bool

config HAS_FOO_0
    bool

config HAS_FOO_1
    bool

config HAS_FOO_2
    bool
```

## dist/tools/kconfiglib/examples/select_specific_implementation_from_module/Kconfig.generated
```kconfig
menuconfig MODULE_FOO
    bool "Module FOO"

if MODULE_FOO

config ERROR_FOO
    bool
    default y if !MODULE_FOO_0 && REQUIRES_FOO_0
    default y if !MODULE_FOO_1 && REQUIRES_FOO_1
    default y if !MODULE_FOO_2 && REQUIRES_FOO_2
    default y if !REQUIRES_FOO_N && REQUIRES_FOO_N

choice FOO_IMPLEMENTATION
    bool
    prompt "FOO Implementation"
    default MODULE_FOO_0 if REQUIRES_FOO_0
    default MODULE_FOO_1 if REQUIRES_FOO_1 || REQUIRES_FOO_N
    default MODULE_FOO_2 if REQUIRES_FOO_2 || REQUIRES_FOO_N
    default MODULE_FOO_0 if HAS_FOO_0
    default MODULE_FOO_1 if HAS_FOO_1
    default MODULE_FOO_2 if HAS_FOO_2

config MODULE_FOO_0
    bool "Implementation 0"

config MODULE_FOO_1
    bool "Implementation 1"
    select PROVIDE_FOO

config MODULE_FOO_2
    bool "Implementation 2"
    select PROVIDE_FOO

endchoice # FOO_IMPLEMENTATION
endif # MODULE_FOO

# All REQUIRES_*, HAS_* and PROVIDE_* should be defined outside of the module
# so anything can select it

# If multiple implementations can provide a feature we can use PROVIDE instead
# of a long list of A && B && ...
config PROVIDE_FOO_N
    bool

config REQUIRES_FOO_0
    bool

config REQUIRES_FOO_1
    bool

config REQUIRES_FOO_2
    bool

config REQUIRES_FOO_N
    bool

config HAS_FOO_0
    bool

config HAS_FOO_1
    bool

config HAS_FOO_2
    bool
```

## dist/tools/kconfiglib/examples/select_specific_implementation_from_module/Kconfig.use_case.choice_error
```kconfig
config BOARD
    bool
    default y
    select HAS_STDIO_USB
    select HAS_PERIPH_UART
    select HAS_PERIPH_USB

config HAS_PERIPH_UART
    bool

config HAS_PERIPH_USB
    bool

config HAS_STDIO_USB
    bool

###############################################################################
config APP
    bool
    default y
    select MODULE_STDIO

###############################################################################
menuconfig MODULE_STDIO
    bool "Enable STDIO"

if MODULE_STDIO

choice STDIO_IMPL
    bool "STDIO implementation"
    default MODULE_STDIO_UART if HAS_STDIO_UART
    default MODULE_STDIO_USB if HAS_STDIO_USB

config MODULE_STDIO_UART
    bool "UART"
    depends on HAS_PERIPH_UART

config MODULE_STDIO_USB
    bool "USB"
    depends on HAS_PERIPH_USB
    select MODULE_USB
    select REQUIRES_USB_CDC_ACM

endchoice # STDIO_IMPL

endif # MODULE_STDIO

###############################################################################
menuconfig MODULE_USB
    bool "Enable USB"

if MODULE_USB

choice USB_IMPL
    bool "USB implementation"

###############
menuconfig MODULE_MIN_USB
    bool "A basic USB stack"
    depends on !REQUIRES_USB_CDC_ACM

if MODULE_MIN_USB

config MODULE_USB_MSD
    bool "Enable USB MSD"

endif # MODULE_MIN_USB

###############
menuconfig MODULE_RIOT_USB
    bool "RIOT USB stack"
    depends on HAS_PERIPH_USB
    select MODULE_RIOT_USB_CDC_ACM if REQUIRES_USB_CDC_ACM
    depends on MISSING_DEP

if MODULE_RIOT_USB

config MODULE_RIOT_USB_CDC_ACM
    bool "Enable USB ACM CDC"

config MODULE_RIOT_USB_MSD
    bool "Enable USB MSD"

endif # MODULE_RIOT_USB

###############
menuconfig PACKAGE_USB
    bool "External USB stack"
    depends on HAS_PERIPH_USB
    depends on MISSING_DEP
    select MODULE_PACKAGE_USB_CDC_ACM if REQUIRES_USB_CDC_ACM

if PACKAGE_USB

config MODULE_PACKAGE_USB_CDC_ACM
    bool "Enable USB ACM CDC"

config MODULE_PACKAGE_USB_MSD
    bool "Enable USB MSD"

endif # PACKAGE_USB

###############
config ERROR_USB_IMPL
    bool "Missing implementation."
    help
        The selected USB implementation does not provide USB CDC ACM support.
        Please select a USB implementation that provides this feature.

endchoice # USB_IMPL

endif # MODULE_USB

config REQUIRES_USB_CDC_ACM
    bool

###############################################################################

config MISSING_DEP
    bool "Missing dependency"
```

## dist/tools/kconfiglib/tests/Kconfig.test
```kconfig
config APPLICATION
    bool
    default y
    depends on MODULE_FOO

config MODULE_FOO
    bool "The Foo"

config MODULE_BAR
    bool "The Bar"
    depends on MODULE_BAZ

config MODULE_BAZ
    bool "The Baz"

choice
    bool "Options"

config OPT_1
    bool "1"

config OPT_2
    bool "2"
    depends on MODULE_BAZ

config OPT_3
    bool "3"

endchoice
```
