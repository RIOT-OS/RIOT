## drivers/Kconfig
```kconfig
# SPDX-FileCopyrightText: 2020 HAW Hamburg
# SPDX-License-Identifier: LGPL-2.1-only

menu "Drivers"

menu "Actuator Device Drivers"
rsource "dfplayer/Kconfig"
rsource "motor_driver/Kconfig"
endmenu # Actuator Device Drivers

menu "Display Device Drivers"
rsource "ili9341/Kconfig"
rsource "lcd/Kconfig"
rsource "st77xx/Kconfig"
rsource "touch_dev_gestures/Kconfig"
endmenu # Display Device Drivers

menu "Miscellaneous Device Drivers"
rsource "at/Kconfig"
endmenu # Miscellaneous Device Drivers

rsource "Kconfig.net"

menu "Peripherals drivers"
rsource "periph_common/Kconfig"
endmenu # Peripherals drivers

menu "Sensor Device Drivers"
rsource "ads101x/Kconfig"
rsource "bmx055/Kconfig"
rsource "fxos8700/Kconfig"
rsource "gp2y10xx/Kconfig"
rsource "hdc1000/Kconfig"
rsource "hm330x/Kconfig"
rsource "hsc/Kconfig"
rsource "isl29020/Kconfig"
rsource "l3g4200d/Kconfig"
rsource "l3gxxxx/Kconfig"
rsource "lm75/Kconfig"
rsource "lpsxxx/Kconfig"
rsource "mag3110/Kconfig"
rsource "matrix_keypad/Kconfig"
rsource "mma8x5x/Kconfig"
rsource "opt3001/Kconfig"
rsource "paa5100je/Kconfig"
rsource "seesaw_soil/Kconfig"
rsource "sht2x/Kconfig"
rsource "sm_pwm_01c/Kconfig"
rsource "sps30/Kconfig"
rsource "tcs37727/Kconfig"
rsource "tmp00x/Kconfig"
rsource "vl6180x/Kconfig"
endmenu # Sensor Device Drivers

menu "Storage Device Drivers"
rsource "mtd_sdcard/Kconfig"
endmenu # Storage Device Drivers

endmenu # Drivers
```

## drivers/Kconfig.net
```kconfig
# SPDX-FileCopyrightText: 2020 HAW Hamburg
# SPDX-License-Identifier: LGPL-2.1-only

menu "Network Device Drivers"

rsource "netdev/Kconfig"

rsource "at86rf215/Kconfig"
rsource "cc110x/Kconfig"
rsource "$(RIOTCPU)/nrf5x_common/radio/Kconfig.nrf5x"
rsource "dose/Kconfig"
rsource "mrf24j40/Kconfig"
rsource "pn532/Kconfig"
rsource "rn2xx3/Kconfig"
rsource "slipdev/Kconfig"
endmenu # Network Device Drivers
```

## drivers/a3g4250d/Kconfig
```kconfig
# Copyright (c) 2022 samkno1
#
# This file is subject to the terms and conditions of the GNU Lesser
# General Public License v2.1. See the file LICENSE in the top level
# directory for more details.

config MODULE_A3G4250D
    bool "drivers_a3g4250d"
    depends on TEST_KCONFIG
    depends on HAS_ PERIPH_GPIO
    depends on HAS_ PERIPH_SPI
    depends on HAS_PERIPH_I2C
    select PACKAGE_DRIVER_A3G4250D
    select MODULE_ PERIPH_GPIO
    select MODULE_ PERIPH_SPI
    select MODULE_PERIPH_I2C
    select MODULE_ A3G4250D_I2C
    select MODULE_A3G4250D_SPI
```

## drivers/ad7746/Kconfig
```kconfig
# Copyright (c) 2020 HAW Hamburg
#
# This file is subject to the terms and conditions of the GNU Lesser
# General Public License v2.1. See the file LICENSE in the top level
# directory for more details.
#

config MODULE_AD7746
    bool "AD7746 Capacitance-to-digital converter"
    depends on HAS_PERIPH_I2C
    depends on TEST_KCONFIG
    select MODULE_PERIPH_I2C
    select MODULE_ZTIMER
    select MODULE_ZTIMER_MSEC
    help
        AD7746 Capacitance-to-digital converter with temperature sensor driver.
```

## drivers/adcxx1c/Kconfig
```kconfig
# Copyright (c) 2020 HAW Hamburg
#
# This file is subject to the terms and conditions of the GNU Lesser
# General Public License v2.1. See the file LICENSE in the top level
# directory for more details.
#

menuconfig MODULE_ADCXX1C
    bool
    prompt "ADCXX1C Analog-to-Digital converter" if !(SAUL_DEFAULT && HAVE_ADCXX1C)
    default SAUL_DEFAULT && HAVE_ADCXX1C
    depends on HAS_PERIPH_GPIO
    depends on HAS_PERIPH_GPIO_IRQ
    depends on HAS_PERIPH_I2C
    depends on TEST_KCONFIG
    select MODULE_PERIPH_GPIO
    select MODULE_PERIPH_GPIO_IRQ
    select MODULE_PERIPH_I2C

choice ADCXX1C_VARIANT
    bool "Variants"
    depends on MODULE_ADCXX1C
    default MODULE_ADC081C if HAVE_ADC081C
    default MODULE_ADC101C if HAVE_ADC101C
    default MODULE_ADC121C if HAVE_ADC121C
    help
        This driver works with adc081c, adc101c and adc121c models. Select one.

config MODULE_ADC081C
    bool "ADC081C"

config MODULE_ADC101C
    bool "ADC101C"

config MODULE_ADC121C
    bool "ADC121C"

endchoice

config HAVE_ADCXX1C
    bool
    help
        Indicates that ADCXX1C Analog-to-Digital is present.

config HAVE_ADC081C
    bool
    select HAVE_ADCXX1C
    help
        Indicates that ADC081C Analog-to-Digital is present.

config HAVE_ADC101C
    bool
    select HAVE_ADCXX1C
    help
        Indicates that ADC101C Analog-to-Digital is present.

config HAVE_ADC121C
    bool
    select HAVE_ADCXX1C
    help
        Indicates that ADC121C Analog-to-Digital is present.
```

## drivers/ads101x/Kconfig
```kconfig
# SPDX-FileCopyrightText: 2020 Freie Universitaet Berlin
# SPDX-License-Identifier: LGPL-2.1-only

menu "ADS101X driver"
    depends on USEMODULE_ADS101X

config ADS101X_I2C_ADDRESS
    hex "Default I2C address"
    range 0x48 0x51
    default 0x48
    help
        ADS101X allows for upto 4 devices on Single Bus. The value depends on
        the state of ADDR Pin. Default value (0x48) corresponds to ADDR pin tied
        to GND. For more information refer I2C Address Selection in Datasheet.

endmenu # ADS101X driver
```

## drivers/ads1x1x/Kconfig
```kconfig
# SPDX-FileCopyrightText: 2020 Freie Universitaet Berlin
# SPDX-License-Identifier: LGPL-2.1-only

menu "ADS1X1X driver"
    depends on USEMODULE_ADS1X1X

config ADS1X1X_I2C_ADDRESS
    hex "Default I2C address"
    range 0x48 0x51
    default 0x48
    help
        ADS1X1X allows for upto 4 devices on Single Bus. The value depends on
        the state of ADDR Pin. Default value (0x48) corresponds to ADDR pin tied
        to GND. For more information refer I2C Address Selection in Datasheet.

endmenu # ADS1X1X driver
```

## drivers/adxl345/Kconfig
```kconfig
# Copyright (c) 2020 HAW Hamburg
#
# This file is subject to the terms and conditions of the GNU Lesser
# General Public License v2.1. See the file LICENSE in the top level
# directory for more details.
#

config MODULE_ADXL345
    bool "ADXL345 3-Axis accelerometer"
    depends on HAS_PERIPH_I2C
    depends on TEST_KCONFIG
    select MODULE_PERIPH_I2C

config HAVE_ADXL345
    bool
    select MODULE_ADXL345 if MODULE_SAUL_DEFAULT
    help
        Indicates that a adxl345 sensor is present.
```

## drivers/aip31068/Kconfig
```kconfig
# Copyright (c) 2020 HAW Hamburg
#
# This file is subject to the terms and conditions of the GNU Lesser
# General Public License v2.1. See the file LICENSE in the top level
# directory for more details.
#

config MODULE_AIP31068
    bool "AIP31068 I2C LCD controller"
    depends on HAS_PERIPH_I2C
    depends on TEST_KCONFIG
    select MODULE_XTIMER
    select MODULE_PERIPH_I2C
```

## drivers/apds99xx/Kconfig
```kconfig
# Copyright (c) 2020 HAW Hamburg
#
# This file is subject to the terms and conditions of the GNU Lesser
# General Public License v2.1. See the file LICENSE in the top level
# directory for more details.
#

menuconfig MODULE_APDS99XX
    bool
    prompt "APDS99xx Broadcom Sensors" if !(MODULE_SAUL_DEFAULT && HAVE_APDS99XX)
    depends on HAS_PERIPH_I2C
    depends on TEST_KCONFIG
    select MODULE_PERIPH_I2C
    help
        The driver can be used with following Broadcom sensors: APDS9900,
        APDS9901, APDS9930, APDS9950, APDS9960. Select one model.

        The base driver only supports a basic set of functions and has therefore
        a small size. The procedure for retrieving new data is polling. Ambient
        light and proximity sensing are supported.

        The fully functional driver MODULE_APDS99XX_FULL supports all the
        features supported by the base driver, as well as all other sensor
        features, including interrupts and their configuration. Data-ready
        interrupts can be used to retrieve data. In addition, threshold
        interrupts can be used and configured.

if MODULE_APDS99XX

choice APDS99XX_VARIANT
    bool "Model"
    default MODULE_APDS9900 if HAVE_APDS9900
    default MODULE_APDS9901 if HAVE_APDS9901
    default MODULE_APDS9930 if HAVE_APDS9930
    default MODULE_APDS9950 if HAVE_APDS9950
    default MODULE_APDS9960 if HAVE_APDS9960
    help
        The driver can be used with following Broadcom sensors: APDS9900,
        APDS9901, APDS9930, APDS9950, APDS9960. Select one model.

config MODULE_APDS9900
    bool "APDS9900"

config MODULE_APDS9901
    bool "APDS9901"

config MODULE_APDS9930
    bool "APDS9930"

config MODULE_APDS9950
    bool "APDS9950"

config MODULE_APDS9960
    bool "APDS9960"

endchoice

endif # MODULE_APDS99XX

config MODULE_APDS99XX_FULL
    bool "APDS99XX Full functionalities"
    depends on MODULE_APDS99XX
    depends on HAS_PERIPH_GPIO_IRQ
    select MODULE_PERIPH_GPIO_IRQ

config HAVE_APDS99XX
    bool
    select MODULE_APDS99XX if MODULE_SAUL_DEFAULT
    help
        Indicates that a apds99xx sensor is present.

config HAVE_APDS9900
    bool
    select HAVE_APDS99XX
    help
        Indicates that a apds9900 sensor is present.

config HAVE_APDS9901
    bool
    select HAVE_APDS99XX
    help
        Indicates that a apds9901 sensor is present.

config HAVE_APDS9930
    bool
    select HAVE_APDS99XX
    help
        Indicates that a apds9930 sensor is present.

config HAVE_APDS9950
    bool
    select HAVE_APDS99XX
    help
        Indicates that a apds9950 sensor is present.

config HAVE_APDS9960
    bool
    select HAVE_APDS99XX
    help
        Indicates that a apds9960 sensor is present.
```

## drivers/at/Kconfig
```kconfig
# Copyright (c) 2020 Freie Universitaet Berlin
#
# This file is subject to the terms and conditions of the GNU Lesser
# General Public License v2.1. See the file LICENSE in the top level
# directory for more details.
#

menu "AT driver"
    depends on USEMODULE_AT

choice
    bool "End of line character"
    default AT_SEND_EOL_MAC
    help
        Select the EOL character to send after the AT command.
        The character sequence depends on target device.
        By default "\r", aka carriage return, is used.

config AT_SEND_EOL_WINDOWS
    bool "\\r\\n"

config AT_SEND_EOL_UNIX
    bool "\\n"

config AT_SEND_EOL_MAC
    bool "\\r"

endchoice

config AT_SEND_SKIP_ECHO
    bool "Disable check for echo"
    help
        Enable this to disable check for echo after an AT
        command is sent.

config AT_RECV_OK
    string "OK reply string"
    default "OK"
    help
        Change okay response of the AT device.

config AT_RECV_ERROR
    string "Error reply string"
    default "ERROR"
    help
        Change error response of the AT device.

config AT_BUF_SIZE_EXP
    int "Exponent for the buffer size (resulting in the queue size 2^n)"
    range 0 31
    default 7
    depends on USEMODULE_AT_URC
    help
        Size of buffer used to process unsolicited result code data. (as
        exponent of 2^n). As the buffer size ALWAYS needs to be power of two,
        this option represents the exponent of 2^n, which will be used as the
        size of the buffer.

endmenu # AT driver
```

## drivers/at24cxxx/Kconfig
```kconfig
# Copyright (c) 2020 HAW Hamburg
#
# This file is subject to the terms and conditions of the GNU Lesser
# General Public License v2.1. See the file LICENSE in the top level
# directory for more details.
#

menuconfig MODULE_AT24CXXX
    bool
    prompt "AT24CXXX EEPROM" if !(MODULE_MTD && HAVE_AT24CXXX)
    default (MODULE_MTD && HAVE_AT24CXXX)
    depends on TEST_KCONFIG
    depends on HAS_PERIPH_I2C
    select MODULE_PERIPH_I2C
    select HAVE_MTD_AT24CXXX
    select MODULE_XTIMER

choice AT24CXXX_VARIANT
    bool "Variants"
    depends on MODULE_AT24CXXX
    default MODULE_AT24C01 if HAVE_AT24C01
    default MODULE_AT24C02 if HAVE_AT24C02
    default MODULE_AT24C04 if HAVE_AT24C04
    default MODULE_AT24C08A if HAVE_AT24C08A
    default MODULE_AT24C16A if HAVE_AT24C16A
    default MODULE_AT24C32 if HAVE_AT24C32
    default MODULE_AT24C64 if HAVE_AT24C64
    default MODULE_AT24C128 if HAVE_AT24C128
    default MODULE_AT24C256 if HAVE_AT24C256
    default MODULE_AT24C512 if HAVE_AT24C512
    default MODULE_AT24C1024 if HAVE_AT24C1024
    default AT24CXXX_MULTIPLE
    help
        This driver supports the multiple models, select one.

config AT24CXXX_MULTIPLE
    bool "Multiple"
    help
        This should be selected when using multiple variants and providing
        the params.

config MODULE_AT24C01
    bool "AT24C01"

config MODULE_AT24C02
    bool "AT24C02"

config MODULE_AT24C04
    bool "AT24C04"

config MODULE_AT24C08A
    bool "AT24C08A"

config MODULE_AT24C16A
    bool "AT24C16A"

config MODULE_AT24C32
    bool "AT24C32"

config MODULE_AT24C64
    bool "AT24C64"

config MODULE_AT24C128
    bool "AT24C128"

config MODULE_AT24C256
    bool "AT24C256"

config MODULE_AT24C512
    bool "AT24C512"

config MODULE_AT24C1024
    bool "AT24C1024"
endchoice

config HAVE_AT24CXXX
    bool
    help
        Indicates that the AT24CXXX EEPROM is present.
        This should be selected when using multiple variants and providing
        the params.

config HAVE_AT24C01
    bool
    select HAVE_AT24CXXX
    help
        Indicates that the AT24C01 is present.

config HAVE_AT24C02
    bool
    select HAVE_AT24CXXX
    help
        Indicates that the AT24C02 is present.

config HAVE_AT24C04
    bool
    select HAVE_AT24CXXX
    help
        Indicates that the AT24C04 is present.

config HAVE_AT24C08A
    bool
    select HAVE_AT24CXXX
    help
        Indicates that the AT24C08A is present.

config HAVE_AT24C16A
    bool
    select HAVE_AT24CXXX
    help
        Indicates that the AT24C16A is present.

config HAVE_AT24C32
    bool
    select HAVE_AT24CXXX
    help
        Indicates that the AT24C32 is present.

config HAVE_AT24C64
    bool
    select HAVE_AT24CXXX
    help
        Indicates that the AT24C64 is present.

config HAVE_AT24C128
    bool
    select HAVE_AT24CXXX
    help
        Indicates that the AT24C128 is present.

config HAVE_AT24C256
    bool
    select HAVE_AT24CXXX
    help
        Indicates that the AT24C256 is present.

config HAVE_AT24C512
    bool
    select HAVE_AT24CXXX
    help
        Indicates that the AT24C512 is present.

config HAVE_AT24C1024
    bool
    select HAVE_AT24CXXX
    help
        Indicates that the AT24C1024 is present.
```

## drivers/at24cxxx/mtd/Kconfig
```kconfig
# Copyright (c) 2020 HAW Hamburg
#
# This file is subject to the terms and conditions of the GNU Lesser
# General Public License v2.1. See the file LICENSE in the top level
# directory for more details.
#

config MODULE_MTD_AT24CXXX
    bool "MTD implementation for AT24CXXX"
    default y
    depends on MODULE_AT24CXXX
    depends on MODULE_MTD
    depends on TEST_KCONFIG
```
