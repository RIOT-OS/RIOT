## cpu/stm32/kconfigs/f7/Kconfig
```kconfig
# SPDX-FileCopyrightText: 2020 Inria
# SPDX-License-Identifier: LGPL-2.1-only

config CPU_FAM_F7
    bool
    select CPU_STM32
    select CPU_CORE_CORTEX_M7

config CPU_FAM
    default "f7" if CPU_FAM_F7
```

## cpu/stm32/kconfigs/f7/Kconfig.clk
```kconfig
# SPDX-FileCopyrightText: 2022 HAW Hamburg
# SPDX-License-Identifier: LGPL-2.1-only

rsource '../f2f4f7mp1/Kconfig.clk'

if CPU_FAM_F7

config CLOCK_PLL_M
    int "M: PLLIN division factor" if CUSTOM_PLL_PARAMS
    default 25 if CLOCK_HSE = 25000000
    default 4

config CLOCK_PLL_N
    int "N: PLLIN multiply factor" if CUSTOM_PLL_PARAMS
    default 216 if CLOCK_HSE = 8000000
    default 432 if CLOCK_HSE = 25000000
    default 108
    range 50 432

endif # CPU_FAM_F7
```

## cpu/stm32/kconfigs/f7/Kconfig.models
```kconfig
# Copyright (c) 2020 Inria
#
# This file is subject to the terms and conditions of the GNU Lesser
# General Public License v2.1. See the file LICENSE in the top level
# directory for more details.
#

# CPU models
config CPU_MODEL_STM32F722ZE
    bool
    select CPU_LINE_STM32F722XX

config CPU_MODEL_STM32F723IE
    bool
    select CPU_LINE_STM32F723XX

config CPU_MODEL_STM32F746ZG
    bool
    select CPU_LINE_STM32F746XX

config CPU_MODEL_STM32F767ZI
    bool
    select CPU_LINE_STM32F767XX

config CPU_MODEL_STM32F769NI
    bool
    select CPU_LINE_STM32F769XX

# Configure CPU model
config CPU_MODEL
    default "stm32f722ze" if CPU_MODEL_STM32F722ZE
    default "stm32f723ie" if CPU_MODEL_STM32F723IE
    default "stm32f746zg" if CPU_MODEL_STM32F746ZG
    default "stm32f767zi" if CPU_MODEL_STM32F767ZI
    default "stm32f769ni" if CPU_MODEL_STM32F769NI
```

## cpu/stm32/kconfigs/g0/Kconfig
```kconfig
# SPDX-FileCopyrightText: 2020 Inria
# SPDX-License-Identifier: LGPL-2.1-only

config CPU_FAM_G0
    bool
    select CPU_STM32
    select CPU_CORE_CORTEX_M0PLUS

config CPU_FAM
    default "g0" if CPU_FAM_G0
```

## cpu/stm32/kconfigs/g0/Kconfig.clk
```kconfig
# SPDX-FileCopyrightText: 2022 HAW Hamburg
# SPDX-License-Identifier: LGPL-2.1-only

rsource '../g0wxmp1/Kconfig.clk'

if CPU_FAM_G0

config CLOCK_PLL_M
    int "M: PLLIN division factor" if CUSTOM_PLL_PARAMS
    default 1
    range 1 8

config CLOCK_PLL_N
    int "N: PLLIN multiply factor" if CUSTOM_PLL_PARAMS
    default 20
    range 8 86

choice
bool "HSISYS division factor" if USE_CLOCK_HSI
default CLOCK_HSISYS_DIV_1

config CLOCK_HSISYS_DIV_1
    bool "Divide HSISYS by 1"

config CLOCK_HSISYS_DIV_2
    bool "Divide HSISYS by 2"

config CLOCK_HSISYS_DIV_4
    bool "Divide HSISYS by 4"

config CLOCK_HSISYS_DIV_8
    bool "Divide HSISYS by 8"

config CLOCK_HSISYS_DIV_16
    bool "Divide HSISYS by 16"

config CLOCK_HSISYS_DIV_32
    bool "Divide HSISYS by 32"

config CLOCK_HSISYS_DIV_64
    bool "Divide HSISYS by 64"

config CLOCK_HSISYS_DIV_128
    bool "Divide HSISYS by 128"

endchoice

config CLOCK_HSISYS_DIV
    int
    default 1 if CLOCK_HSISYS_DIV_1
    default 2 if CLOCK_HSISYS_DIV_2
    default 4 if CLOCK_HSISYS_DIV_4
    default 8 if CLOCK_HSISYS_DIV_8
    default 16 if CLOCK_HSISYS_DIV_16
    default 32 if CLOCK_HSISYS_DIV_32
    default 64 if CLOCK_HSISYS_DIV_64
    default 128 if CLOCK_HSISYS_DIV_128

endif # CPU_FAM_G0
```

## cpu/stm32/kconfigs/g0wxmp1/Kconfig.clk
```kconfig
# SPDX-FileCopyrightText: 2022 HAW Hamburg
# SPDX-License-Identifier: LGPL-2.1-only

if CPU_FAM_G0 || CPU_FAM_WB || CPU_FAM_WL || CPU_FAM_MP1

config CLOCK_PLL_R
    int "Q: VCO division factor" if CUSTOM_PLL_PARAMS
    default 2 if CPU_FAM_WB || CPU_FAM_WL
    default 3 if CPU_FAM_MP1
    default 6 if BOARD_HAS_HSE
    default 5
    range 2 8

endif # CPU_FAM_G0 || CPU_FAM_WB || CPU_FAM_WL || CPU_FAM_MP1
```

## cpu/stm32/kconfigs/g4/Kconfig
```kconfig
# Copyright (c) 2020 Inria
#
# This file is subject to the terms and conditions of the GNU Lesser
# General Public License v2.1. See the file LICENSE in the top level
# directory for more details.
#

config CPU_FAM_G4
    bool
    select CPU_STM32
    select CPU_CORE_CORTEX_M4

config CPU_FAM
    default "g4" if CPU_FAM_G4
```

## cpu/stm32/kconfigs/g4/Kconfig.clk
```kconfig
# SPDX-FileCopyrightText: 2022 HAW Hamburg
# SPDX-License-Identifier: LGPL-2.1-only

rsource '../g4l4l5/Kconfig.clk'

if CPU_FAM_G4

config CLOCK_PLL_M
    int "M: PLLIN division factor" if CUSTOM_PLL_PARAMS
    default 6 if BOARD_HAS_HSE
    default 4
    range 1 16

config CLOCK_PLL_N
    int "N: PLLIN multiply factor" if CUSTOM_PLL_PARAMS
    default 85
    range 8 127

endif # CPU_FAM_G4
```

## cpu/stm32/kconfigs/g4l4l5/Kconfig.clk
```kconfig
# SPDX-FileCopyrightText: 2022 HAW Hamburg
# SPDX-License-Identifier: LGPL-2.1-only

if CPU_FAM_G4 || CPU_FAM_L4 || CPU_FAM_L5

choice
bool "R: Main PLL division factor for PLL 'R' clock (system clock)" if CUSTOM_PLL_PARAMS
default PLL_R_DIV_2

config PLL_R_DIV_2
    bool "Divide by 2"

config PLL_R_DIV_4
    bool "Divide by 4"

config PLL_R_DIV_6
    bool "Divide by 6"

config PLL_R_DIV_8
    bool "Divide by 8"

endchoice

config CLOCK_PLL_R
    int
    default 2 if PLL_R_DIV_2
    default 4 if PLL_R_DIV_4
    default 6 if PLL_R_DIV_6
    default 8 if PLL_R_DIV_8

endif # CPU_FAM_G4 || CPU_FAM_L4 || CPU_FAM_L5
```

## cpu/stm32/kconfigs/h7/Kconfig
```kconfig
# SPDX-FileCopyrightText: 2025 Technische Universität Hamburg
# SPDX-License-Identifier: LGPL-2.1-only

config CPU_FAM_H7
    bool
    select CPU_STM32
    select CPU_CORE_CORTEX_M7

config CPU_FAM
    default "h7" if CPU_FAM_H7
```

## cpu/stm32/kconfigs/h7/Kconfig.clk
```kconfig
# SPDX-FileCopyrightText: 2025 Technische Universität Hamburg
# SPDX-License-Identifier: LGPL-2.1-only

if CPU_FAM_H7

menu "STM32H753 Clock Configuration"

#----------------------
# 1. Clock Source Selection
#----------------------
menu "Clock Source Configuration"

choice
    prompt "Select main clock source"
    default USE_HSI_DIRECT
    help
      Only one main clock source can be active:
      - HSI direct (no PLL)
      - HSE direct (no PLL)
      - CSI direct (no PLL)
      - HSI + PLL
      - CSI + PLL
      - HSE + PLL

config USE_HSI_DIRECT
    bool "Use HSI direct (no PLL)"
    help
      Use HSI RC oscillator directly as SYSCLK.
      SYSCLK = HSI / HSI_DIV.

config USE_HSE_DIRECT
    bool "Use HSE direct (no PLL)"
    help
      Use HSE RC oscillator directly as SYSCLK.
      SYSCLK = HSE.

config USE_CSI_DIRECT
    bool "Use CSI direct (no PLL)"
    help
      Use CSI oscillator directly as SYSCLK.
      SYSCLK = CSI.

config USE_HSI_PLL
    bool "Use HSI + PLL"
    help
      Use HSI RC as PLL input to generate SYSCLK.
      SYSCLK = PLL1_P output.

config USE_CSI_PLL
    bool "Use CSI + PLL"
    help
        Use CSI as PLL input to generate SYSCLK.
        SYSCLK = PLL1_P output.

config USE_HSE_PLL
    bool "Use HSE + PLL"
    help
      Use an external crystal (HSE) as PLL input to generate SYSCLK.
      SYSCLK = PLL1_P output.
endchoice

#----------------------
# HSI settings
#----------------------
config CLOCK_HSI
    int "HSI frequency (MHz)"
    default 64
    help
      Internal HSI RC frequency before divider (64 MHz).

config CLOCK_HSI_DIV
    int "HSI divider"
    default 1
    help
      Divider applied to HSI before SYSCLK or PLL.

#----------------------
# HSE settings
#----------------------
config CLOCK_HSE
    int "HSE frequency (MHz)"
    default 8
    depends on USE_HSE_DIRECT || USE_HSE_PLL
    help
      External crystal frequency in MHz.
      Typical values: 8, 25.

config CLOCK_HSE_MIN
    int "HSE minimum frequency (MHz)"
    default 4
    depends on USE_HSE_DIRECT || USE_HSE_PLL
    help
      Minimum HSE frequency allowed.

config CLOCK_HSE_MAX
    int "HSE maximum frequency (MHz)"
    default 50
    depends on USE_HSE_DIRECT || USE_HSE_PLL
    help
      Maximum HSE frequency allowed.

#----------------------
# CSI clock
#----------------------
config CLOCK_CSI
    int "CSI frequency (MHz)"
    default 4
    depends on USE_CSI_DIRECT || USE_CSI_PLL
    help
      Frequency of the CSI clock source in MHz.

endmenu # Clock Source Selection


#----------------------
# 2. LSE / LSI clocks
#----------------------
menu "Configure LSI/LSE"

config USE_LSE
    bool "Enable LSE"
    default n
    help
      Enable LSE oscillator.

config CLOCK_LSE
    int "LSE frequency (Hz)"
    default 32768
    depends on USE_LSE
    help
      External low-speed 32.768 kHz crystal for RTC.

config USE_LSI
    bool "Enable LSI"
    default y
    help
      Enable LSI oscillator.

config CLOCK_LSI
    int "LSI frequency (Hz)"
    default 32000
    depends on USE_LSI
    help
      Internal low-speed RC oscillator (~32 kHz).

endmenu     #  LSI/LSE

#----------------------
# 3. PLLx Setting
#----------------------
menu "Configure PLLx"
    depends on USE_HSI_PLL || USE_HSE_PLL || USE_CSI_PLL

menu "Set Parameters PLL1"

config CLOCK_PLL1_M
    int "PLL1 input divider M"
    default 8
    help
      PLL1 input divider (M).

config CLOCK_PLL1_N
    int "PLL1 multiplier N"
    default 120
    help
      PLL1 VCO multiplier (N).

config CLOCK_PLL1_P
    int "PLL1 output P divider"
    default 2
    help
      PLL1_P output divider (SYSCLK).

config CLOCK_PLL1_Q
    int "PLL1 output Q divider"
    default 20
    help
      PLL1_Q output divider (USB/SDMMC/RNG).

config CLOCK_PLL1_R
    int "PLL1 output R divider"
    default 2
    help
      PLL1_R optional output divider (optional peripherals).

endmenu     # PLL1

#----------------------
# PLL2 settings
#----------------------
menu "Set Parameters PLL2"

config CLOCK_PLL2_M
    int "PLL2 input divider M"
    default 8
    help
      PLL2 input divider (M).

config CLOCK_PLL2_N
    int "PLL2 multiplier N"
    default 120
    help
      PLL2 VCO multiplier (N).

config CLOCK_PLL2_P
    int "PLL2 output P divider"
    default 2
    help
      PLL2_P output divider.

config CLOCK_PLL2_Q
    int "PLL2 output Q divider"
    default 20
    help
      PLL2_Q output divider.

config CLOCK_PLL2_R
    int "PLL2 output R divider"
    default 2
    help
      PLL2_R optional output divider.

endmenu     # PLL2

#----------------------
# PLL3 settings
#----------------------
menu "Set Parameters PLL3"

config CLOCK_PLL3_M
    int "PLL3 input divider M"
    default 8
    help
      PLL3 input divider (M).

config CLOCK_PLL3_N
    int "PLL3 multiplier N"
    default 120
    help
      PLL3 VCO multiplier (N).

config CLOCK_PLL3_P
    int "PLL3 output P divider"
    default 2
    help
      PLL3_P output divider.

config CLOCK_PLL3_Q
    int "PLL3 output Q divider"
    default 20
    help
      PLL3_Q output divider.

config CLOCK_PLL3_R
    int "PLL3 output R divider"
    default 2
    help
      PLL1_R optional output divider.

endmenu     # PLL3

endmenu     # Configure PLLx

#----------------------------
# 4. Core and bus prescalers
#----------------------------
menu "Core and Bus Prescalers"

config CLOCK_CORECLOCK_DIV
    int "Core clock divider"
    default 1
    help
      Divider applied to SYSCLK to generate CPU core clock.

config CLOCK_AHB_DIV
    int "AHB prescaler"
    default 2
    help
      Divide core clock for AHB bus.

config CLOCK_APB1_DIV
    int "APB1 prescaler"
    default 2
    help
      Divide AHB clock for APB1 (max 120 MHz).

config CLOCK_APB2_DIV
    int "APB2 prescaler"
    default 2
    help
      Divide AHB clock for APB2 (max 120 MHz).

config CLOCK_APB3_DIV
    int "APB3 prescaler"
    default 2
    help
      Divide AHB clock for APB3 (max 120 MHz).

config CLOCK_APB4_DIV
    int "APB4 prescaler"
    default 2
    help
      Divide AHB clock for APB4 (max 120 MHz).


endmenu  # Core and Bus Prescalers

#----------------------------
# 5. MCO Configurator
#----------------------------
menu "MCO Configurator"

menu "MCO1"

config CLOCK_ENABLE_MCO1
    bool "Enable MCO1"
    default n
    help
        MCO1 as clock output for external devices.

config CLOCK_MCO1_PRE
    int "MCO1 prescaler"
    default 1
    help
        Prescaler range 1 to 5.

menu "MCO1 clock source"

config CLOCK_MCO1_USE_PLL1_Q
    bool "Use PLL1_Q as clock source"
    default y
    depends on CLOCK_ENABLE_MCO1
    help
        Default clock source for MCO1.

config CLOCK_MCO1_USE_HSE
    bool "Use HSE as clock source"
    default N
    depends on CLOCK_ENABLE_MCO1

config CLOCK_MCO1_USE_HSI
    bool "Use HSI as clock source"
    default N
    depends on CLOCK_ENABLE_MCO1

config CLOCK_MCO1_USE_LSE
    bool "Use LSE as clock source"
    default N
    depends on CLOCK_ENABLE_MCO1

config CLOCK_MCO1_USE_HSI48
    bool "Use HSI48 as clock source"
    default N
    depends on CLOCK_ENABLE_MCO1

endmenu # MCO1 clock source
endmenu # MCO1

menu "MCO2"

config CLOCK_ENABLE_MCO2
    bool "Enable MCO2"
    default n
    help
        MCO2 as clock output for external devices.

config CLOCK_MCO2_PRE
    int "MCO2 prescaler"
    default 1
    help
        Prescaler range 1 to 5.

menu "MCO2 clock source"

config CLOCK_MCO2_USE_PLL1_P
    bool "Use PLL1_P as clock source"
    default y
    depends on CLOCK_ENABLE_MCO2
    help
        Default clock source for MCO2.

config CLOCK_MCO2_USE_PLL2_Q
    bool "Use PLL2_Q as clock source"
    default n
    depends on CLOCK_ENABLE_MCO2

config CLOCK_MCO2_USE_HSE
    bool "Use HSE as clock source"
    default N
    depends on CLOCK_ENABLE_MCO2

config CLOCK_MCO2_USE_LSI
    bool "Use LSI as clock source"
    default N
    depends on CLOCK_ENABLE_MCO2

config CLOCK_MCO2_USE_CSI
    bool "Use CSI as clock source"
    default N
    depends on CLOCK_ENABLE_MCO2

config CLOCK_MCO2_USE_SYSCLK
    bool "Use HSI48 as clock source"
    default N
    depends on CLOCK_ENABLE_MCO2

endmenu # MCO2 clock source
endmenu # MCO2

endmenu # MCO Configurator

endmenu  # STM32H753 Clock Configuration

endif # CPU_FAM_H7
```

## cpu/stm32/kconfigs/h7/Kconfig.fdcan
```kconfig
menu "STM32H753ZI FDCAN Configuration"

config FDCAN_SRAM_MESSAGE_RAM_OFFSET
    int "Message RAM Offset"
    range 0 10240
    default 0
    help
      Message RAM start offset (in bytes).
      Must be between 0 and 10240.

config FDCAN_STD_FILTERS_NUM
    int "Number of Standard ID Filters"
    range 0 128
    default 0

config FDCAN_EXT_FILTERS_NUM
    int "Number of Extended ID Filters"
    range 0 64
    default 0

config FDCAN_RX_FIFO0_ELEMENTS
    int "RX FIFO0 Elements"
    range 0 64
    default 0

config FDCAN_RX_FIFO0_ELEMENT_SIZE
    int "RX FIFO0 element size"
    default 0
    range 0 7
    help
      0 = 8 bytes
      1 = 12 bytes
      2 = 16 bytes
      3 = 20 bytes
      4 = 24 bytes
      5 = 32 bytes
      6 = 48 bytes
      7 = 64 bytes

config FDCAN_RX_FIFO1_ELEMENTS
    int "RX FIFO1 Elements"
    range 0 64
    default 0

config FDCAN_RX_FIFO1_ELEMENT_SIZE
    int "RX FIFO1 element size"
    default 0
    range 0 7
    help
      0 = 8 bytes
      1 = 12 bytes
      2 = 16 bytes
      3 = 20 bytes
      4 = 24 bytes
      5 = 32 bytes
      6 = 48 bytes
      7 = 64 bytes

config FDCAN_RX_BUFFERS_NUM
    int "Dedicated RX Buffers"
    range 0 64
    default 0

config FDCAN_RX_BUFFER_ELEMENT_SIZE
    int "RX BUFFER element size"
    default 0
    range 0 7
    help
      0 = 8 bytes
      1 = 12 bytes
      2 = 16 bytes
      3 = 20 bytes
      4 = 24 bytes
      5 = 32 bytes
      6 = 48 bytes
      7 = 64 bytes

config FDCAN_TX_EVENTS_NUM
    int "TX Event FIFO Elements"
    range 0 32
    default 0

config FDCAN_TX_BUFFERS_NUM
    int "Dedicated TX Buffers"
    range 0 32
    default 0

config FDCAN_TX_FIFO_QUEUE_ELEMENTS
    int "TX FIFO/Queue Elements"
    range 0 32
    default 0

config FDCAN_TX_FIFO_QUEUE_MODE
    int "TX mode"
    default 0
    range 0 1
    help
      0 = FIFO Mode
      1 = QUEUE Mode

config FDCAN_TX_ELEMENT_SIZE
    int "TX FIFO0 element size"
    default 0
    range 0 7
    help
      0 = 8 bytes
      1 = 12 bytes
      2 = 16 bytes
      3 = 20 bytes
      4 = 24 bytes
      5 = 32 bytes
      6 = 48 bytes
      7 = 64 bytes

endmenu
```
