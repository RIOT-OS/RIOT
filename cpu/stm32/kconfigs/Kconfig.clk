## cpu/stm32/kconfigs/Kconfig.clk
```kconfig
# Copyright (c) 2020 Inria
#
# This file is subject to the terms and conditions of the GNU Lesser
# General Public License v2.1. See the file LICENSE in the top level
# directory for more details.
#

config CLOCK_HAS_NO_MCO_PRE
    bool
    help
        Indicates that the CPU has no MCO prescaler


choice
bool "Clock source selection"
default USE_CLOCK_PLL

config USE_CLOCK_PLL
    bool "PLL"

config USE_CLOCK_HSE
    bool "Direct High frequency external oscillator (HSE)"
    depends on BOARD_HAS_HSE

config USE_CLOCK_HSI
    bool "Direct High frequency internal oscillator (HSI16)"

endchoice

config CLOCK_HSE
    int
    depends on BOARD_HAS_HSE
    default 24000000 if CPU_FAM_G0 || CPU_FAM_G4 || CPU_FAM_L0 || CPU_FAM_L1 || CPU_FAM_MP1
    default 8000000

config CUSTOM_PLL_PARAMS
    bool "Configure PLL parameters"
    depends on USE_CLOCK_PLL

choice
bool "APB1 prescaler (division factor of HCLK to produce PCLK1)"
default CLOCK_APB1_DIV_4 if CPU_FAM_F2 || (CPU_FAM_F4 && CLOCK_MAX_180MHZ) || CPU_FAM_F7 || CPU_FAM_L4 || CPU_FAM_L5 || CPU_FAM_U5 || CPU_FAM_WB || CPU_FAM_WL
default CLOCK_APB1_DIV_2 if CPU_FAM_F1 || CPU_FAM_F3 || CPU_FAM_F4 || CPU_FAM_MP1
default CLOCK_APB1_DIV_1

config CLOCK_APB1_DIV_1
    bool "Divide HCLK by 1"

config CLOCK_APB1_DIV_2
    bool "Divide HCLK by 2"

config CLOCK_APB1_DIV_4
    bool "Divide HCLK by 4"

config CLOCK_APB1_DIV_8
    bool "Divide HCLK by 8"

config CLOCK_APB1_DIV_16
    bool "Divide HCLK by 16"

endchoice

config CLOCK_APB1_DIV
    int
    default 1 if CLOCK_APB1_DIV_1
    default 2 if CLOCK_APB1_DIV_2
    default 4 if CLOCK_APB1_DIV_4
    default 8 if CLOCK_APB1_DIV_8
    default 16 if CLOCK_APB1_DIV_16

choice
bool "APB2 prescaler (division factor of HCLK to produce PCLK2)"
depends on !CPU_FAM_G0 && !CPU_FAM_F0
default CLOCK_APB2_DIV_2 if CPU_FAM_F2 || (CPU_FAM_F4 && CLOCK_MAX_180MHZ) || CPU_FAM_F7 || CPU_FAM_L4 || CPU_FAM_L5 || CPU_FAM_U5 || CPU_FAM_WB || CPU_FAM_WL || CPU_FAM_MP1
default CLOCK_APB2_DIV_1

config CLOCK_APB2_DIV_1
    bool "Divide HCLK by 1"

config CLOCK_APB2_DIV_2
    bool "Divide HCLK by 2"

config CLOCK_APB2_DIV_4
    bool "Divide HCLK by 4"

config CLOCK_APB2_DIV_8
    bool "Divide HCLK by 8"

config CLOCK_APB2_DIV_16
    bool "Divide HCLK by 16"

endchoice

config CLOCK_APB2_DIV
    int
    default 1 if CLOCK_APB2_DIV_1
    default 2 if CLOCK_APB2_DIV_2
    default 4 if CLOCK_APB2_DIV_4
    default 8 if CLOCK_APB2_DIV_8
    default 16 if CLOCK_APB2_DIV_16
```

## cpu/stm32/kconfigs/c0/Kconfig
```kconfig
# SPDX-FileCopyrightText: 2024 BISSELL Homecare, Inc.
# SPDX-License-Identifier: LGPL-2.1-only

config CPU_FAM_C0
    bool
    select CPU_STM32
    select CPU_CORE_CORTEX_M0PLUS

config CPU_FAM
    default "c0" if CPU_FAM_C0
```

## cpu/stm32/kconfigs/c0/Kconfig.clk
```kconfig
# Copyright (C) 2024 BISSELL Homecare, Inc.
#
# This file is subject to the terms and conditions of the GNU Lesser
# General Public License v2.1. See the file LICENSE in the top level
# directory for more details.
#

if CPU_FAM_C0

choice
bool "HSISYS division factor" if USE_CLOCK_HSI
default CLOCK_HSISYS_DIV_1

config CLOCK_HSISYS_DIV_1
    bool "Divide HSISYS by 1"

config CLOCK_HSISYS_DIV_2
    bool "Divide HSISYS by 2"

config CLOCK_HSISYS_DIV_4
    bool "Divide HSISYS by 4"

config CLOCK_HSISYS_DIV_8
    bool "Divide HSISYS by 8"

config CLOCK_HSISYS_DIV_16
    bool "Divide HSISYS by 16"

config CLOCK_HSISYS_DIV_32
    bool "Divide HSISYS by 32"

config CLOCK_HSISYS_DIV_64
    bool "Divide HSISYS by 64"

config CLOCK_HSISYS_DIV_128
    bool "Divide HSISYS by 128"

endchoice

config CLOCK_HSISYS_DIV
    int
    default 1 if CLOCK_HSISYS_DIV_1
    default 2 if CLOCK_HSISYS_DIV_2
    default 4 if CLOCK_HSISYS_DIV_4
    default 8 if CLOCK_HSISYS_DIV_8
    default 16 if CLOCK_HSISYS_DIV_16
    default 32 if CLOCK_HSISYS_DIV_32
    default 64 if CLOCK_HSISYS_DIV_64
    default 128 if CLOCK_HSISYS_DIV_128

endif # CPU_FAM_C0
```

## cpu/stm32/kconfigs/f0/Kconfig
```kconfig
# Copyright (c) 2020 Inria
#
# This file is subject to the terms and conditions of the GNU Lesser
# General Public License v2.1. See the file LICENSE in the top level
# directory for more details.
#

config CPU_FAM
    default "f0" if CPU_FAM_F0

config CPU_FAM_F0
    bool
    select CPU_STM32
    select CPU_CORE_CORTEX_M0
    select HAS_CPU_STM32F0
    select HAS_PERIPH_FLASHPAGE
    select HAS_PERIPH_FLASHPAGE_PAGEWISE

config HAS_CPU_STM32F0
    bool
    help
        Indicates that the cpu being used belongs to the 'stm32f0' family.
```

## cpu/stm32/kconfigs/f0/Kconfig.clk
```kconfig
# SPDX-FileCopyrightText: 2022 HAW Hamburg
# SPDX-License-Identifier: LGPL-2.1-only

rsource '../f0f1f3/Kconfig.clk'
```

## cpu/stm32/kconfigs/f0/Kconfig.models
```kconfig
# Copyright (c) 2020 Inria
#
# This file is subject to the terms and conditions of the GNU Lesser
# General Public License v2.1. See the file LICENSE in the top level
# directory for more details.
#

# CPU models
config CPU_MODEL_STM32F030F4
    bool
    select CPU_FAM_F0

config CPU_MODEL_STM32F030R8
    bool
    select CPU_LINE_STM32F030X8

config CPU_MODEL_STM32F031K6
    bool
    select CPU_LINE_STM32F031X6

config CPU_MODEL_STM32F042K6
    bool
    select CPU_LINE_STM32F042X6

config CPU_MODEL_STM32F051R8
    bool
    select CPU_LINE_STM32F051X8

config CPU_MODEL_STM32F070RB
    bool
    select CPU_LINE_STM32F070XB

config CPU_MODEL_STM32F072RB
    bool
    select CPU_LINE_STM32F072XB

config CPU_MODEL_STM32F091RC
    bool
    select CPU_LINE_STM32F091XC

# Configure CPU model
config CPU_MODEL
    default "stm32f030f4" if CPU_MODEL_STM32F030F4
    default "stm32f030r8" if CPU_MODEL_STM32F030R8
    default "stm32f031k6" if CPU_MODEL_STM32F031K6
    default "stm32f042k6" if CPU_MODEL_STM32F042K6
    default "stm32f051r8" if CPU_MODEL_STM32F051R8
    default "stm32f070rb" if CPU_MODEL_STM32F070RB
    default "stm32f072rb" if CPU_MODEL_STM32F072RB
    default "stm32f091rc" if CPU_MODEL_STM32F091RC
```

## cpu/stm32/kconfigs/f0f1f3/Kconfig.clk
```kconfig
# SPDX-FileCopyrightText: 2022 HAW Hamburg
# SPDX-License-Identifier: LGPL-2.1-only

if CPU_FAM_F0 || CPU_FAM_F1 || CPU_FAM_F3

config CLOCK_PLL_PREDIV
    int "PLLIN division factor" if CUSTOM_PLL_PARAMS && !HAVE_CLOCK_PLL_PREDIV_HARDWIRED_2
    default 2 if HAVE_CLOCK_PLL_PREDIV_HARDWIRED_2 || CLOCK_HSE = 16000000
    default 1
    range 1 16

config CLOCK_PLL_MUL
    int "PLLIN multiply factor" if CUSTOM_PLL_PARAMS
    default 12 if CPU_FAM_F0 && HAVE_CLOCK_PLL_PREDIV_HARDWIRED_2
    default 6 if CPU_FAM_F0
    default 16 if CPU_FAM_F3 && HAVE_CLOCK_PLL_PREDIV_HARDWIRED_2
    default 9 if CPU_FAM_F1 || CPU_FAM_F3

    range 2 16

endif # CPU_FAM_F0 || CPU_FAM_F1 || CPU_FAM_F3
```

## cpu/stm32/kconfigs/f0f1f3g0g4l0l1l4wbwl/Kconfig.clk
```kconfig
# Copyright (c) 2022 HAW Hamburg
#
# This file is subject to the terms and conditions of the GNU Lesser
# General Public License v2.1. See the file LICENSE in the top level
# directory for more details.
#

if CPU_FAM_F0 || CPU_FAM_F1 || CPU_FAM_F3 || CPU_FAM_G0 || CPU_FAM_G4 || CPU_FAM_L0 || CPU_FAM_L4 || CPU_FAM_WB || CPU_FAM_WL

config CLOCK_ENABLE_MCO
    bool "Enable MCU Clock Output (MCO) on PA8"

choice
bool "MCO source"
depends on CLOCK_ENABLE_MCO
default CLOCK_MCO_USE_PLLCLK

config CLOCK_MCO_USE_PLLCLK
    bool "Use PLLCLK as MCO source"

config CLOCK_MCO_USE_HSE
    bool "Use HSE as MCO source"

config CLOCK_MCO_USE_HSI
    bool "Use HSI as MCO source"

config CLOCK_MCO_USE_LSE
    bool "Use LSE as MCO source"
    depends on CPU_FAM_G0 || CPU_FAM_G4 || CPU_FAM_L0 || CPU_FAM_L1 || CPU_FAM_L4 || CPU_FAM_WB  || CPU_FAM_WL

config CLOCK_MCO_USE_LSI
    bool "Use LSI as MCO source"
    depends on CPU_FAM_G0 || CPU_FAM_G4 || CPU_FAM_L0 || CPU_FAM_L1 || CPU_FAM_L4 || CPU_FAM_WB || CPU_FAM_WL

config CLOCK_MCO_USE_MSI
    bool "Use MSI as MCO source"
    depends on CPU_FAM_L0 || CPU_FAM_L1 || CPU_FAM_L4 || CPU_FAM_WB || CPU_FAM_WL

config CLOCK_MCO_USE_SYSCLK
    bool "Use SYSCLK as MCO source"

endchoice

choice
bool "MCO prescaler"
depends on !CLOCK_HAS_NO_MCO_PRE && CLOCK_ENABLE_MCO
default CLOCK_MCO_PRE_1

config CLOCK_MCO_PRE_1
    bool "Divide MCO by 1"

config CLOCK_MCO_PRE_2
    bool "Divide MCO by 2"

config CLOCK_MCO_PRE_4
    bool "Divide MCO by 4"

config CLOCK_MCO_PRE_8
    bool "Divide MCO by 8"

config CLOCK_MCO_PRE_16
    bool "Divide MCO by 16"

config CLOCK_MCO_PRE_32
    bool "Divide MCO by 32"
    depends on CPU_FAM_F0 || CPU_FAM_F1 || CPU_FAM_F3 || CPU_FAM_G0

config CLOCK_MCO_PRE_64
    bool "Divide MCO by 64"
    depends on CPU_FAM_F0 || CPU_FAM_F1 || CPU_FAM_F3 || CPU_FAM_G0

config CLOCK_MCO_PRE_128
    bool "Divide MCO by 128"
    depends on CPU_FAM_F0 || CPU_FAM_F1 || CPU_FAM_F3 || CPU_FAM_G0

endchoice

config CLOCK_MCO_PRE
    int
    default 2 if CLOCK_MCO_PRE_2
    default 4 if CLOCK_MCO_PRE_4
    default 8 if CLOCK_MCO_PRE_8
    default 16 if CLOCK_MCO_PRE_16
    default 32 if CLOCK_MCO_PRE_32
    default 64 if CLOCK_MCO_PRE_64
    default 128 if CLOCK_MCO_PRE_128
    default 1

endif # CPU_FAM_F0 || CPU_FAM_F1 || CPU_FAM_F3 || CPU_FAM_G0 || CPU_FAM_G4 || CPU_FAM_L0 || CPU_FAM_L4 || CPU_FAM_WB || CPU_FAM_WL
```

## cpu/stm32/kconfigs/f1/Kconfig
```kconfig
# SPDX-FileCopyrightText: 2020 Inria
# SPDX-License-Identifier: LGPL-2.1-only

config CPU_FAM_F1
    bool
    select CPU_CORE_CORTEX_M3
    select CPU_STM32

if CPU_FAM_F1

config CPU_FAM
    default "f1"

endif # CPU_FAM_F1
```

## cpu/stm32/kconfigs/f2/Kconfig
```kconfig
# Copyright (c) 2020 Inria
#
# This file is subject to the terms and conditions of the GNU Lesser
# General Public License v2.1. See the file LICENSE in the top level
# directory for more details.
#

config CPU_FAM_F2
    bool
    select CPU_STM32
    select CPU_CORE_CORTEX_M3
    select HAS_CPU_STM32F2
    select HAS_CORTEXM_MPU
    select HAS_PERIPH_HWRNG

config CPU_FAM
    default "f2" if CPU_FAM_F2

config HAS_CPU_STM32F2
    bool
    help
        Indicates that the cpu being used belongs to the 'stm32f2' family.
```

## cpu/stm32/kconfigs/f2/Kconfig.clk
```kconfig
# SPDX-FileCopyrightText: 2022 HAW Hamburg
# SPDX-License-Identifier: LGPL-2.1-only

rsource '../f2f4f7mp1/Kconfig.clk'

if CPU_FAM_F2

config CLOCK_PLL_M
    int "M: PLLIN division factor" if CUSTOM_PLL_PARAMS
    default 4

config CLOCK_PLL_N
    int "N: PLLIN multiply factor" if CUSTOM_PLL_PARAMS
    default 120 if CLOCK_HSE = 8000000
    default 60
    range 50 432

endif # CPU_FAM_F2
```

## cpu/stm32/kconfigs/f2f4f7mp1/Kconfig.clk
```kconfig
# SPDX-FileCopyrightText: 2022 HAW Hamburg
# SPDX-License-Identifier: LGPL-2.1-only

if CPU_FAM_F2 || CPU_FAM_F4 || CPU_FAM_F7 || CPU_FAM_MP1

choice
bool "Main PLL division factor (PLLP) for main system clock" if CUSTOM_PLL_PARAMS
default PLL_P_DIV_4 if CPU_FAM_F4 && CLOCK_MAX_84MHZ
default PLL_P_DIV_2

config PLL_P_DIV_2
    bool "Divide by 2"

config PLL_P_DIV_4
    bool "Divide by 4"

config PLL_P_DIV_6
    bool "Divide by 6"

config PLL_P_DIV_8
    bool "Divide by 8"

endchoice

config CLOCK_PLL_P
    int
    default 3 if CPU_FAM_MP1
    default 2 if PLL_P_DIV_2
    default 4 if PLL_P_DIV_4
    default 6 if PLL_P_DIV_6
    default 8 if PLL_P_DIV_8

config CLOCK_PLL_Q
    int "Main PLL division factor (PLLQ) for USB OTG FS, and SDIO clocks" if CUSTOM_PLL_PARAMS
    default 5 if CPU_FAM_F2
    default 7 if CPU_FAM_F4 && CLOCK_MAX_84MHZ
    default 4 if CPU_FAM_F4 && CLOCK_MAX_100MHZ
    default 7 if CPU_FAM_F4 && CLOCK_MAX_180MHZ && (MODULE_PERIPH_USBDEV_CLK || USEMODULE_PERIPH_USBDEV_CLK) && !HAVE_CLOCK_ALT_48MHZ
    default 9 if CPU_FAM_F7
    default 13 if CPU_FAM_MP1
    default 8
    range 2 15

endif # CPU_FAM_F2 || CPU_FAM_F4 || CPU_FAM_F7 || CPU_FAM_MP1
```

## cpu/stm32/kconfigs/f3/Kconfig
```kconfig
# SPDX-FileCopyrightText: 2020 Inria
# SPDX-License-Identifier: LGPL-2.1-only

config CPU_FAM_F3
    bool
    select CPU_STM32
    select CPU_CORE_CORTEX_M4F

config CPU_FAM
    default "f3" if CPU_FAM_F3
```

## cpu/stm32/kconfigs/f3/Kconfig.clk
```kconfig
# Copyright (c) 2022 HAW Hamburg
#
# This file is subject to the terms and conditions of the GNU Lesser
# General Public License v2.1. See the file LICENSE in the top level
# directory for more details.
#

rsource '../f0f1f3/Kconfig.clk'
```

## cpu/stm32/kconfigs/f4/Kconfig
```kconfig
# Copyright (c) 2020 Inria
#
# This file is subject to the terms and conditions of the GNU Lesser
# General Public License v2.1. See the file LICENSE in the top level
# directory for more details.
#

config CPU_FAM_F4
    bool
    select CPU_STM32
    select CPU_CORE_CORTEX_M4F

config CPU_FAM
    default "f4" if CPU_FAM_F4

config CLOCK_MAX_84MHZ
    bool
    help
        Indicates that the CPU max core clock frequency is 84MHz

config CLOCK_MAX_100MHZ
    bool
    help
        Indicates that the CPU max core clock frequency is 100MHz

config CLOCK_MAX_180MHZ
    bool
    help
        Indicates that the CPU max core clock frequency is 180MHz
```

## cpu/stm32/kconfigs/f4/Kconfig.clk
```kconfig
# SPDX-FileCopyrightText: 2022 HAW Hamburg
# SPDX-License-Identifier: LGPL-2.1-only

rsource '../f2f4f7mp1/Kconfig.clk'

if CPU_FAM_F4

config CLOCK_PLL_M
    int "M: PLLIN division factor" if CUSTOM_PLL_PARAMS
    default 25 if CLOCK_MAX_84MHZ && CLOCK_HSE = 25000000
    default 25 if CLOCK_MAX_100MHZ && CLOCK_HSE = 25000000
    default 12 if CLOCK_MAX_180MHZ && CLOCK_HSE = 16000000
    default 12 if CLOCK_MAX_180MHZ && CLOCK_HSE = 12000000
    default 4

config CLOCK_PLL_N
    int "N: PLLIN multiply factor" if CUSTOM_PLL_PARAMS
    default 168 if CLOCK_MAX_84MHZ && CLOCK_HSE = 8000000
    default 336 if CLOCK_MAX_84MHZ && CLOCK_HSE = 25000000
    default 84 if CLOCK_MAX_84MHZ

    default 96 if CLOCK_MAX_100MHZ && CLOCK_HSE = 8000000 && (MODULE_PERIPH_USBDEV_CLK || USEMODULE_PERIPH_USBDEV_CLK) && !HAVE_CLOCK_ALT_48MHZ
    default 100 if CLOCK_MAX_100MHZ && CLOCK_HSE = 8000000
    default 192 if CLOCK_MAX_100MHZ && CLOCK_HSE = 25000000 && (MODULE_PERIPH_USBDEV_CLK || USEMODULE_PERIPH_USBDEV_CLK) && !HAVE_CLOCK_ALT_48MHZ
    default 200 if CLOCK_MAX_100MHZ && CLOCK_HSE = 25000000
    default 48 if CLOCK_MAX_100MHZ && (MODULE_PERIPH_USBDEV_CLK || USEMODULE_PERIPH_USBDEV_CLK)
    default 50 if CLOCK_MAX_100MHZ

    default 168 if CLOCK_MAX_180MHZ && CLOCK_HSE = 8000000 && (MODULE_PERIPH_USBDEV_CLK || USEMODULE_PERIPH_USBDEV_CLK) && !HAVE_CLOCK_ALT_48MHZ
    default 180 if CLOCK_MAX_180MHZ && CLOCK_HSE = 8000000
    default 336 if CLOCK_MAX_180MHZ && CLOCK_HSE = 12000000 && (MODULE_PERIPH_USBDEV_CLK || USEMODULE_PERIPH_USBDEV_CLK) && !HAVE_CLOCK_ALT_48MHZ
    default 360 if CLOCK_MAX_180MHZ && CLOCK_HSE = 12000000
    default 336 if CLOCK_MAX_180MHZ && CLOCK_HSE = 16000000 && (MODULE_PERIPH_USBDEV_CLK || USEMODULE_PERIPH_USBDEV_CLK) && !HAVE_CLOCK_ALT_48MHZ
    default 360 if CLOCK_MAX_180MHZ && CLOCK_HSE = 16000000
    default 84 if CLOCK_MAX_180MHZ && (MODULE_PERIPH_USBDEV_CLK || USEMODULE_PERIPH_USBDEV_CLK) && !HAVE_CLOCK_ALT_48MHZ
    default 90 if CLOCK_MAX_180MHZ
    range 50 432

endif # CPU_FAM_F4
```
