PROVIDE ( GPIO = 0x60000300);

PROVIDE ( uart0 = 0x60000000 );
PROVIDE ( uart1 = 0x60000f00 );

PROVIDE ( frc1 = 0x60000600 );
PROVIDE ( frc2 = 0x60000620 );

PROVIDE ( rtc_sys_info = 0x60001100 );

PROVIDE ( SLC = 0x60000B00 );
PROVIDE ( I2S = 0x60000e00 );

PROVIDE ( SPI1 = 0x60000100 );
PROVIDE ( SPI0 = 0x60000200 );
