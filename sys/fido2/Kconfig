## sys/net/application_layer/unicoap/Kconfig
```kconfig
menu "CoAP Unified Suite (unicoap)"
    depends on USEMODULE_UNICOAP

    comment "******************"
    comment "SUITE"

    menu "Buffers"

        config UNICOAP_OPTIONS_MAX
            int "Maximum number of options in a message"
            range 0 9999999
            default 16
            help
                Maximum number of options that can be present in a request or response

        config UNICOAP_OPTIONS_BUFFER_DEFAULT_CAPACITY
            int "Default option buffer capacity (bytes)"
            range 0 9999999
            default 32
            help
                Default buffer capacity unicoap chooses when you invoke @ref UNICOAP_OPTIONS_ALLOC

        config UNICOAP_EXTERNAL_TOKEN_LENGTH_MAX
            int "Maximum length of a token received from a client (bytes)"
            range 1 8
            default 8
            help
                External = generated by another node

        config UNICOAP_GENERATED_TOKEN_LENGTH
            int "Length of generated tokens (bytes)"
            range 1 8
            default 2
            help
                Generated = generated by unicoap

    endmenu

    menu "Behaviors"

        config UNICOAP_CREATE_THREAD
            bool "Create dedicated thread for unicoap"
            default y
            help
                When this option is turned on, unicoap_init will call thread_create. The unicoap thread will execute unicoap_loop_run. If you want to run unicoap on another thread (e.g., the main thread), disable this option and call unicoap_loop_run yourself.

        config UNICOAP_DEBUG_LOGGING
            bool "Enable debug logging"
            default n
            help
                When enabled, debug logs are printed. Helps trace messages through layers.

        config UNICOAP_ASSIST
            bool "Enable assistant (API misuse, warnings, fixits)"
            default n
            help
                When enabled, helpful warnings and error explanations are printed to stdout. Disable this setting and enable link-time optimization to strip logic from application binary. Enables safety measures in the parser and client and server API. Trades safety for performance due to added conditional statements.

        config UNICOAP_PREVENT_OPTIONAL_RESPONSES
            bool "Prevent sending optional responses"
            default n
            help
                Server only. Prevents unicoap from sending a response if optional, as indicated by the No-Response option. If enabled, responses prepared by the application will be disregarded and not sent.

        config UNICOAP_SOCK_ZERO_COPY_GUARANTEES
            bool "Zero-copy sock guarantees"
            help
                 If enabled, guarantees @ref sock_udp_recv_buf never returns fragmented data, i.e., the entire datagram is always fully retrieved after the first call to @ref sock_udp_recv_buf. Default value: gnrc_sock_udp is used.

        config UNICOAP_GET_LOCAL_ENDPOINTS
            bool "Retrieve local endpoint"
            default y
            help
                 Instructs the transport drivers to retrieve the local endpoint a PDU arrives at.

    endmenu

    comment "******************"
    comment "EXTENSIONS"

    menu "Resource Observation"

        config UNICOAP_OBSERVE_VALUE_WIDTH
            int "Observe option value width (bytes)"
            range 1 3
            default 3

    endmenu

    comment "******************"
    comment "DRIVERS"

        menu "RFC 7252 messaging (CoAP over UDP and DTLS common)"

        comment "******************"
        comment "BUFFERS"

        config UNICOAP_RFC7252_TRANSMISSIONS_MAX
            int "Maximum number of parallel RFC 7252 (re-)transmissions"
            range 0 9999999
            default 2
            help
                  Maximum number of parallel message IDs that are sent and watched for reset and acknowledgment messages. Must not exceed CONFIG_UNICOAP_MEMOS_MAX.

        config UNICOAP_CARBON_COPIES_MAX
            int "Carbon copies: Maximum number of PDU copies for retransmissions (and piggybacked ACKs in deduplication)"
            range 0 9999999
            default 2
            help
                 Used for retransmitting CON messages, and storing ACK messages when deduplicating.

        comment "******************"
        comment "TIMING"

        config UNICOAP_TIMEOUT_ACK_MS
            int "ACK timeout -> retransmission"
            range 1 9999999
            default 2000
            help
                 Initial ACK timeout after which a given message will be retransmitted.

        config UNICOAP_RANDOM_FACTOR_1000
            int "ACK timeout upper bound factor * 1000"
            range 1000 9999999
            default 1500
            help
                This represents the ACK_RANDOM_FACTOR (RFC 7252, section 4.2, https://tools.ietf.org/html/rfc7252#section-4.2) multiplied by 1000, to avoid floating point arithmetic.

        config UNICOAP_RETRANSMISSIONS_MAX
            int "Maximum retransmissions"
            range 1 32
            default 4
            help
                 Maximum number of retransmissions of a confirmable message

    endmenu

    menu "CoAP over UDP"
        config UNICOAP_UDP_PORT
            int "UDP port"
            default 5683
            range 1 65535
    endmenu

    menu "CoAP over DTLS"
        config UNICOAP_DTLS_PORT
            int "DTLS port"
            default 5684
            range 1 65535

        config UNICOAP_DTLS_HANDSHAKE_TIMEOUT_MS
            int "DTLS handshake timeout (ms)"
            range 0 9999999
            default 3000
            help
                 Timeout for the DTLS handshake process. Set to 0 for infinite time.

        config UNICOAP_DTLS_MINIMUM_AVAILABLE_SESSION_SLOTS
            int "DTLS minimum number of available sessions at any time"
            range 0 9999999
            default 1
            help
                 Number of minimum available sessions. If the count of available sessions falls below this threshold, the oldest used session will be closed after a timeout time. Set to 0 to deactivate this feature.

        config UNICOAP_DTLS_MINIMUM_AVAILABLE_SESSIONS_TIMEOUT_MS
            int "DTLS session triage timeout (ms)"
            range 0 9999999
            default 15000
            help
                 Timeout for freeing up a session when minimum number of available sessions is not given.
    endmenu


    # unicoap_driver_extension_point

endmenu # unicoap
```

## sys/net/crosslayer/netopt/Kconfig
```kconfig
# Copyright (c) 2022 HAW Hamburg
#
# This file is subject to the terms and conditions of the GNU Lesser
# General Public License v2.1. See the file LICENSE in the top level
# directory for more details.
#

config MODULE_NETOPT
    bool
    depends on TEST_KCONFIG
    help
        Functionalities to map netopt option numbers to strings.
```

## sys/net/gnrc/application_layer/dhcpv6/Kconfig
```kconfig
menuconfig KCONFIG_USEMODULE_GNRC_DHCPV6
    bool "Configure GNRC-part of DHCPv6"
    depends on USEMODULE_GNRC_DHCPV6
    help
        Configure GNRC-part of DHCPv6 via Kconfig.

if KCONFIG_USEMODULE_GNRC_DHCPV6

if USEMODULE_GNRC_DHCPV6_CLIENT_6LBR
config GNRC_DHCPV6_CLIENT_6LBR_UPSTREAM
    int "Identifier for the upstream interface of the 6LoWPAN border router"
    default 0
    help
        Leave 0 to let the client pick the first non-6LoWPAN interface it finds

config GNRC_DHCPV6_CLIENT_6LBR_6LO_CTX_MIN
    int "6LoWPAN compression context lifetime for configured prefixes in minutes"
    default 60
    range 1 255
    help
        @see [RFC 6775, section 4.2](https://tools.ietf.org/html/rfc6775#section-4.2)


config GNRC_DHCPV6_CLIENT_6LBR_STATIC_ROUTE
    bool "Use static routes to upstream interface"
    help
        If set to 1 the border router will be configured to have a default
        route via `fe80::1`. The link-local address `fe80::2` will be added so
        that the upstream router can set a static route for the delegated
        prefix via that address. It is recommended to increase at least @ref
        CONFIG_GNRC_NETIF_IPV6_ADDRS_NUMOF to that end.
endif # USEMODULE_GNRC_DHCPV6_CLIENT_6LBR

endif # KCONFIG_USEMODULE_GNRC_DHCPV6
```
