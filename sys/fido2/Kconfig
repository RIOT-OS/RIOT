## sys/fido2/Kconfig
```kconfig
# SPDX-FileCopyrightText: 2021 Freie Universität Berlin
# SPDX-License-Identifier: LGPL-2.1-only

if USEMODULE_FIDO2

rsource "ctap/Kconfig"

endif # USEMODULE_FIDO2
```

## sys/fido2/ctap/Kconfig
```kconfig
# Copyright (C) 2021 Freie Universität Berlin
#
# This file is subject to the terms and conditions of the GNU Lesser
# General Public License v2.1. See the file LICENSE in the top level
# directory for more details.


if USEMODULE_FIDO2_CTAP

config FIDO2_CTAP_STACK_SIZE
    int "CTAP thread stack size"
    default 15000

config FIDO2_CTAP_DEVICE_AAGUID
    string "AAGUID of the CTAP authenticator"
    default "9c295865fa2c36b705a42320af9c8f16"
    help
        The AAGUID is identifying the type of the authenticator (e.g manufacturer
        and model). The AAGUID needs to be 128 bits long. The default value here
        is a fallback value that was randomly generated.

config FIDO2_CTAP_DISABLE_UP
    bool "Disable user presence tests"
    help
        When set, the authenticator will not ask for permission before creating
        a new credential pair or authenticating.

config FIDO2_CTAP_DISABLE_LED
    bool "Disable LED animations"
    help
        When set, the authenticator will not use LED's.

config FIDO2_CTAP_UP_TIMEOUT
    int "Seconds until user presence test times out"
    default 15

config FIDO2_CTAP_UP_BUTTON_PORT
    int "Port of user presence button"
    depends on !FIDO2_CTAP_DISABLE_UP
    default -1

config FIDO2_CTAP_UP_BUTTON_PIN
    int "Pin of user presence button"
    depends on !FIDO2_CTAP_DISABLE_UP
    default -1

choice
    bool "User presence button mode"
    depends on !FIDO2_CTAP_DISABLE_UP
    default FIDO2_CTAP_UP_BUTTON_MODE_IN_PU

config FIDO2_CTAP_UP_BUTTON_MODE_IN_PU
    bool "GPIO_IN_PU"
    help
        Configure as input with pull-up resistor

config FIDO2_CTAP_UP_BUTTON_MODE_IN_PD
    bool "GPIO_IN_PD"
    help
        Configure as input with pull-down resistor

config FIDO2_CTAP_UP_BUTTON_MODE_IN
    bool "GPIO_IN"
    help
        Configure as input without pull resistor

endchoice

choice
    bool "User presence button pin flank"
    depends on !FIDO2_CTAP_DISABLE_UP
    default FIDO2_CTAP_UP_BUTTON_FLANK_FALLING

config FIDO2_CTAP_UP_BUTTON_FLANK_FALLING
    bool "GPIO_FALLING"

config FIDO2_CTAP_UP_BUTTON_FLANK_RISING
    bool "GPIO_RISING"

endchoice

config FIDO2_CTAP_NUM_FLASHPAGES
    int "Amount of flashpages to use"
    range 2 256
    default 4
    help
        Configure how many flashpages are used to store FIDO2 CTAP data.

        To save a credential (rk) in flash memory, roughly 156 bytes are needed. This
        number might change slightly depending on the flash block size.
        Therefore, if one wants to e.g. save 40 credentials and the flashpage
        size is 4096 bytes roughly 156 * 40 / 4096 (2) flashpages are needed.
        To save authenticator state data one additional flashpage is needed.
        So in total one has to configure 3 to save 40 credentials.

rsource "transport/Kconfig"

endif # USEMODULE_FIDO2_CTAP
```

## sys/fido2/ctap/transport/Kconfig
```kconfig
# SPDX-FileCopyrightText: 2021 Freie Universität Berlin
# SPDX-License-Identifier: LGPL-2.1-only

rsource "hid/Kconfig"
```

## sys/fido2/ctap/transport/hid/Kconfig
```kconfig
# SPDX-FileCopyrightText: 2021 Freie Universität Berlin
# SPDX-License-Identifier: LGPL-2.1-only

if USEMODULE_FIDO2_CTAP_TRANSPORT_HID

config FIDO2_CTAP_TRANSPORT_HID_TRANSACTION_TIMEOUT
    int "CTAPHID Transaction timeout in milliseconds"
    default 500
    help
        A CTAPHID transaction has to be completed within a specified period
        of time to prevent the authenticator from being locked by a
        stalling application.

endif # USEMODULE_FIDO2_CTAP_TRANSPORT_HID
```

## sys/fmt/Kconfig
```kconfig
# Copyright (c) 2020 HAW Hamburg
#
# This file is subject to the terms and conditions of the GNU Lesser
# General Public License v2.1. See the file LICENSE in the top level
# directory for more details.
#

menuconfig MODULE_FMT
    bool "String formatting"

config MODULE_FMT_TABLE
    bool "Table extension"
    depends on MODULE_FMT
```

## sys/fs/devfs/Kconfig
```kconfig
# Copyright (c) 2021 HAW Hamburg
#
# This file is subject to the terms and conditions of the GNU Lesser
# General Public License v2.1. See the file LICENSE in the top level
# directory for more details.
#

menuconfig MODULE_DEVFS
    bool "DevFS support"
    depends on MODULE_VFS
    help
        This file system implementation allows devices to register file names
        for easier access to device drivers from shell commands etc. The idea is
        similar to the /dev directory on Unix.

if MODULE_DEVFS

config MODULE_DEVFS_HWRNG
    bool "Add HWRNG device"
    depends on HAS_PERIPH_HWRNG
    select MODULE_PERIPH_HWRNG
    help
      Adds the hardware random number generator (HWRNG) as a device
      (/dev/hwrng).

config MODULE_DEVFS_RANDOM
    bool "Add random device"
    select MODULE_RANDOM
    help
      Adds a device to generate random (/dev/urandom).

endif # MODULE_DEVFS
```

## sys/fs/mountfs/Kconfig
```kconfig
# Copyright (c) 2022 ML!PA Consulting GmbH
#
# This file is subject to the terms and conditions of the GNU Lesser
# General Public License v2.1. See the file LICENSE in the top level
# directory for more details.
#

config MODULE_MOUNTFS
    bool "MountFS support"
    help
      MountFS static file system.
```

## sys/hashes/psa_riot_hashes/Kconfig
```kconfig
# Copyright (c) 2021 HAW Hamburg
#
# This file is subject to the terms and conditions of the GNU Lesser
# General Public License v2.1. See the file LICENSE in the top level
# directory for more details.
#

config MODULE_PSA_RIOT_HASHES_MD5
    bool
    depends on MODULE_PSA_CRYPTO
    select MODULE_PSA_RIOT_HASHES
    select MODULE_HASHES

config MODULE_PSA_RIOT_HASHES_SHA_1
    bool
    depends on MODULE_PSA_CRYPTO
    select MODULE_PSA_RIOT_HASHES
    select MODULE_HASHES

config MODULE_PSA_RIOT_HASHES_SHA_224
    bool
    depends on MODULE_PSA_CRYPTO
    select MODULE_PSA_RIOT_HASHES
    select MODULE_HASHES

config MODULE_PSA_RIOT_HASHES_SHA_256
    bool
    depends on MODULE_PSA_CRYPTO
    select MODULE_PSA_RIOT_HASHES
    select MODULE_HASHES

config MODULE_PSA_RIOT_HASHES_HMAC_SHA256
    bool
    depends on MODULE_PSA_CRYPTO
    select MODULE_PSA_RIOT_HASHES
    select MODULE_HASHES

config MODULE_PSA_RIOT_HASHES
    bool
```

## sys/iolist/Kconfig
```kconfig
# Copyright (c) 2021 HAW Hamburg
#
# This file is subject to the terms and conditions of the GNU Lesser
# General Public License v2.1. See the file LICENSE in the top level
# directory for more details.
#

config MODULE_IOLIST
    bool "iolist scatter / gather IO"
    depends on TEST_KCONFIG
```

## sys/isrpipe/Kconfig
```kconfig
# Copyright (c) 2020 HAW Hamburg
#
# This file is subject to the terms and conditions of the GNU Lesser
# General Public License v2.1. See the file LICENSE in the top level
# directory for more details.
#

config MOD_ISRPIPE
    bool "ISR Pipe module"
    select MOD_TSRB

config MOD_ISRPIPE_READ_TIMEOUT
    bool "ISR Pipe read with timeout"
    depends on MOD_ISRPIPE && MOD_XTIMER
```

## sys/log/Kconfig
```kconfig
# Copyright (c) 2021 HAW Hamburg
#
# This file is subject to the terms and conditions of the GNU Lesser
# General Public License v2.1. See the file LICENSE in the top level
# directory for more details.
#

choice
  bool "Logging system override"
  optional
  depends on TEST_KCONFIG
  help
    Say y to override the default logging functions. For more information see
    core/include/log.h.

config MODULE_LOG_COLOR
    bool "Colored output"
    select MODULE_LOG
    help
      Implements a logging module with colored output.

config MODULE_LOG_PRINTFNOFORMAT
    bool "puts-based log"
    select MODULE_LOG
    help
      Logging is implemented using puts instead of printf. Use it where printf
      might be too heavy. This also serves as an example for logging
      implementation.

endchoice

config MODULE_LOG
    bool
    help
        Modules that override the default log implementation shoul select this.
        For more information see core/include/log.h.
```

## sys/log_color/Kconfig
```kconfig
# Copyright (c) 2019 HAW Hamburg
#
# This file is subject to the terms and conditions of the GNU Lesser
# General Public License v2.1. See the file LICENSE in the top level
# directory for more details.
#
choice LOG
#the choice prompt is described in sys/Kconfig

config MODULE_LOG_COLOR
    bool "log_color: colored log output"
    select MODULE_LOG
    # log_color fails to compile with -Wformat-nonliteral but this is required
    # for the wrapped stdio that pushes the format string into progmem
    depends on !CPU_ARCH_AVR8
    help
      Implements a logging module with colored output.

endchoice
```

## sys/log_printfnoformat/Kconfig
```kconfig
# Copyright (c) 2019 HAW Hamburg
#
# This file is subject to the terms and conditions of the GNU Lesser
# General Public License v2.1. See the file LICENSE in the top level
# directory for more details.
#
choice LOG
#the choice prompt is described in sys/Kconfig

config MODULE_LOG_PRINTFNOFORMAT
    bool "log_printfnoformat: puts-based log"
    select MODULE_LOG
    help
      Logging is implemented using puts instead of printf. Use it where printf
      might be too heavy. This also serves as an example for logging
      implementation.

endchoice
```

## sys/luid/Kconfig
```kconfig
# Copyright (c) 2021 HAW Hamburg
#
# This file is subject to the terms and conditions of the GNU Lesser
# General Public License v2.1. See the file LICENSE in the top level
# directory for more details.
#

config MODULE_LUID
    bool "Locally Unique ID Generator"
    depends on TEST_KCONFIG
    select MODULE_PERIPH_CPUID if HAS_PERIPH_CPUID
```

## sys/net/application_layer/Kconfig.coap
```kconfig
# Copyright (c) 2020 HAW Hamburg
#
# This file is subject to the terms and conditions of the GNU Lesser
# General Public License v2.1. See the file LICENSE in the top level
# directory for more details.
#

menu "CoAP generic options"
    depends on USEMODULE_NANOCOAP || USEMODULE_GCOAP

config COAP_ACK_TIMEOUT_MS
    int "Timeout in milliseconds for a response to a confirmable request"
    default 2000
    help
        This value is for the response to the initial confirmable message. The
        timeout doubles for subsequent retries. To avoid synchronization of
        resends across hosts, the actual timeout is chosen randomly between
        @ref CONFIG_COAP_ACK_TIMEOUT_MS and
        (@ref CONFIG_COAP_ACK_TIMEOUT_MS * @ref CONFIG_COAP_RANDOM_FACTOR_1000 / 1000).
        The default of 2 seconds is taken from
        [RFC 7252, section 4.8](https://tools.ietf.org/html/rfc7252#section-4.8).

config COAP_RANDOM_FACTOR_1000
    int "Timeout random factor (multiplied by 1000)"
    default 1500
    help
        This value is used to calculate the upper bound for the timeout. It
        represents the `ACK_RANDOM_FACTOR`
        ([RFC 7252, section 4.2](https://tools.ietf.org/html/rfc7252#section-4.2))
        multiplied by 1000, to avoid floating point arithmetic.
        The default that represents 1.5 seconds is taken from
        The default of 2 seconds is taken from
        [RFC 7252, section 4.8](https://tools.ietf.org/html/rfc7252#section-4.8).

config COAP_MAX_RETRANSMIT
    int "Maximum number of retransmissions"
    default 4
    help
        Maximum number of retransmissions for a confirmable request. The default
        of 4 retransmissions is taken from
        [RFC 7252, section 4.8](https://tools.ietf.org/html/rfc7252#section-4.8).

endmenu # CoAP generic options
```

## sys/net/application_layer/asymcute/Kconfig
```kconfig
# Copyright (c) 2020 Freie Universitaet Berlin
#
# This file is subject to the terms and conditions of the GNU Lesser
# General Public License v2.1. See the file LICENSE in the top level
# directory for more details.
#
menu "Asymcute"
    depends on USEMODULE_ASYMCUTE

config ASYMCUTE_DEFAULT_PORT
    int "Default UDP port to listen on"
    default 1883
    help
        Default UDP port to listen on (also used as SRC port). This will write
        to macro 'CONFIG_ASYMCUTE_DEFAULT_PORT'. Usage can be found in
        examples/asymcute_mqttsn

config ASYMCUTE_BUFSIZE
    int "Size of buffer used for receive and request buffers"
    default 128

config ASYMCUTE_TOPIC_MAXLEN
    int "Maximum topic length"
    default 32
    help
        Configure maximum length for clients topic. The value must be less than
        (256 - 8) and less than ('CONFIG_ASYMCUTE_BUFSIZE' - 8).

config ASYMCUTE_KEEPALIVE
    int "Keep alive interval in seconds"
    range 300 $(UINT32_MAX)
    default 360
    help
        Configure 'CONFIG_ASYMCUTE_KEEPALIVE', keep alive interval in seconds
        which is communicated to the gateway in the CONNECT message. For more
        information, see MQTT-SN Spec v1.2, section 5.4.4. For default values,
        see section 7.2 -> TWAIT: > 5 min. Default value is 360 seconds which
        corresponds to 6 minutes.

config ASYMCUTE_KEEPALIVE_PING_EN
    bool "Enable configuration of keep alive ping"
    help
        Enable configuration of 'CONFIG_ASYMCUTE_KEEPALIVE_PING', keep alive
        ping interval. If not enabled, 'CONFIG_ASYMCUTE_KEEPALIVE_PING' will
        default to three quarters of 'CONFIG_ASYMCUTE_KEEPALIVE', keep alive
        interval.

config ASYMCUTE_KEEPALIVE_PING
    int "Keep alive ping interval in seconds"
    default 270
    depends on ASYMCUTE_KEEPALIVE_PING_EN
    help
        Configure 'CONFIG_ASYMCUTE_KEEPALIVE_PING', interval used by client for
        sending periodic keep alive ping messages to the gateway. The value must
        be less than 'CONFIG_ASYMCUTE_KEEPALIVE'.

config ASYMCUTE_T_RETRY
    int "Retry timer in seconds"
    range 10 15
    default 10
    help
        Configure 'CONFIG_ASYMCUTE_T_RETRY', interval used for timing the retry
        messages which are sent when the expected reply from GW is not received.
        The retry timer is started by the client when the message is sent and
        stopped when the expected reply from GW is received. If the timer times
        out and the expected GW’s reply is not received, the client retransmits
        the message. For more information, see MQTT-SN Spec v1.2, section 6.13.
        For default values, see section 7.2 -> Tretry: 10 to 15 sec.

config ASYMCUTE_N_RETRY
    int "Maximum number of retransmissions"
    range 3 5
    default 3
    help
        Configure 'CONFIG_ASYMCUTE_N_RETRY',the maximum number of retransmissions
        in the event that the retry timer times out. After 'CONFIG_ASYMCUTE_N_RETRY'
        number of retransmissions, the client aborts the procedure and assumes
        that its MQTT-SN connection to the gateway is disconnected. For more
        information, see MQTT-SN Spec v1.2, section 6.13. For default values,
        see section 7.2 -> Nretry: 3-5.

endmenu # Asymcute
```
