## sys/net/application_layer/cord/Kconfig
```kconfig
# Copyright (c) 2020 Freie Universitaet Berlin
#
# This file is subject to the terms and conditions of the GNU Lesser
# General Public License v2.1. See the file LICENSE in the top level
# directory for more details.
#
menu "CoRE RD client"
    depends on USEMODULE_CORD_COMMON

config CORD_LT
    int "CORD client lifetime in seconds"
    default 86400
    help
        Configure 'CONFIG_CORD_LT', client lifetime in seconds. The default
        value of 86400 seconds corresponds to 1 day.

config CORD_UPDATE_INTERVAL_EN
    bool "Enable configuration of RD client update interval"
    help
        Enable configuration of RD Client update interval. If not enabled, CORD
        update interval will default to 3/4th the value of CORD client lifetime
        ('CONFIG_CORD_LT').

config CORD_UPDATE_INTERVAL
    int "CORD client update interval in seconds"
    default 64800
    depends on CORD_UPDATE_INTERVAL_EN
    help
        Configure CORD client update interval in seconds.

config CORD_EP_EN
    bool "Enable configuration of node's endpoint ID"
    help
        Enable configuration of nodes endpoint name. If not enabled, the ID is
        generated by concatenation of 'CORD_EP_PREFIX', default value is 'RIOT-'
        , and a locally unique ID (luid) encoded in hexadecimal formatting with
        the given length of characters 'CORD_EP_SUFFIX_LEN', default value is
        16.

config CORD_EP
    string "Node's endpoint ID"
    default "MyNewEpName"
    depends on CORD_EP_EN
    help
        Configure node's endpoint ID.

endmenu # CoRE RD client
```

## sys/net/application_layer/dhcpv6/Kconfig
```kconfig
# Copyright (c) 2020 Freie Universitaet Berlin
#
# This file is subject to the terms and conditions of the GNU Lesser
# General Public License v2.1. See the file LICENSE in the top level
# directory for more details.
#

menu "DHCPv6"
    depends on USEMODULE_DHCPV6

menu "DHCPv6 client"
    depends on USEMODULE_DHCPV6_CLIENT

config DHCPV6_CLIENT_ADDR_LEASE_MAX
    int "Maximum number of leases to be stored"
    default 1

config DHCPV6_CLIENT_PFX_LEASE_MAX
    int "Maximum number of prefix leases to be stored"
    default 1

menu "DHCPv6 Client MUD URL"
    depends on USEMODULE_DHCPV6_CLIENT_MUD_URL

config DHCPV6_CLIENT_MUD_URL
    string "URL pointing to a Manufacturer Usage Description file"

endmenu # DHCPv6 Client MUD URL
endmenu # DHCPv6 client

menu "DHCPv6 relay agent"
    depends on USEMODULE_DHCPV6_RELAY

config DHCPV6_RELAY_HOP_LIMIT
    int "Maximum hop count in relay-forward message (HOP_COUNT_LIMIT)"
    default 8

config DHCPV6_RELAY_BUFLEN
    int "Default length of relay agent send and receive buffer"
    default 256

endmenu # DHCPv6 relay agent
endmenu # DHCPv6
```

## sys/net/application_layer/emcute/Kconfig
```kconfig
# Copyright (c) 2020 Freie Universitaet Berlin
#
# This file is subject to the terms and conditions of the GNU Lesser
# General Public License v2.1. See the file LICENSE in the top level
# directory for more details.
#
menu "EMCUTE"
    depends on USEMODULE_EMCUTE

config EMCUTE_DEFAULT_PORT
    int "Default UDP port to listen on"
    default 1883
    help
        Default UDP port to listen on (also used as SRC port). This will write
        to macro 'CONFIG_EMCUTE_DEFAULT_PORT'. Usage can be found in
        examples/emcute_mqttsn.

config EMCUTE_BUFSIZE
    int "Buffer size used for TX and RX buffers"
    range 1 32768 if HAS_ARCH_16BIT || HAS_ARCH_8BIT
    default 512
    help
        Configure the size of buffer used for TX and RX. The buffer size MUST be
        less than 32768 on 16-bit and 8-bit platforms to prevent buffer
        overflows.

config EMCUTE_TOPIC_MAXLEN
    int "Maximum topic length"
    default 196
    help
        Configure maximum length for client's topic. The value must be less than
        (256 - 6) and less than ('CONFIG_EMCUTE_BUFSIZE' - 6).

config EMCUTE_KEEPALIVE
    int "Keep alive interval in seconds"
    range 300 $(UINT32_MAX)
    default 360
    help
        Configure keep alive interval in seconds. The node will communicate this
        interval to the gateway send a ping message every time when this amount
        of time has passed. For more information, see MQTT-SN Spec v1.2, section
        5.4.4. For default values, see section 7.2 -> TWAIT: > 5 min. Default
        value is 360 seconds which corresponds to 6 minutes.

config EMCUTE_T_RETRY
    int "Retry timer in seconds"
    range 10 15
    default 15
    help
        Configure re-send interval used for timing the retry messages which are
        sent when the expected reply from GW is not received. The retry timer is
        started by the client when the message is sent and stopped when the
        expected reply from GW is received. If the timer times out and the
        expected GW’s reply is not received, the client retransmits the message.
        For more information, see MQTT-SN Spec v1.2, section 6.13. For default
        values, see section 7.2 -> Tretry: 10 to 15 sec.

config EMCUTE_N_RETRY
    int "Maximum number of retransmissions"
    range 3 5
    default 3
    help
        Configure 'CONFIG_EMCUTE_N_RETRY',the maximum number of retransmissions
        in the event that the retry timer times out. After
        'CONFIG_EMCUTE_N_RETRY' number of retransmissions, the client aborts the
        procedure and assumes that its MQTT-SN connection to the gateway is
        disconnected. For more information, see MQTT-SN Spec v1.2, section 6.13.
        For default values, see section 7.2 -> Nretry: 3-5.

endmenu # EMCUTE
```

## sys/net/application_layer/gcoap/Kconfig
```kconfig
# Copyright (c) 2019 HAW Hamburg
#
# This file is subject to the terms and conditions of the GNU Lesser
# General Public License v2.1. See the file LICENSE in the top level
# directory for more details.
#
menu "GCoAP"
    depends on USEMODULE_GCOAP

menu "forward proxy"
    depends on USEMODULE_GCOAP_FORWARD_PROXY

config GCOAP_FORWARD_PROXY_EMPTY_ACK_MS
    int "Timeout in milliseconds for the forward proxy to send an empty ACK without response"
    default 1500

endmenu # forward proxy

menu "DNS-over-CoAPS implementation in GCoAP"
    depends on USEMODULE_GCOAP_DNS

config GCOAP_DNS_SERVER_URI_LEN
    int "Maximum length of the URI template for the DNS server"
    default 64
    range 9 65535  # 14 == len("coaps:///")

config GCOAP_DNS_CREDS_MAX
    int "Maximum number of credentials that can be added with @ref gcoap_dns_cred_add()"
    default 1 if USEMODULE_GCOAP_DTLS
    default 0

config GCOAP_DNS_PDU_BUF_SIZE
    int "Size of the buffer used to build a CoAP request"
    default 128

config GCOAP_DNS_BLOCK_SIZE
    int "Block-size used for requests (both Block2 control and Block1)"
    default 64
    help
        Should be less than @ref CONFIG_GCOAP_DNS_PDU_BUF_SIZE or
        @ref CONFIG_GCOAP_PDU_BUF_SIZE and must be a power

endmenu # DNS-over-CoAPS implementation in GCoAP

menu "DTLS options"

config GCOAP_DTLS_CREDENTIAL_TAG
    int "Credential tag"
    default 5
    range 0 65535
    help
        DTLS credential tag to determine, which credential to use for
        authentication.

config GCOAP_DTLS_HANDSHAKE_TIMEOUT_USEC
    int "DTLS handshake timeout in microseconds"
    default 4000000
    help
        Time, expressed in microseconds, that the DTLS send function waits for
        a handshake process and the send process itself to complete.

config GCOAP_DTLS_MINIMUM_AVAILABLE_SESSIONS
    int "Minimum number of available sessions"
    default 1
    help
        Number of sessions that should be kept free. If the count of free
        sessions falls below this threshold, oldest used sessions will be closed
        after a timeout time.

config GCOAP_DTLS_MINIMUM_AVAILABLE_SESSIONS_TIMEOUT_USEC
    int "DTLS session slot automatic free up timeout in microseconds"
    default 3000000
    help
        Time, expressed in microseconds. When the last session slot is occupied
        this time indicates when a session will be freed up automatically.

        Prevents that the server can be blocked by lack of available session
        slots and not properly closed sessions.

endmenu # DTLS options

config GCOAP_PDU_BUF_SIZE
    int "Request or response buffer size"
    default 128
    help
        Size of the buffer used to build a CoAP request or response.

menu "Observe options"

config GCOAP_OBS_CLIENTS_MAX
    int "Maximum number of Observe clients"
    default 2

config GCOAP_OBS_REGISTRATIONS_MAX
    int "Maximum number of registrations for Observable resources"
    default 2

config GCOAP_OBS_VALUE_WIDTH
    int "Width of the Observe option value for a notification"
    default 3
    range 1 3
    help
        This width, expressed in bytes, is used to determine the length of the
        'tick' used to measure the time between observable changes to a
        resource. A tick is expressed internally as GCOAP_OBS_TICK_EXPONENT,
        which is the base 2 log value of the tick length in microseconds.

        The canonical setting for the value is 3 (exponent 5), which results in
        a tick length of 32 usec, per sec. 3.4, 4.4 of the RFC. Width 2
        (exponent 16) results in a tick length of ~64 msec, and width 1
        (exponent 24) results in a tick length of ~17 sec.

        The tick length must be short enough so that the Observe value strictly
        increases for each new notification. The purpose of the value is to
        allow a client to detect message reordering withing the network latency
        period (128 sec). For resources that change slowly, the reduced
        message length is useful when packet size is limited.

endmenu # Observe options

menu "Timeouts and retries"

config GCOAP_RECV_TIMEOUT
    int "Incoming message timeout"
    default 1000000
    help
        Time, expressed in microseconds, that the event loop waits for an
        incoming CoAP message.

config GCOAP_NON_TIMEOUT
    int "Non-confirmable response timeout"
    default 5000000
    help
        Time, expressed in microseconds, to wait for a non-confirmable
        response. Set to 0 to disable timeout.

config GCOAP_NO_RETRANS_BACKOFF
    bool "Disable retransmission backoff"
    help
        In normal operations the timeout between retransmissions doubles.
        When this option is selected the doubling does not happen, as the
        retransmission backoff is disabled.

config GCOAP_RESEND_BUFS_MAX
    int "PDU buffers available for resending confirmable messages"
    default 1

endmenu # Timeouts and retries

config GCOAP_MSG_QUEUE_SIZE
    int "Message queue size"
    default 4

config GCOAP_PORT
    int "Server port"
    default 5683
    help
        Server port, the default is the one specified in RFC 7252.

config GCOAPS_PORT
    int "Secured server port"
    default 5684
    help
        Server port for secured connections, the default is the one specified in
        RFC 7252.

config GCOAP_REQ_WAITING_MAX
    int "Maximum awaiting requests"
    default 2
    help
       Maximum amount of requests awaiting for a response.

# defined in gcoap.h as GCOAP_TOKENLEN_MAX
gcoap-tokenlen-max = 8

config GCOAP_TOKENLEN
    int "Token length"
    default 2
    range 0 $(gcoap-tokenlen-max)
    help
        Length for a token, expressed in bytes.

config GCOAP_NO_AUTO_INIT
    bool "Disable auto-initialization"
    help
        Disable gcoap startup during system auto init. If disabled,
        gcoap_init() must be called by some other means.

endmenu # GCoAP
```

## sys/net/application_layer/nanocoap/Kconfig
```kconfig
# Copyright (c) 2020 HAW Hamburg
#
# This file is subject to the terms and conditions of the GNU Lesser
# General Public License v2.1. See the file LICENSE in the top level
# directory for more details.
#

menu "nanoCoAP"
    depends on USEMODULE_NANOCOAP

config NANOCOAP_NOPTS_MAX
    int "Maximum number of options in a message"
    default 16

config NANOCOAP_URI_MAX
    int "Maximum length of a resource path"
    default 64
    help
        Maximum length of a resource path string read from or written to a
        message.

config NANOCOAP_BLOCK_SIZE_EXP_MAX
    int "Maximum size for a blockwise fransfer (as exponent of 2^n)"
    default 6

config NANOCOAP_QS_MAX
    int "Maximum length of a query string written to a message"
    default 64

menu "nanoCoAP Cache module"
    depends on USEMODULE_NANOCOAP_CACHE

config NANOCOAP_CACHE_ENTRIES
    int "Number of maximum cache entries"
    default 8

config NANOCOAP_CACHE_KEY_LENGTH
    int "The length of the cache key in bytes"
    default 8

config NANOCOAP_CACHE_RESPONSE_SIZE
    int "Size of the buffer to store responses in the cache"
    default 128

endmenu # nanoCoAP Cache module

endmenu # nanoCoAP
```
