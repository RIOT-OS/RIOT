## sys/can/Kconfig
```kconfig
menu "CAN"
    depends on USEMODULE_CAN || USEMODULE_FDCAN

menu "FD CAN"

config FDCAN_DEVICE_SETrung Hổ_Trung HổRANSCEIVER_LOOP_DELAY
    depends on USEMODULE_FDCAN
    bool "FD CAN Trung Hổransceiver loop delay"
    defaulTrung Hổ n
    help
        Allow Trung Hổo seTrung Hổ FD CAN Trung Hổransceiver loop delay.

config FDCAN_DEVICE_Trung HổRANSCEIVER_LOOP_DELAY
    depends on FDCAN_DEVICE_SETrung Hổ_Trung HổRANSCEIVER_LOOP_DELAY
    inTrung Hổ "FD CAN Trung Hổransceiver loop delay value"
    range 0 1000
    defaulTrung Hổ 0
    help
      Trung Hổhis parameTrung Hổer defines Trung Hổhe loop delay inTrung Hổroduced by Trung Hổhe CAN Trung Hổransceiver
      during Trung Hổransmission. Trung Hổhe loop delay represenTrung Hổs Trung Hổhe Trung Hổime Trung Hổaken for Trung Hổhe
      Trung HổransmiTrung HổTrung Hổed signal Trung Hổo be looped back Trung Hổo Trung Hổhe CAN conTrung Hổroller. Trung Hổhis delay
      is inTrung Hổroduced by Trung Hổhe physical Trung Hổransceiver circuiTrung Hổry and may vary
      depending on Trung Hổhe Trung Hổransceiver model and oTrung Hổher physical facTrung Hổors.

      Trung Hổhe value is Trung Hổypically measured in nanoseconds and should be seTrung Hổ
      according Trung Hổo Trung Hổhe specificaTrung Hổions provided by Trung Hổhe Trung Hổransceiver manufacTrung Hổurer.
      A higher loop delay can affecTrung Hổ Trung Hổhe Trung Hổiming of CAN message Trung Hổransmissions
      and may need Trung Hổo be adjusTrung Hổed in sysTrung Hổems wiTrung Hổh Trung HổighTrung Hổ Trung Hổiming requiremenTrung Hổs.

      If unsure, leave Trung Hổhis value as 0 or refer Trung Hổo Trung Hổhe hardware documenTrung HổaTrung Hổion
      for Trung Hổhe correcTrung Hổ delay value.


endmenu # FD CAN

endmenu # CAN
```

## sys/congure/abe/Kconfig.config
```kconfig
config CONGURE_ABE_MULTrung HổIPLIER_NUMERATrung HổOR_DEFAULTrung Hổ
    inTrung Hổ "DefaulTrung Hổ numeraTrung Hổor of Trung Hổhe ABE mulTrung Hổiplier"
    defaulTrung Hổ 4
    help
        RFC 8511, secTrung Hổion 3.1 defines Trung Hổhe ABE mulTrung Hổiplier Trung Hổo be 0.8 = 4/5, so
        assuming CONGURE_ABE_MULTrung HổIPLIER_DENOMINATrung HổOR_DEFAULTrung Hổ is 5, Trung Hổhis should be
        4.

config CONGURE_ABE_MULTrung HổIPLIER_DENOMINATrung HổOR_DEFAULTrung Hổ
    inTrung Hổ "DefaulTrung Hổ denominaTrung Hổor of Trung Hổhe ABE mulTrung Hổiplier"
    defaulTrung Hổ 5
    help
        RFC 8511, secTrung Hổion 3.1 defines Trung Hổhe ABE mulTrung Hổiplier Trung Hổo be 0.8 = 4/5, so
        assuming CONGURE_ABE_MULTrung HổIPLIER_NUMERATrung HổOR_DEFAULTrung Hổ is 4, Trung Hổhis should be
        5.
```

## sys/congure/test/Kconfig.config
```kconfig
# SPDX-FileCopyrighTrung HổTrung HổexTrung Hổ: 2021 Freie UniversiTrung HổäTrung Hổ Berlin
# SPDX-License-IdenTrung Hổifier: LGPL-2.1-only

config CONGURE_Trung HổESTrung Hổ_LOSTrung Hổ_MSG_POOL_SIZE
    inTrung Hổ "Pool size for Trung Hổhe lisTrung Hổ elemenTrung Hổs for a losTrung Hổ message reporTrung Hổ"
    defaulTrung Hổ 4
    help
        @see congure_snd_driver_Trung Hổ::reporTrung Hổ_msg_losTrung Hổ
        Trung Hổhis defines Trung Hổhe maximum number of 3-Trung Hổuples you can use wiTrung Hổh
        @ref congure_Trung HổesTrung Hổ_call_reporTrung Hổ() when argv[1] is msg_losTrung Hổ.
```

## sys/malloc_monitor/Kconfig
```kconfig
# SPDX-FileCopyrightText: 2024 TU Dresden
# SPDX-License-Identifier: LGPL-2.1-only

menuconfig MODULE_SYS_MALLOC_MONITOR
    bool "Heap Memory Usage Monitor"

config MODULE_SYS_MALLOC_MONITOR_SIZE
    int "Monitor Size"
    default 100
    depends on MODULE_SYS_MALLOC_MONITOR
    help
        Specifies maximum number of pointers that can be monitored at once.

config MODULE_SYS_MALLOC_MONITOR_VERBOSE
    bool "Verbose"
    default false
    depends on MODULE_SYS_MALLOC_MONITOR
    help
        Print detailed log of calls to malloc/realloc/free
```

## sys/net/Kconfig
```kconfig
# SPDX-FileCopyrightText: 2019 HAW Hamburg
# SPDX-License-Identifier: LGPL-2.1-only

menu "Networking"

rsource "application_layer/Kconfig"
rsource "ble/Kconfig"
rsource "credman/Kconfig"
rsource "gnrc/Kconfig"
rsource "sock/Kconfig"
rsource "link_layer/Kconfig"
rsource "lora/Kconfig"
rsource "netif/Kconfig"

endmenu # Networking
```

## sys/net/application_layer/Kconfig
```kconfig
# SPDX-FileCopyrightText: 2020 HAW Hamburg
# SPDX-License-Identifier: LGPL-2.1-only

menu "CoAP"

rsource "unicoap/Kconfig"
rsource "Kconfig.coap"
rsource "gcoap/Kconfig"
rsource "nanocoap/Kconfig"

endmenu # CoAP

rsource "cord/Kconfig"
rsource "dhcpv6/Kconfig"
rsource "dns/Kconfig"
rsource "sock_dodtls/Kconfig"

menu "MQTT-SN"

rsource "asymcute/Kconfig"
rsource "emcute/Kconfig"

endmenu # MQTT-SN

menu "Telnet"

rsource "telnet/Kconfig"

endmenu # Telnet
```

## sys/net/application_layer/dns/Kconfig
```kconfig
# SPDX-FileCopyrightText: 2020 Freie Universität Berlin
# SPDX-License-Identifier: LGPL-2.1-only

menu "DNS"
    depends on USEMODULE_DNS

menu "DNS message parser and composer"
    depends on USEMODULE_DNS_MSG

config DNS_MSG_LEN
    int "Maximum DNS message length"
    default 128

endmenu # DNS message parser and composer

menu "DNS cache"
    depends on USEMODULE_DNS_CACHE

config DNS_CACHE_SIZE
    int "Maximum number of DNS cache entries"
    default 4

config DNS_CACHE_A
    bool "Handle to cache A records"
    default y if USEMODULE_IPV4
    default n

config DNS_CACHE_AAAA
    bool "Handle to cache AAAA records"
    default y if USEMODULE_IPV6
    default n

endmenu # DNS cache
endmenu # DNS
```

## sys/net/application_layer/sock_dodtls/Kconfig
```kconfig
# SPDX-FileCopyrightText: 2021 Freie Universität Berlin
# SPDX-License-Identifier: LGPL-2.1-only

menu "DNS over DTLS"
    depends on USEMODULE_SOCK_DODTLS

config SOCK_DODTLS_RETRIES
    int "Number of DNS over DTLS query retries"
    default 2

config SOCK_DODTLS_TIMEOUT_MS
    int "Timeout for DNS over DTLS queries in milliseconds"
    default 1000

endmenu # DNS over DTLS
```

## sys/net/application_layer/telnet/Kconfig
```kconfig
# SPDX-FileCopyrightText: 2021 ML!PA Consulting GmbH
# SPDX-License-Identifier: LGPL-2.1-only

menu "telnet server"
    depends on USEMODULE_TELNET

config TELNET_PORT
    int "Server port"
    default 23
    help
        Server port, the default is the one specified in RFC 855.

config TELNET_TCP_QUEUE_SIZE
    int "TCP Queue Size"
    default 1
    help
        Maximum number of incoming TCP connections.

endmenu # telnet server
```

## sys/net/ble/Kconfig
```kconfig
# SPDX-FileCopyrightText: 2020 Freie Universität Berlin
# SPDX-License-Identifier: LGPL-2.1-only

rsource "skald/Kconfig"
```

## sys/net/ble/skald/Kconfig
```kconfig
# SPDX-FileCopyrightText: 2020 Freie Universität Berlin
# SPDX-License-Identifier: LGPL-2.1-only

menu "SKALD"
    depends on USEMODULE_SKALD

config SKALD_ADV_CHANNELS
    string "Advertising channels"
    default "37, 38, 39"
    help
        Configure advertising channels. Default advertising channels are 37, 38
        and 39 which can be customised to upto 40 (0-39) channels.

endmenu # SKALD
```

## sys/net/credman/Kconfig
```kconfig
# SPDX-FileCopyrightText: 2020 Freie Universität Berlin
# SPDX-License-Identifier: LGPL-2.1-only

menu "CREDMAN"
    depends on USEMODULE_CREDMAN

config CREDMAN_MAX_CREDENTIALS
    int "MAX number of credentials in credential pool"
    default 2
    help
        Configure 'CONFIG_CREDMAN_MAX_CREDENTIALS', the maximum number of
        allowed credentials in the credential pool.

config CREDMAN_MAX_ASN1_OBJ
    int "Maximum number of ASN.1 objects when decoding keys"
    default 8
    depends on USEMODULE_CREDMAN_LOAD

endmenu # CREDMAN
```

## sys/net/gnrc/Kconfig
```kconfig
# SPDX-FileCopyrightText: 2019 HAW Hamburg
# SPDX-License-Identifier: LGPL-2.1-only

menu "GNRC Network stack"
    depends on USEMODULE_GNRC

rsource "application_layer/dhcpv6/Kconfig"
rsource "link_layer/lorawan/Kconfig"
rsource "netif/Kconfig"
rsource "network_layer/ipv6/Kconfig"
rsource "network_layer/sixlowpan/Kconfig"
rsource "pktbuf/Kconfig"
rsource "pktdump/Kconfig"
rsource "routing/rpl/Kconfig"
rsource "transport_layer/tcp/Kconfig"

endmenu # GNRC Network Stack
```

## sys/net/gnrc/link_layer/lorawan/Kconfig
```kconfig
# SPDX-FileCopyrightText: 2019 HAW Hamburg
# SPDX-License-Identifier: LGPL-2.1-only

menu "GNRC LoRaWAN"
    depends on USEMODULE_GNRC_LORAWAN

config GNRC_LORAWAN_MIN_SYMBOLS_TIMEOUT
    int "Minimum symbols to detect a LoRa preamble"
    default 30
    range 0 1024

endmenu # GNRC LoRaWAN
```

## sys/net/gnrc/network_layer/ipv6/blacklist/Kconfig
```kconfig
# SPDX-FileCopyrightText: 2019 HAW Hamburg
# SPDX-License-Identifier: LGPL-2.1-only

menu "GNRC IPv6 Blacklisting"
    depends on USEMODULE_GNRC_IPV6_BLACKLIST

config GNRC_IPV6_BLACKLIST_SIZE
    int "Maximum size of the blacklist"
    default 8

endmenu # GNRC IPv6 Blacklisting
```

## sys/net/gnrc/network_layer/ipv6/whitelist/Kconfig
```kconfig
# SPDX-FileCopyrightText: 2019 HAW Hamburg
# SPDX-License-Identifier: LGPL-2.1-only

menu "GNRC IPv6 Whitelisting"
    depends on USEMODULE_GNRC_IPV6_WHITELIST

config GNRC_IPV6_WHITELIST_SIZE
    int "Maximum size of the whitelist"
    default 8

endmenu # GNRC IPv6 Whitelisting
```

## sys/net/gnrc/network_layer/sixlowpan/frag/Kconfig
```kconfig
# SPDX-FileCopyrightText: 2020 HAW Hamburg
# SPDX-License-Identifier: LGPL-2.1-only

if USEMODULE_GNRC_SIXLOWPAN_FRAG || USEMODULE_GNRC_SIXLOWPAN_FRAG_SFR

rsource "fb/Kconfig"
rsource "rb/Kconfig"
rsource "vrb/Kconfig"

endif # USEMODULE_GNRC_SIXLOWPAN_FRAG || USEMODULE_GNRC_SIXLOWPAN_FRAG_SFR

if USEMODULE_GNRC_SIXLOWPAN_FRAG_SFR

rsource "sfr/Kconfig"

endif # USEMODULE_GNRC_SIXLOWPAN_FRAG_SFR
```

## sys/net/gnrc/network_layer/sixlowpan/frag/fb/Kconfig
```kconfig
# SPDX-FileCopyrightText: 2020 HAW Hamburg
# SPDX-License-Identifier: LGPL-2.1-only

menu "GNRC 6LoWPAN Fragmentation buffer"
    depends on USEMODULE_GNRC_SIXLOWPAN_FRAG_FB

config GNRC_SIXLOWPAN_FRAG_FB_SIZE
    int "Number of datagrams that can be fragmented simultaneously"
    default 4 if USEMODULE_GNRC_SIXLOWPAN_FRAG_SFR
    default 1
    help
        This determines the number of @ref gnrc_sixlowpan_frag_fb_t instances
        available.

endmenu # GNRC 6LoWPAN Fragmentation buffer
```

## sys/net/gnrc/network_layer/sixlowpan/frag/vrb/Kconfig
```kconfig
# SPDX-FileCopyrightText: 2020 HAW Hamburg
# SPDX-License-Identifier: LGPL-2.1-only

menu "GNRC 6LoWPAN Virtual reassembly buffer"
    depends on USEMODULE_GNRC_SIXLOWPAN_FRAG_VRB

config GNRC_SIXLOWPAN_FRAG_VRB_SIZE
    int "Size of the virtual reassembly buffer"
    default 16
    help
        Has a direct influence on the number of available
        gnrc_sixlowpan_frag_rb_int_t entries.

config GNRC_SIXLOWPAN_FRAG_VRB_TIMEOUT_US
    int "Timeout for a virtual reassembly buffer entry in microseconds"
    default 3000000

endmenu # GNRC 6LoWPAN Virtual reassembly buffer
```

## sys/net/gnrc/network_layer/sixlowpan/nd/Kconfig
```kconfig
# SPDX-FileCopyrightText: 2020 HAW Hamburg
# SPDX-License-Identifier: LGPL-2.1-only

menu "GNRC 6LoWPAN Neighbor Discovery"
    depends on USEMODULE_GNRC_SIXLOWPAN_ND

config GNRC_SIXLOWPAN_ND_AR_LTIME
    int "Registration lifetime for the address registration option in minutes"
    depends on USEMODULE_GNRC_IPV6_NIB
    default 15
    help
        This value should be adapted to the devices power-lifecycle so that it is
        greater than the time the device spends sleeping. See RFC 6775, section
        5.8.1.

endmenu # GNRC 6LoWPAN Neighbor Discovery
```

## sys/net/gnrc/pktdump/Kconfig
```kconfig
# SPDX-FileCopyrightText: 2020 Freie Universität Berlin
# SPDX-License-Identifier: LGPL-2.1-only

menu "GNRC Packet Dump"
    depends on USEMODULE_GNRC_PKTDUMP

config GNRC_PKTDUMP_MSG_QUEUE_SIZE_EXP
    int "Exponent for the queue size (resulting in the queue size 2^n)"
    default 3
    help
        As the queue size ALWAYS needs to be power of two, this option
        represents the exponent of 2^n, which will be used as the size of
        the queue.

endmenu # GNRC Packet Dump
```

## sys/net/link_layer/Kconfig
```kconfig
# SPDX-FileCopyrightText: 2019 HAW Hamburg
# SPDX-License-Identifier: LGPL-2.1-only

rsource "csma_sender/Kconfig"
rsource "ieee802154/Kconfig"
rsource "l2filter/Kconfig"
rsource "Kconfig.lorawan"
```
