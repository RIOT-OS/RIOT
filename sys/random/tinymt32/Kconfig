## sys/test_utils/interactive_sync/Kconfig
```kconfig
# Copyright (c) 2020 HAW Hamburg
#
# This file is subject to the terms and conditions of the GNU Lesser
# General Public License v2.1. See the file LICENSE in the top level
# directory for more details.
#

config MOD_TEST_UTILS_INTERACTIVE_SYNC
    bool "Interactive synchronization"
    select MOD_STDIN

config MOD_TEST_UTILS_INTERACTIVE_SYNC_SHELL
    bool "Use the shell to synchronize"
    depends on MOD_TEST_UTILS_INTERACTIVE_SYNC
    default y if MOD_SHELL
```

## sys/test_utils/netdev_ieee802154_minimal/Kconfig
```kconfig
# Copyright (c) 2022 HAW Hamburg
#
# This file is subject to the terms and conditions of the GNU Lesser
# General Public License v2.1. See the file LICENSE in the top level
# directory for more details.
#

config MODULE_TEST_UTILS_NETDEV_IEEE802154_MINIMAL
    bool "Minimal netdev IEEE 802.15.4 device processing"
    depends on TEST_KCONFIG
    select MODULE_NETDEV
    select MODULE_EVENT
    select MODULE_EVENT_THREAD
    select MODULE_L2UTIL
    select MODULE_OD
    select MODULE_OD_STRING
    select MODULE_SHELL
```

## sys/test_utils/print_stack_usage/Kconfig
```kconfig
# Copyright (c) 2022 Freie Universität Berlin
#               2022 Inria
#
# This file is subject to the terms and conditions of the GNU Lesser
# General Public License v2.1. See the file LICENSE in the top level
# directory for more details.
#

config MODULE_TEST_UTILS_PRINT_STACK_USAGE
    bool "Print stack usage metrics on stack exit"
```

## sys/test_utils/result_output/Kconfig
```kconfig
# Copyright (c) 2021 HAW Hamburg
#
# This file is subject to the terms and conditions of the GNU Lesser
# General Public License v2.1. See the file LICENSE in the top level
# directory for more details.
#

menuconfig MODULE_TEST_UTILS_RESULT_OUTPUT
    bool "Use result output abstraction"
    depends on TEST_KCONFIG

if MODULE_TEST_UTILS_RESULT_OUTPUT

choice
    bool "Test utils result output"
    default MODULE_TEST_UTILS_RESULT_OUTPUT_JSON
    help
        A common API that can format result output depending on the module
        used.

config MODULE_TEST_UTILS_RESULT_OUTPUT_TXT
    bool "Text"
    select MODULE_FMT
    help
        Output results in plain text. Intended for developer friendly console
        output.

config MODULE_TEST_UTILS_RESULT_OUTPUT_JSON
    bool "JSON"
    select MODULE_FMT
    help
        Output results json formatted results. This allows generic json parsers
        to be used. Trailing commas may be present.

config MODULE_TEST_UTILS_RESULT_OUTPUT_CHECK
    bool "Check"
    help
        Asserts that the structure of the result output are correct. No output
        is given.

endchoice

endif # MODULE_TEST_UTILS_RESULT_OUTPUT
```

## sys/tiny_strerror/Kconfig
```kconfig
# Copyright (C) 2022 Otto-von-Guericke-Universität Magdeburg
#
# This file is subject to the terms and conditions of the GNU Lesser
# General Public License v2.1. See the file LICENSE in the top level
# directory for more details.
#

config MODULE_TINY_STRERROR
    bool
    depends on TEST_KCONFIG
    help
        This module provides `tiny_strerror()`, a drop-in replacement for
        `strerror()` that returns the errno macro name rather than a verbose
        help description string.

config MODULE_TINY_STRERROR_AS_STRERROR
    bool
    depends on TEST_KCONFIG
    select MODULE_TINY_STRERROR
    help
        This replaces all calls to `strerror()` with calls to `tiny_strerror()`
        via linker magic. This may safe a bit of ROM.
```

## sys/trace/Kconfig
```kconfig
# Copyright (c) 2021 Inria
#
# This file is subject to the terms and conditions of the GNU Lesser
# General Public License v2.1. See the file LICENSE in the top level
# directory for more details.
#

config MODULE_TRACE
    bool "Trace program flows"
    depends on TEST_KCONFIG
    select MODULE_ZTIMER
    select MODULE_ZTIMER_USEC
    select MODULE_ZTIMER_PERIPH_TIMER
```

## sys/trickle/Kconfig
```kconfig
# Copyright (c) 2023 HAW Hamburg
#
# This file is subject to the terms and conditions of the GNU Lesser
# General Public License v2.1. See the file LICENSE in the top level
# directory for more details.
#

config MODULE_TRICKLE
    bool "Trickle Algorithm (RFC 6206)"
    depends on TEST_KCONFIG
    select ZTIMER_MSEC
    select MODULE_RANDOM
```

## sys/usb/Kconfig
```kconfig
# Copyright (c) 2019 HAW Hamburg
#
# This file is subject to the terms and conditions of the GNU Lesser
# General Public License v2.1. See the file LICENSE in the top level
# directory for more details.
#

if USEMODULE_PERIPH_USBDEV || USEMODULE_TINYUSB_DEVICE || USEMODULE_USBDEV_MOCK

rsource "usbus/Kconfig"

menu "Power management"

config USB_MAX_POWER
    int "Reported maximum power draw [mA]"
    default 100
    range 0 500

config USB_SELF_POWERED
    bool "Report as self-powered device"
    help
        When enabled, the device advertises itself as a self-powered device to
        the host computer.

endmenu # Power management

choice
    bool "USB specification version"

    config USB_SPEC_BCDVERSION_2_0
        bool "USB v2.0"
        help
            The peripheral acts as an USB version 2.0 device.

    config USB_SPEC_BCDVERSION_1_1
        bool "USB v1.1"
        help
            The peripheral acts as an USB version 1.1 device.

endchoice

config CUSTOM_USB_VID_PID
    bool "Use custom VID and PID"
    help
        If using in USB in application then one must set a VID and PID.
        If RIOT is internally using the USB, say for STDIO, then the VID and
        PID depending in the internal peripheral configuration used.

config USB_PID
    hex "Product ID"
    depends on CUSTOM_USB_VID_PID
    range 0x0000 0xFFFF
    default 0x7D01
    help
        You must provide your own PID.

config USB_VID
    hex "Vendor ID"
    range 0x0000 0xFFFF
    depends on CUSTOM_USB_VID_PID
    default 0x1209
    help
        You must provide your own VID.

config USB_MANUF_STR
    string "Manufacturer string"
    default "RIOT-os.org"

config USB_PRODUCT_STR
    string "Product string"
    default BOARD

config USB_CONFIGURATION_STR
    string "Configuration string"
    default "USB config"

config USB_PRODUCT_BCDVERSION
    hex "Device version"
    default 0x0100
    help
        This is the version number of this peripheral. Not to be confused with
        the USB version number.

config USB_DEFAULT_LANGID
    hex "Reported string Language ID"
    default 0x0409
    help
        The default value is EN-US (0x0409).

config USB_CUSTOM_SERIAL_STR
    bool "Configure a custom USB serial string"

config USB_SERIAL_STR
    string "Serial string"
    depends on USB_CUSTOM_SERIAL_STR
    help
        USB peripheral serial string

        Compile-time value to override the serial string with. An LUID-based hex
        string is generated when this value is not used.

        This string does not have to be a number, but it must be unique between
        devices with identical VID:PID combination.

config USB_SERIAL_BYTE_LENGTH
    int "USB peripheral serial string length"
    depends on !USB_CUSTOM_SERIAL_STR
    range 0 63
    default 8
    help
        The length here is in bytes. The generated hex string is twice as many chars
        in length due to conversion from bytes to hex chars.

comment "WARNING: The serial string is empty!"
    depends on USB_SERIAL_STR = "" && USB_CUSTOM_SERIAL_STR

endif # KUSEMODULE_PERIPH_USBDEV || USEMODULE_TINYUSB_DEVICE || USEMODULE_USBDEV_MOCK
```

## sys/usb/usbus/Kconfig
```kconfig
# Copyright (c) 2020 HAW Hamburg
#
# This file is subject to the terms and conditions of the GNU Lesser
# General Public License v2.1. See the file LICENSE in the top level
# directory for more details.
#

menu "Configure USB Unified Stack (USBUS)"
    depends on USEMODULE_USBUS
config USBUS_AUTO_ATTACH
    bool "Auto attach"
    default y
    help
        When set, the USBUS thread will automatically enable the USB pull-up
        resistor after initializing the thread. This will signal to the host
        that the USB peripheral is ready for use.

choice
    bool "Endpoint 0 buffer size"
    default USBUS_EP0_SIZE_64
    help
        This configures the buffer size of the control endpoint. Unless you
        transfer large amount of data often over the control endpoint, a minimal
        size should be sufficient.

    config USBUS_EP0_SIZE_8
        bool "8"

    config USBUS_EP0_SIZE_16
        bool "16"

    config USBUS_EP0_SIZE_32
        bool "32"

    config USBUS_EP0_SIZE_64
        bool "64"

endchoice
endmenu # Configure USB Unified Stack (USBUS)

rsource "cdc/Kconfig"
rsource "dfu/Kconfig"
rsource "hid/Kconfig"
rsource "msc/Kconfig"
```
