## sys/shell/cmds/Kconfig
```kconfig
# Copyright (c) 2022 Otto-von-Guericke-Universität Magdeburg
#
# This file is subject to the terms and conditions of the GNU Lesser
# General Public License v2.1. See the file LICENSE in the top level
# directory for more details.
#

menuconfig MODULE_SHELL_CMDS
    bool "Support for shell commands"
    depends on MODULE_SHELL

config CONFIG_MODULE_SHELL_COMMANDS
    bool
    select MODULE_SHELL_CMDS_DEFAULT
    help
        Deprecated alias for MODULE_SHELL_CMDS_DEFAULT. For new apps, use
        MODULE_SHELL_CMDS_DEFAULT directly.

config MODULE_SHELL_CMDS_DEFAULT
    bool "Default shell commands for enabled modules"
    select MODULE_SHELL_CMDS
    help
        Shell commands can be enabled and disabled individually as dedicated
        modules. This module instead will select the shell commands of modules
        already used, if this is considered as "good default choice".

config MODULE_SHELL_CMD_APP_METADATA
    bool "Command to print app meta data as JSON"
    default y if MODULE_SHELL_CMDS_DEFAULT
    depends on MODULE_SHELL_CMDS
    depends on MODULE_APP_METADATA

config MODULE_SHELL_CMD_AT30TSE75X
    bool "Command to testAT30TSE75x temperature sensors"
    default y if MODULE_SHELL_CMDS_DEFAULT
    depends on MODULE_SHELL_CMDS
    depends on MODULE_AT30TSE75X

config MODULE_SHELL_CMD_BENCHMARK_UDP
    bool "Command to perform a UDP benchmark"
    default y if MODULE_SHELL_CMDS_DEFAULT
    depends on MODULE_SHELL_CMDS
    depends on MODULE_BENCHMARK_UDP

config MODULE_SHELL_CMD_CCN-LITE-UTILS
    bool "Commands to interact with the CCN-Lite stack"
    default y if MODULE_SHELL_CMDS_DEFAULT
    depends on MODULE_SHELL_CMDS
    depends on MODULE_CCN-LITE-UTILS

config MODULE_SHELL_CMD_CONN_CAN
    bool "Command to interact with the CAN stack"
    default y if MODULE_SHELL_CMDS_DEFAULT
    depends on MODULE_SHELL_CMDS
    depends on MODULE_CONN_CAN

config MODULE_SHELL_CMD_CORD_EP
    bool "Command to interact with a resource directory endpoint"
    default y if MODULE_SHELL_CMDS_DEFAULT
    depends on MODULE_SHELL_CMDS
    depends on MODULE_CORD_EP

config MODULE_SHELL_CMD_CRYPTOAUTHLIB
    bool "Command to interact with Microchip CryptoAuth devices"
    default y if MODULE_SHELL_CMDS_DEFAULT
    depends on MODULE_SHELL_CMDS
    depends on MODULE_CRYPTOAUTHLIB

config MODULE_SHELL_CMD_DFPLAYER
    bool "Command to control a dfplayer MP3 player"
    default y if MODULE_SHELL_CMDS_DEFAULT
    depends on MODULE_SHELL_CMDS
    depends on MODULE_DFPLAYER
    select MODULE_AUTO_INIT_MULTIMEDIA
    select MODULE_FMT

config MODULE_SHELL_CMD_FIB
    bool "Command to interact with the Forwarding Information Base (FIB)"
    default y if MODULE_SHELL_CMDS_DEFAULT
    depends on MODULE_SHELL_CMDS
    depends on MODULE_FIB
    depends on MODULE_POSIX_INET

config MODULE_SHELL_CMD_GNRC_ICMPV6_ECHO
    bool "Command to send ICMPv6 Echo Requests (a.k.a. ping)"
    default y if MODULE_SHELL_CMDS_DEFAULT
    depends on MODULE_SHELL_CMDS
    depends on MODULE_GNRC_ICMPV6_ECHO
    depends on MODULE_NETUTILS
    depends on MODULE_ZTIMER_USEC

config MODULE_SHELL_CMD_GNRC_IPV6_BLACKLIST
    bool "Command to manage IPv6 addresses in reception deny list"
    default y if MODULE_SHELL_CMDS_DEFAULT
    depends on MODULE_SHELL_CMDS
    depends on MODULE_GNRC_IPV6_BLACKLIST

config MODULE_SHELL_CMD_GNRC_IPV6_FRAG_STATS
    bool "Command to show IPv6 fragmentation statistics"
    default y if MODULE_SHELL_CMDS_DEFAULT
    depends on MODULE_SHELL_CMDS
    depends on MODULE_GNRC_IPV6_FRAG_STATS

config MODULE_SHELL_CMD_GNRC_IPV6_NIB
    bool "Command to configure the neighbor information base"
    default y if MODULE_SHELL_CMDS_DEFAULT
    depends on MODULE_SHELL_CMDS
    depends on MODULE_GNRC_IPV6_NIB

config MODULE_SHELL_CMD_GNRC_IPV6_WHITELIST
    bool "Command to manage IPv6 addresses in reception allow list"
    default y if MODULE_SHELL_CMDS_DEFAULT
    depends on MODULE_SHELL_CMDS
    depends on MODULE_GNRC_IPV6_WHITELIST

config MODULE_SHELL_CMD_GNRC_NETIF
    bool "Command to manage GNRC network interfaces (ifconfig)"
    default y if MODULE_SHELL_CMDS_DEFAULT
    depends on MODULE_SHELL_CMDS
    depends on MODULE_GNRC_NETIF

config MODULE_SHELL_CMD_GNRC_NETIF_LORA
    bool "LoRa phy integration to the GNRC network interface command (ifconfig)"
    default y if MODULE_SHELL_CMD_GNRC_NETIF && MODULE_LORA
    depends on MODULE_GNRC_NETIF
    depends on MODULE_LORA
    depends on MODULE_SHELL_CMDS
    depends on MODULE_SHELL_CMD_GNRC_NETIF

config MODULE_SHELL_CMD_GNRC_NETIF_LORAWAN
    bool "LoRaWAN integration to the GNRC network interface command (ifconfig)"
    default y if MODULE_SHELL_CMD_GNRC_NETIF && MODULE_GNRC_NETIF_LORAWAN
    depends on MODULE_GNRC_NETIF
    depends on MODULE_GNRC_NETIF_LORAWAN
    depends on MODULE_SHELL_CMDS
    depends on MODULE_SHELL_CMD_GNRC_NETIF
    depends on MODULE_SHELL_CMD_GNRC_NETIF_LORA

config MODULE_SHELL_CMD_GNRC_PKTBUF
    bool "Command to print stats of the GNRC packet buffer"
    default y if MODULE_SHELL_CMDS_DEFAULT
    depends on MODULE_SHELL_CMDS
    depends on MODULE_GNRC_PKTBUF

config MODULE_SHELL_CMD_GNRC_RPL
    bool "Command to configure GNRC's RPL implementation"
    default y if MODULE_SHELL_CMDS_DEFAULT
    depends on MODULE_SHELL_CMDS
    depends on MODULE_GNRC_RPL

config MODULE_SHELL_CMD_GNRC_SIXLOWPAN_CTX
    bool "Command to configure 6LoWPAN context in GNRC"
    default y if MODULE_SHELL_CMDS_DEFAULT
    depends on MODULE_SHELL_CMDS
    depends on MODULE_SIXLOWPAN_CTX

config MODULE_SHELL_CMD_GNRC_SIXLOWPAN_FRAG_STATS
    bool "Command to display 6LoWPAN fragment statistics"
    default y if MODULE_SHELL_CMDS_DEFAULT
    depends on MODULE_SHELL_CMDS
    depends on MODULE_GNRC_SIXLOWPAN_FRAG_STATS

config MODULE_SHELL_CMD_GNRC_UDP
    bool "Command interface to a UDP server and client"
    default y if MODULE_SHELL_CMDS_DEFAULT
    depends on MODULE_SHELL_CMDS
    depends on MODULE_GNRC_UDP
    depends on MODULE_GNRC_PKTDUMP

config MODULE_SHELL_CMD_HEAP
    bool "Command to print dynamic memory allocation statistics"
    depends on MODULE_SHELL_CMDS

config MODULE_SHELL_CMD_I2C_SCAN
    bool "Command to scan for I2C devices"
    depends on MODULE_SHELL_CMDS
    depends on MODULE_PERIPH_I2C

config MODULE_SHELL_CMD_IW
    bool "Command to interact with WiFi interfaces"
    depends on MODULE_ZTIMER_SEC

config MODULE_SHELL_CMD_LWIP_NETIF
    bool "Command to manage lwIP network interfaces (ifconfig)"
    default y if MODULE_SHELL_CMDS_DEFAULT
    depends on MODULE_SHELL_CMDS
    depends on MODULE_LWIP_NETIF

config MODULE_SHELL_CMD_MCI
    bool "Commands to query parameters and read contents from memory cards"
    default y if MODULE_SHELL_CMDS_DEFAULT
    depends on MODULE_SHELL_CMDS
    depends on MODULE_MCI

config MODULE_SHELL_CMD_MD5SUM
    bool "Command to calculate the MD5 sum of a file"
    depends on MODULE_SHELL_CMDS
    depends on MODULE_SHELL_CMD_VFS

config MODULE_SHELL_CMD_NANOCOAP_VFS
    bool "Commands to upload/download files to/from a CoAP server"
    default y if MODULE_SHELL_CMDS_DEFAULT
    depends on MODULE_SHELL_CMDS
    depends on MODULE_NANOCOAP_VFS
    depends on MODULE_VFS_UTIL

config MODULE_SHELL_CMD_NETSTATS_NEIGHBOR
    bool "Command to show neighbor statistics"
    default y if MODULE_SHELL_CMDS_DEFAULT
    depends on MODULE_SHELL_CMDS
    depends on MODULE_NETSTATS_NEIGHBOR

config MODULE_SHELL_CMD_NICE
    bool "Command to change the priority of running threads"
    depends on MODULE_SHELL_CMDS

config MODULE_SHELL_CMD_NIMBLE_NETIF
    bool "Command to manage BLE connections for NimBLE"
    default y if MODULE_SHELL_CMDS_DEFAULT
    depends on MODULE_SHELL_CMDS
    depends on MODULE_FMT
    depends on MODULE_NIMBLE_NETIF
    depends on MODULE_NIMBLE_SCANLIST
    depends on MODULE_NIMBLE_SCANNER

config MODULE_SHELL_CMD_NIMBLE_STATCONN
    bool "Command to controle the NimBLE netif statconn connection manager"
    default y if MODULE_SHELL_CMDS_DEFAULT
    depends on MODULE_SHELL_CMDS
    depends on MODULE_NIMBLE_STATCONN

config MODULE_SHELL_CMD_OPENWSN
    bool "Commands to interact with the OpenWSN network statck (ifconfig, openwsn)"
    default y if MODULE_SHELL_CMDS_DEFAULT
    depends on MODULE_IPV6_ADDR
    depends on MODULE_L2UTIL
    depends on MODULE_NETIF
    depends on MODULE_SHELL_CMDS
    depends on USEPKG_OPENWSN

config MODULE_SHELL_CMD_PM
    bool "Command to interact with the layered power management subsystem"
    default y if MODULE_SHELL_CMDS_DEFAULT && MODULE_PERIPH_PM
    depends on MODULE_SHELL_CMDS
    depends on HAS_PERIPH_PM

config MODULE_SHELL_CMD_PS
    bool "Command to print information about running threads"
    default y if MODULE_SHELL_CMDS_DEFAULT
    depends on MODULE_SHELL_CMDS
    depends on MODULE_PS

config MODULE_SHELL_CMD_RANDOM
    bool "Commands to initialize the PRNG and print 32 bit pseudo-random numbers"
    depends on MODULE_SHELL_CMDS
    depends on MODULE_RANDOM

config MODULE_SHELL_CMD_RTC
    bool "Command to control the peripheral real time clock"
    default y if MODULE_SHELL_CMDS_DEFAULT && MODULE_PERIPH_RTC
    depends on MODULE_SHELL_CMDS
    depends on HAS_PERIPH_RTC || HAS_PERIPH_RTT
    depends on MODULE_RTT_RTC || HAS_PERIPH_RTC

config MODULE_SHELL_CMD_RTT
    bool "Command to control the peripheral real time timer"
    depends on MODULE_SHELL_CMDS
    depends on HAS_PERIPH_RTT

config MODULE_SHELL_CMD_SAUL_REG
    bool "Command to read sensors and control actuators via SAUL"
    default y if MODULE_SHELL_CMDS_DEFAULT
    depends on MODULE_SHELL_CMDS
    depends on MODULE_SAUL_REG

config MODULE_SHELL_CMD_SEMTECH-LORAMAC
    bool "Command to control the Semtech LoRaMAC stack"
    default y if MODULE_SHELL_CMDS_DEFAULT
    depends on MODULE_SHELL_CMDS
    depends on MODULE_SEMTECH-LORAMAC

config MODULE_SHELL_CMD_SHA1SUM
    bool "Command to compute the SHA1 sum of a file"
    depends on MODULE_SHELL_CMDS
    depends on MODULE_SHELL_CMD_VFS

config MODULE_SHELL_CMD_SHA256SUM
    bool "Command to compute the SHA256 sum of a file"
    depends on MODULE_SHELL_CMDS
    depends on MODULE_SHELL_CMD_VFS

config MODULE_SHELL_CMD_SHT1X
    bool "Commands to interact with SHT1x sensors"
    default y if MODULE_SHELL_CMDS_DEFAULT
    depends on MODULE_SHELL_CMDS
    depends on MODULE_SHT1X

config MODULE_SHELL_CMD_SNTP
    bool "Command to synchronize time with an SNTP server"
    default y if MODULE_SHELL_CMDS_DEFAULT
    depends on MODULE_SHELL_CMDS
    depends on MODULE_SNTP

config MODULE_SHELL_CMD_SUIT
    bool "Command to trigger a SUIT firmware update"
    default y if MODULE_SHELL_CMDS_DEFAULT
    depends on MODULE_SHELL_CMDS
    depends on MODULE_SUIT_TRANSPORT_WORKER

config MODULE_SHELL_CMD_SYS
    bool "Common utility commands (version, reboot, bootloader)"
    default y if MODULE_SHELL_CMDS_DEFAULT
    depends on MODULE_SHELL_CMDS

config MODULE_SHELL_CMD_CORECLK
    bool "Shell command printing the CPU frequency"
    default n
    depends on MODULE_SHELL_CMDS

config MODULE_SHELL_CMD_VFS
    bool "Commands for the VFS module (ls, vfs)"
    default y if MODULE_SHELL_CMDS_DEFAULT
    depends on MODULE_SHELL_CMDS
    depends on MODULE_VFS
    select MODULE_TINY_STRERROR
```

## sys/shell/commands/Kconfig
```kconfig
# Copyright (c) 2020 HAW Hamburg
#
# This file is subject to the terms and conditions of the GNU Lesser
# General Public License v2.1. See the file LICENSE in the top level
# directory for more details.
#

menuconfig MODULE_SHELL_COMMANDS
    bool "Basic shell commands"
    depends on MODULE_SHELL

config MODULE_I2C_SCAN
    bool "I2c scanner"
    depends on MODULE_SHELL
    depends on MODULE_PERIPH_I2C
```

## sys/ssp/Kconfig
```kconfig
# Copyright (c) 2023 Inria
#
# This file is subject to the terms and conditions of the GNU Lesser
# General Public License v2.1. See the file LICENSE in the top level
# directory for more details.
#

config MODULE_SSP
    bool "Stack Smashing Protector (SSP) helper functions"
    depends on TEST_KCONFIG

    select HAS_SSP
```

## sys/syslog/Kconfig
```kconfig
# Copyright (c) 2021 Continental
#
# This file is subject to the terms and conditions of the GNU Lesser
# General Public License v2.1. See the file LICENSE in the top level
# directory for more details.
#
menuconfig KCONFIG_SYSLOG
    bool "Syslog"
    select MODULE_SYSLOG
    depends on TEST_KCONFIG
    help
        Configure syslog via Kconfig

if KCONFIG_SYSLOG

config SYSLOG_HOSTNAME
    string "Hostname"
    default "-"
    help
        Syslog hostmame printed in the messages. Can also be set at runtime.

config SYSLOG_SET_DEFAULT_IDENT
    bool "Set default ident"

config SYSLOG_DEFAULT_IDENT
    string "Default ident"
    depends on SYSLOG_SET_DEFAULT_IDENT
    help
        Syslog default entry ident string

config SYSLOG_MAX_STRING_LEN
    int "Max length for a printed log message"
    default 256

choice
    bool "Formatter"
    default KCONFIG_SYSLOG_FORMATTER_DEFAULT
    help
        Select the log message formatter

config KCONFIG_SYSLOG_FORMATTER_DEFAULT
    bool "Default (libc-based)"
    select MODULE_FORMATTER_DEFAULT

config KCONFIG_SYSLOG_FORMATTER_FMT
    bool "fmt"
    select MODULE_FORMATTER_FMT
    select MODULE_FMT

endchoice

config SYSLOG_ALLOC_MEMARRAY
    bool "Use memarray"
    default n
    select MODULE_MEMARRAY
    help
        Use memarray instead of malloc for memory allocation

if SYSLOG_ALLOC_MEMARRAY

config SYSLOG_MAX_ENTRIES
    int "Max number of entries allocated with memarray"
    default 8

config SYSLOG_MAX_MSGS
    int "Max number of messages allocated with memarray"
    default 64

endif # SYSLOG_ALLOC_MEMARRAY

config SYSLOG_HAS_OPEN
    bool "Implements openlog/closelog"
    default n
    help
        Implements openlog and closelog. If disabled, all logs will use the same entry.

config SYSLOG_BACKEND_EXTRA
    bool "Use external user-provided backend(s)"
    default n
    help
        User-defined external backend(s) are provided. syslog_backend_extra.h must be provided
        by the user and SYSLOG_BACKEND_EXTRA must be defined and contains the syslog_backend_t
        driver(s) name that will be included to the backend array.

config MODULE_SYSLOG_BACKEND_STDIO
    bool "STDIO backend"
    default y
    help
        Print log messages on stdio

menuconfig KCONFIG_SYSLOG_BACKEND_FILE
    bool "File backend"
    select MODULE_SYSLOG_BACKEND_FILE
    select MODULE_VFS
    help
        Configure syslog file backend via Kconfig

if KCONFIG_SYSLOG_BACKEND_FILE

config SYSLOG_BACKEND_FILE_PATH
    string "Directory path where logs are stored"
    default "/log/sys"
    help
        Directory where logs will be stored. It should not contain a trailing '/'

config SYSLOG_FILE_ENTRY_NAME
    string "Log filename prefix"
    default "log"
    help
        Prefix of log files name, if "log", files will be log.0, log.1...

config SYSLOG_BACKEND_ROT_SIZE
    int "Rotation size"
    default 262144
    help
        Max size of a file before a file rotation is triggered

config SYSLOG_BACKEND_NB_FILES
    int "Max number of log files"
    default 32
    help
        Maximum number of log files that are kept

config SYSLOG_BACKEND_FILE_HAS_SUSPEND
    bool "Enable suspend/resume"
    default y
    help
        Build suspend/resume functions in to temporarly suspend file rotation

endif # KCONFIG_SYSLOG_BACKEND_FILE

endif # KCONFIG_SYSLOG
```

## sys/test_utils/dummy_thread/Kconfig
```kconfig
# Copyright (c) 2020 HAW Hamburg
#
# This file is subject to the terms and conditions of the GNU Lesser
# General Public License v2.1. See the file LICENSE in the top level
# directory for more details.
#

config MODULE_DUMMY_THREAD
    bool "Dummy thread"
    help
        This module can be used to mess up the number of threads a bit, e.g.,
        for testing test scripts.
```
