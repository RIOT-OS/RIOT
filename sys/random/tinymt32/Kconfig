## sys/random/tinymt32/Kconfig
```kconfig
# Copyright (c) 2021 HAW Hamburg
#
# This file is subject to the terms and conditions of the GNU Lesser
# General Public License v2.1. See the file LICENSE in the top level
# directory for more details.
#

config MODULE_TINYMT32
    bool
    depends on TEST_KCONFIG
    help
        Tiny Mersenne Twister only 127 bit internal state.
```

## sys/registry/Kconfig
```kconfig
# SPDX-FileCopyrightText: 2023-2026 Lasse Rosenow <lasse.rosenow@haw-hamburg.de>
# SPDX-FileCopyrightText: 2023-2026 HAW Hamburg
# SPDX-License-Identifier: LGPL-2.1-only

menuconfig MODULE_REGISTRY
    bool "REGISTRY"
    help
        RIOT Registry module for handling runtime configurations.

if MODULE_REGISTRY

config REGISTRY_ENABLE_META_NAME
    bool "Include name string in schemas"

config REGISTRY_ENABLE_META_DESCRIPTION
    bool "Include description string in schemas"

endif # MODULE_REGISTRY
```

## sys/registry/namespace/Kconfig
```kconfig
# SPDX-FileCopyrightText: 2023-2025 Lasse Rosenow <lasse.rosenow@haw-hamburg.de>
# SPDX-FileCopyrightText: 2023-2025 HAW Hamburg
# SPDX-License-Identifier: LGPL-2.1-only

menuconfig MODULE_REGISTRY_NAMESPACE
    bool "REGISTRY_NAMESPACE"
    depends on MODULE_REGISTRY
    help
        Namespace module containing default namespaces for the RIOT Registry sys module.

if MODULE_REGISTRY_NAMESPACE

rsource "sys/Kconfig"

endif # MODULE_REGISTRY_NAMESPACE
```

## sys/registry/namespace/sys/Kconfig
```kconfig
# SPDX-FileCopyrightText: 2023-2025 Lasse Rosenow <lasse.rosenow@haw-hamburg.de>
# SPDX-FileCopyrightText: 2023-2025 HAW Hamburg
# SPDX-License-Identifier: LGPL-2.1-only

menuconfig MODULE_REGISTRY_NAMESPACE_SYS
    bool "REGISTRY_NAMESPACE_SYS"
    depends on MODULE_REGISTRY_NAMESPACE
    help
        Namespace Sys module providing common sys configuration schemas for the RIOT Registry sys module.

if MODULE_REGISTRY_NAMESPACE_SYS

config MODULE_REGISTRY_NAMESPACE_SYS_RGB_LED
    bool "RGB LED schema"

endif # MODULE_REGISTRY_NAMESPACE_SYS
```

## sys/registry/storage/Kconfig
```kconfig
# SPDX-FileCopyrightText: 2023-2025 Lasse Rosenow <lasse.rosenow@haw-hamburg.de>
# SPDX-FileCopyrightText: 2023-2025 HAW Hamburg
# SPDX-License-Identifier: LGPL-2.1-only

menuconfig MODULE_REGISTRY_STORAGE
    bool "MODULE_REGISTRY_STORAGE"
    depends on MODULE_REGISTRY
    help
        Storage module allowing to store configuration parameters to non-volatile storage.

if MODULE_REGISTRY_STORAGE

config MODULE_REGISTRY_STORAGE_HEAP
    bool "Heap storage"

config MODULE_REGISTRY_STORAGE_VFS
    bool "VFS storage"

endif # MODULE_REGISTRY_STORAGE
```

## sys/rtc_utils/Kconfig
```kconfig
# Copyright (c) 2021 Inria
#
# This file is subject to the terms and conditions of the GNU Lesser
# General Public License v2.1. See the file LICENSE in the top level
# directory for more details.
#

config MODULE_RTC_UTILS
    bool "RTC helper functions"
    depends on TEST_KCONFIG
```

## sys/runtime_config/Kconfig
```kconfig
# SPDX-FileCopyrightText: 2023-2026 Lasse Rosenow <lasse.rosenow@haw-hamburg.de>
# SPDX-FileCopyrightText: 2023-2026 HAW Hamburg
# SPDX-License-Identifier: LGPL-2.1-only

menuconfig MODULE_RUNTIME_CONFIG
    bool "RUNTIME_CONFIG"
    help
        Runtime configuration module for handling runtime configurations.

if USEMODULE_RUNTIME_CONFIG

config RUNTIME_CONFIG_ENABLE_META_NAME
    bool "Include name string in schemas"

config RUNTIME_CONFIG_ENABLE_META_DESCRIPTION
    bool "Include description string in schemas"

endif # USEMODULE_RUNTIME_CONFIG
```

## sys/rust_riotmodules/Kconfig
```kconfig
# Copyright (c) 2022 HAW Hamburg
#
# This file is subject to the terms and conditions of the GNU Lesser
# General Public License v2.1. See the file LICENSE in the top level
# directory for more details.
#

menuconfig MODULE_RUST_RIOTMODULES
    bool "RUST RIOT modules"
    depends on TEST_KCONFIG
    depends on HAS_RUST_TARGET
    help
        This module is used when some module asks to have its code built
        through rust_riotmodules.

config MODULE_RUST_RIOTMODULES_STANDALONE
    bool "RUST RIOT modules are standalone"
    default y
    depends on MODULE_RUST_RIOTMODULES
    help
        This module is used when rust_riotmodules is selected, and the main
        application does not already contain Rust code through which the
        rust_riotmodules are built.
```

## sys/sched_round_robin/Kconfig
```kconfig
# Copyright (c) 2021 TUBA Freiberg
#
# This file is subject to the terms and conditions of the GNU Lesser
# General Public License v2.1. See the file LICENSE in the top level
# directory for more details.
#

config  MODULE_SCHED_ROUND_ROBIN
    bool "round robin scheduling support"
    depends on MODULE_ZTIMER_MSEC || MODULE_ZTIMER_USEC
    depends on TEST_KCONFIG
    select MODULE_SCHED_RUNQUEUE_API

if MODULE_SCHED_ROUND_ROBIN
config SCHED_RR_TIMEOUT
    int "timeout for round robin scheduling"
    default 10000

endif
```

## sys/sema/Kconfig
```kconfig
# Copyright (c) 2021 HAW Hamburg
#
# This file is subject to the terms and conditions of the GNU Lesser
# General Public License v2.1. See the file LICENSE in the top level
# directory for more details.
#

config MODULE_SEMA
    bool "Semaphore"
    depends on TEST_KCONFIG
    select MODULE_ZTIMER

config MODULE_SEMA_DEPRECATED
    bool "Semaphore compatible with 64bit timeouts, deprecated"
    select MODULE_SEMA
    select ZTIMER64_USEC
```

## sys/senml/Kconfig
```kconfig
# Copyright (c) 2021 Silke Hofstra
#
# This file is subject to the terms and conditions of the GNU Lesser
# General Public License v2.1. See the file LICENSE in the top level
# directory for more details.
#

config MODULE_SENML
    bool "SenML"
    depends on TEST_KCONFIG
    help
        Generic data container for physical data and utility functions.

config MODULE_SENML_SAUL
    bool "SenML SAUL  integration"
    depends on TEST_KCONFIG
    select MODULE_SENML_PHYDAT
    select MODULE_SENML_CBOR
    depends on MODULE_SAUL
    depends on MODULE_SAUL_REG
    help
        Generic data container for physical data and utility functions.

config MODULE_SENML_PHYDAT
    bool "SenML Phydat support"
    depends on TEST_KCONFIG
    select MODULE_SENML
    select MODULE_PHYDAT
    help
        Utilities to convert Phydat valus to SenML

config MODULE_SENML_CBOR
    bool "SenML CBOR enconding"
    depends on TEST_KCONFIG
    select MODULE_SENML
    select PACKAGE_NANOCBOR
    help
        Support for CBOR encoding of SenML values
```
