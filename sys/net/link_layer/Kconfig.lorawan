## sys/psa_crypto/Kconfig.ciphers
```kconfig
# Copyright (c) 2021 HAW Hamburg
#
# This file is subject to the terms and conditions of the GNU Lesser
# General Public License v2.1. See the file LICENSE in the top level
# directory for more details.
#

menuconfig MODULE_PSA_CIPHER
    bool "PSA Ciphers"
    select PSA_KEY_CONFIG
    select MODULE_PSA_KEY_SLOT_MGMT

if MODULE_PSA_CIPHER

menuconfig MODULE_PSA_CIPHER_AES_128_ECB
    bool "AES-128 ECB"
    select PSA_KEY_SIZE_128

if MODULE_PSA_CIPHER_AES_128_ECB

choice PSA_CIPHER_AES_128_ECB_BACKEND
    bool "AES-128 Implementation"

config MODULE_PSA_CIPHER_AES_128_ECB_BACKEND_RIOT
    bool "RIOT cipher"
    select MODULE_CRYPTO
    select MODULE_PSA_RIOT_CIPHER_AES_ECB

endchoice

endif # MODULE_PSA_CIPHER_AES_128_ECB

menuconfig MODULE_PSA_CIPHER_AES_128_CBC
    bool "AES-128 CBC"
    select PSA_KEY_SIZE_128

if MODULE_PSA_CIPHER_AES_128_CBC

choice PSA_CIPHER_AES_128_CBC_BACKEND
    bool "AES-128 CBC Implementation"

config MODULE_PSA_CIPHER_AES_128_CBC_BACKEND_PERIPH
    bool "Hardware Accelerated"
    depends on HAS_PERIPH_CIPHER_AES_128_CBC
    select MODULE_PERIPH_CIPHER_AES_128_CBC

config MODULE_PSA_CIPHER_AES_128_CBC_BACKEND_RIOT
    bool "RIOT cipher"
    select MODULE_CRYPTO
    select MODULE_PSA_RIOT_CIPHER_AES_128_CBC

endchoice

endif # MODULE_PSA_CIPHER_AES_128_CBC

menuconfig MODULE_PSA_CIPHER_AES_192_CBC
    bool "AES-192 CBC"
    select PSA_KEY_SIZE_192

if MODULE_PSA_CIPHER_AES_192_CBC

choice PSA_CIPHER_AES_192_CBC_BACKEND
    bool "AES-192 Implementation"

config MODULE_PSA_CIPHER_AES_192_CBC_BACKEND_RIOT
    bool "RIOT cipher"
    select MODULE_CRYPTO
    select MODULE_PSA_RIOT_CIPHER_AES_CBC

endchoice

endif # MODULE_PSA_CIPHER_AES_192_CBC

menuconfig MODULE_PSA_CIPHER_AES_256_CBC
    bool "AES-256 CBC"
    select PSA_KEY_SIZE_256

if MODULE_PSA_CIPHER_AES_256_CBC

choice CIPHER_AES_256_CBC_BACKEND
    bool "AES-256 Implementation"

config MODULE_PSA_CIPHER_AES_256_CBC_BACKEND_RIOT
    bool "RIOT Cipher Module"
    select MODULE_CRYPTO
    select MODULE_PSA_RIOT_CIPHER_AES_CBC

endchoice

endif # MODULE_PSA_CIPHER_AES_256_CBC

endif # MODULE_PSA_CIPHER
```

## sys/psa_crypto/Kconfig.hashes
```kconfig
# Copyright (c) 2021 HAW Hamburg
#
# This file is subject to the terms and conditions of the GNU Lesser
# General Public License v2.1. See the file LICENSE in the top level
# directory for more details.
#

menuconfig MODULE_PSA_HASH
    bool "PSA Hashes"
    select PSA_KEY_CONFIG

if MODULE_PSA_HASH

menuconfig MODULE_PSA_HASH_MD5
    bool "MD5"

if MODULE_PSA_HASH_MD5

choice PSA_HASH_MD5_BACKEND
    bool "MD5 implementation"

config MODULE_PSA_HASH_MD5_BACKEND_RIOT
    bool "RIOT hash"
    select MODULE_PSA_RIOT_HASHES_MD5

endchoice

endif # MODULE_PSA_HASH_MD5

menuconfig MODULE_PSA_HASH_SHA_1
    bool "SHA-1"

if MODULE_PSA_HASH_SHA_1

choice PSA_HASH_SHA_1_BACKEND
    bool "SHA-1 implementation"

config MODULE_PSA_HASH_SHA_1_BACKEND_PERIPH
    bool "Hardware accelerated"
    depends on HAS_PERIPH_HASH_SHA_1
    select MODULE_PERIPH_HASH_SHA_1

config MODULE_PSA_HASH_SHA_1_BACKEND_RIOT
    bool "RIOT hash"
    select MODULE_PSA_RIOT_HASHES_SHA_1

endchoice

endif # MODULE_PSA_HASH_SHA_1

menuconfig MODULE_PSA_HASH_SHA_224
    bool "SHA-224"

if MODULE_PSA_HASH_SHA_224

choice PSA_HASH_SHA_224_BACKEND
    bool "SHA-224 implementation"

config MODULE_PSA_HASH_SHA_224_BACKEND_PERIPH
    bool "Hardware accelerated"
    depends on HAS_PERIPH_HASH_SHA_224
    select MODULE_PERIPH_HASH_SHA_224

config MODULE_PSA_HASH_SHA_224_BACKEND_RIOT
    bool "RIOT Hash Module"
    select MODULE_PSA_RIOT_HASHES_SHA_224

endchoice

endif # MODULE_PSA_HASH_SHA_224

menuconfig MODULE_PSA_HASH_SHA_256
    bool "SHA-256"

if MODULE_PSA_HASH_SHA_256

choice PSA_HASH_SHA_256_BACKEND
    bool "SHA-256 implementation"

config MODULE_PSA_HASH_SHA_256_BACKEND_PERIPH
    bool "Hardware accelerated"
    depends on HAS_PERIPH_HASH_SHA_256
    select MODULE_PERIPH_HASH_SHA_256

config MODULE_PSA_HASH_SHA_256_BACKEND_RIOT
    bool "RIOT hash"
    select MODULE_PSA_RIOT_HASHES_SHA_256

endchoice

endif # MODULE_PSA_HASH_SHA_256

menuconfig MODULE_PSA_HASH_SHA_512
    bool "SHA-512"
    depends on HAS_PERIPH_HASH_SHA_512 # no software implementation so far...

if MODULE_PSA_HASH_SHA_512

choice PSA_HASH_SHA_512_BACKEND
    bool "SHA-512 implementation"

config MODULE_PSA_HASH_SHA_512_BACKEND_PERIPH
    bool "Hardware accelerated"
    depends on HAS_PERIPH_HASH_SHA_512
    select MODULE_PERIPH_HASH_SHA_512

endchoice

endif # MODULE_PSA_HASH_SHA_512

endif # MODULE_PSA_HASH
```

## sys/psa_crypto/Kconfig.mac
```kconfig
# Copyright (c) 2022 HAW Hamburg
#
# This file is subject to the terms and conditions of the GNU Lesser
# General Public License v2.1. See the file LICENSE in the top level
# directory for more details.
#

menuconfig MODULE_PSA_MAC
    bool "PSA Message Authenticated Ciphers"
    select PSA_KEY_CONFIG
    select MODULE_PSA_KEY_SLOT_MGMT

if MODULE_PSA_MAC

menuconfig MODULE_PSA_MAC_HMAC_SHA_256
    bool "HMAC SHA-256"
    select PSA_KEY_SIZE_256

if MODULE_PSA_MAC_HMAC_SHA_256

choice PSA_MAC_HMAC_SHA_256_BACKEND
    bool "HMAC SHA256 Implementation"

config MODULE_PSA_MAC_HMAC_SHA_256_BACKEND_PERIPH
    bool "Hardware Accelerated"
    depends on HAS_PERIPH_HMAC_SHA_256
    select MODULE_PERIPH_HMAC_SHA_256

config MODULE_PSA_MAC_HMAC_SHA_256_BACKEND_RIOT
    bool "RIOT HMAC SHA-256"
    select MODULE_PSA_RIOT_HASHES_HMAC_SHA256

endchoice # PSA_MAC_HMAC_SHA_256_BACKEND

endif # MODULE_PSA_MAC_HMAC_SHA_256

endif # MODULE_PSA_MAC
```

## sys/psa_crypto/psa_key_slot_mgmt/Kconfig
```kconfig
# Copyright (c) 2022 HAW Hamburg
#
# This file is subject to the terms and conditions of the GNU Lesser
# General Public License v2.1. See the file LICENSE in the top level
# directory for more details.
#

config MODULE_PSA_KEY_SLOT_MGMT
    bool
    default y if PACKAGE_PSA_ARCH_TESTS
```

## sys/psa_crypto/psa_persistent_storage/Kconfig
```kconfig
# Copyright (c) 2022 HAW Hamburg
#
# This file is subject to the terms and conditions of the GNU Lesser
# General Public License v2.1. See the file LICENSE in the top level
# directory for more details.
#

config MODULE_PSA_PERSISTENT_STORAGE
    bool "Enable persistent key storage in PSA"
    select PACKAGE_NANOCBOR
    select PACKAGE_LITTLEFS2
    select MODULE_LITTLEFS2_FS
    select MODULE_VFS_AUTO_FORMAT
    select MODULE_VFS_AUTO_MOUNT
    select MODULE_VFS_DEFAULT
```

## sys/random/Kconfig
```kconfig
# Copyright (c) 2021 HAW Hamburg
#
# This file is subject to the terms and conditions of the GNU Lesser
# General Public License v2.1. See the file LICENSE in the top level
# directory for more details.
#

menuconfig MODULE_RANDOM
    bool "Pseudo-Random Number Generation"
    depends on TEST_KCONFIG
    select MODULE_LUID
    select MODULE_PERIPH_HWRNG if HAS_PERIPH_HWRNG && !MODULE_PUF_SRAM

if MODULE_RANDOM

choice RANDOM_IMPLEMENTATION
    bool "PRNG Implementation"
    depends on TEST_KCONFIG
    default MODULE_PRNG_HWRNG if HAS_PERIPH_HWRNG
    default MODULE_PRNG_MUSL_LCG

menuconfig MODULE_PRNG_FORTUNA
    bool "Fortuna"
    select MODULE_HASHES
    select MODULE_FORTUNA
    select MODULE_CRYPTO
    select MODULE_CRYPTO_AES_128

if MODULE_PRNG_FORTUNA

config MODULE_FORTUNA_RESEED
    bool "Reseed prng according to FORTUNA_RESEED_INTERVAL_MS"
    select MODULE_XTIMER
    select MODULE_ATOMIC_UTILS
endif

config MODULE_PRNG_HWRNG
    bool "Hardware RNG"
    depends on HAS_PERIPH_HWRNG
    select MODULE_PERIPH_HWRNG

config MODULE_PRNG_MARSENNE
    bool "Marsenne"

config MODULE_PRNG_MINISTD
    bool "Mini STD"

config MODULE_PRNG_MUSL_LCG
    bool "MUSL LCG"

config MODULE_PRNG_SHA1PRNG
    bool "SHA-1"
    select MODULE_PRNG_SHAXPRNG
    select MODULE_HASHES

config MODULE_PRNG_SHA256PRNG
    bool "SHA-256"
    select MODULE_PRNG_SHAXPRNG
    select MODULE_HASHES

config MODULE_PRNG_TINYMT32
    bool "Tiny-MT 32"
    select MODULE_TINYMT32

config MODULE_PRNG_XORSHIFT
    bool "XOR Shift"

endchoice # RANDOM_IMPLEMENTATION

config MODULE_AUTO_INIT_RANDOM
    bool "Auto-initialize the random subsystem"
    default y
    depends on MODULE_AUTO_INIT

config MODULE_PRNG_SHAXPRNG
    bool
    help
        Unified implementation for SHA-256 and SHA-1 PRNG.

config MODULE_PRNG
    bool
    default y
    help
        Basic Pseudo-random number generation module.

rsource "fortuna/Kconfig"
rsource "tinymt32/Kconfig"

endif # MODULE_RANDOM
```

## sys/random/fortuna/Kconfig
```kconfig
# Copyright (c) 2021 HAW Hamburg
#
# This file is subject to the terms and conditions of the GNU Lesser
# General Public License v2.1. See the file LICENSE in the top level
# directory for more details.
#

config MODULE_FORTUNA
    bool
    depends on TEST_KCONFIG
    help
        Fortuna pseudo-random number generation. This is not your general
        purpose PRNG: it is hungry for memory.
```
