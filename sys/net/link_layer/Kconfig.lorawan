## sys/net/link_layer/csma_sender/Kconfig
```kconfig
# Copyright (c) 2020 Freie Universitaet Berlin
#
# This file is subject to the terms and conditions of the GNU Lesser
# General Public License v2.1. See the file LICENSE in the top level
# directory for more details.
#
menu "CSMA sender"
    depends on USEMODULE_CSMA_SENDER

config CSMA_SENDER_MIN_BE_DEFAULT
    int "Exponent for minimum CSMA/CA backoff time"
    default 3
    help
        Configure 'CONFIG_CSMA_SENDER_MIN_BE_DEFAULT'. Minimum CSMA backoff time
        is calculated as a function of 'CONFIG_CSMA_SENDER_BACKOFF_PERIOD_UNIT'
        and the power of 'CONFIG_CSMA_SENDER_MIN_BE_DEFAULT'.

config CSMA_SENDER_MAX_BE_DEFAULT
    int "Exponent for maximum CSMA/CA backoff time"
    default 5
    help
        Configure 'CONFIG_CSMA_SENDER_MAX_BE_DEFAULT'. Maximum CSMA backoff time
        is calculated as a function of 'CONFIG_CSMA_SENDER_BACKOFF_PERIOD_UNIT'
        and the power of 'CONFIG_CSMA_SENDER_MAX_BE_DEFAULT'.

config CSMA_SENDER_MAX_BACKOFFS_DEFAULT
    int "Maximum number of retries for CSMA/CA method"
    default 4

config CSMA_SENDER_BACKOFF_PERIOD_UNIT
    int "Backoff period for CSMA/CA in microseconds"
    default 320
    help
        Configure 'CONFIG_CSMA_SENDER_BACKOFF_PERIOD_UNIT'. Maximum and Minimum
        CSMA backoff time depends on unit times the value of this configuration.

endmenu # CSMA sender
```

## sys/net/link_layer/l2scan_list/Kconfig
```kconfig
# Copyright (c) 2023 ML!PA Consulting Gmbh
#
# This file is subject to the terms and conditions of the GNU Lesser
# General Public License v2.1. See the file LICENSE in the top level
# directory for more details.
#

config MODULE_L2SCAN_LIST
    bool "List of scanned Link Layer access points"
```

## sys/net/link_layer/l2util/Kconfig
```kconfig
# Copyright (c) 2021 HAW Hamburg
#
# This file is subject to the terms and conditions of the GNU Lesser
# General Public License v2.1. See the file LICENSE in the top level
# directory for more details.
#

config MODULE_L2UTIL
    bool "Link layer utils"
    select MODULE_FMT
```

## sys/net/link_layer/wifi/Kconfig
```kconfig
# Copyright (c) 2023 ML!PA Consulting GmbH
#
# This file is subject to the terms and conditions of the GNU Lesser
# General Public License v2.1. See the file LICENSE in the top level
# directory for more details.
#

menuconfig MODULE_WIFI_CONFIGURATION
    bool "WiFi Configuration"
    depends on MODULE_WIFI
    help
        This module provides a configuration for the WiFi module.

if MODULE_WIFI_CONFIGURATION

config WIFI_CONF_STORED_AP_NUMOF
    int "Nomer of WiFi access points that can be stored"
    default 2

endif # MODULE_WIFI_CONFIGURATION
```

## sys/net/lora/Kconfig
```kconfig
# Copyright (c) 2020 Freie Universitaet Berlin
#
# This file is subject to the terms and conditions of the GNU Lesser
# General Public License v2.1. See the file LICENSE in the top level
# directory for more details.
#

config MODULE_LORA
    bool "LoRa PHY support"
    depends on TEST_KCONFIG

menuconfig KCONFIG_USEMODULE_LORA
    bool "Configure LoRa PHY"
    depends on USEMODULE_LORA
    help
        Configure LoRa PHY using Kconfig.

if KCONFIG_USEMODULE_LORA

config LORA_PREAMBLE_LENGTH_DEFAULT
    int "Preamble length"
    range 8 65537
    default 8
    help
        Configure preamble used in LoRa frame. Each LoRa frame begins with a
        preamble. It starts with a series of upchirps to cover the whole
        frequency band of the particular channel assigned. The last two upchirps
        encode the sync word. Sync word is used to differntiate between LoRa
        transmissions that use the same frequency bands. The sync word is
        followed by two and a quarter downchirps, for a duration of 2.25
        symbols. The total duration of this preamble can be configured between
        10.25 and 65,539.25 symbol hence the range 8 to 65537.

config LORA_SYMBOL_TIMEOUT_DEFAULT
    int "Symbol timeout period in symbols"
    default 10
    help
        Configure symbol time out in terms of number of symbols. One symbol has
        a length in time of (2^SF)/BW seconds.

choice
    bool "Channel bandwidth"
    default LORA_BW_DEFAULT_125
    help
        Configure the channel bandwidth. Refer to country specific regulations
        on channel usage to identify the correct bandwidth.

config LORA_BW_DEFAULT_125
    bool "125kHz"

config LORA_BW_DEFAULT_250
    bool "250kHz"

config LORA_BW_DEFAULT_500
    bool "500kHz"

endchoice

choice
    bool "Spreading factor"
    default LORA_SF_DEFAULT_SF7
    help
        Configure Spreading Factor (SF). SF denotes the amount of spreading code
        applied to the original data signal. A larger SF increases the time on
        air, which increases energy consumption, reduces the data rate, and
        improves communication range. Each step up in spreading factor
        effectively doubles the time on air to transmit the same amount of data.
        Refer to country specific air time usage regulations before varying the
        SF. To calculate air time refer https://www.loratools.nl/#/airtime .

config LORA_SF_DEFAULT_SF6
    bool "SF6"

config LORA_SF_DEFAULT_SF7
    bool "SF7"

config LORA_SF_DEFAULT_SF8
    bool "SF8"

config LORA_SF_DEFAULT_SF9
    bool "SF9"

config LORA_SF_DEFAULT_SF10
    bool "SF10"

config LORA_SF_DEFAULT_SF11
    bool "SF11"

config LORA_SF_DEFAULT_SF12
    bool "SF12"

endchoice

choice
    bool "Coding rate"
    default LORA_CR_DEFAULT_CR_4_5
    help
        Configure Coding rate (CR). CR denotes the implementation of forward
        error correction (FEC). This may be done by encoding 4-bit data with
        redundancies into 5-bit, 6-bit, 7-bit, or 8-bit. Coding Rate (CR) value
        need to be adjusted according to conditions of the channel used for data
        transmission. If there are too many interferences in the channel, then
        it’s recommended to increase the value of CR. However, the rise in CR
        value will also increase the duration for the transmission. Refer to
        country specific air time usage regulations before varying the CR. To
        calculate air time refer https://www.loratools.nl/#/airtime .

config LORA_CR_DEFAULT_CR_4_5
    bool "CR 4/5"

config LORA_CR_DEFAULT_CR_4_6
    bool "CR 4/6"

config LORA_CR_DEFAULT_CR_4_7
    bool "CR 4/7"

config LORA_CR_DEFAULT_CR_4_8
    bool "CR 4/8"

endchoice

config LORA_IQ_INVERTED_DEFAULT
    bool "Enable inverted I/Q mode"
    help
        Enable this to invert the IQ signals used in RF modulation circuit. For
        more information on I/Q modulation technique visit
        http://www.ni.com/tutorial/4805/en/

config LORA_FREQUENCY_HOPPING_DEFAULT
    bool "Enable Frequency hopping spread spectrum (FHSS)"
    help
        Enabling Frequency hopping spread spectrum (FHSS) would imply that a
        portion of each LoRa packet is transmitted on each hopping channel from
        a look up table of frequencies managed by the host microcontroller.

config LORA_FREQUENCY_HOPPING_PERIOD_DEFAULT
    int "Frequency hopping period in symbols"
    default 0
    help
        Configure the hopping period, in symbols, time which each transmission
        will dwell in any given channel. One symbol has a length in time of
        (2^SF)/BW seconds.

config LORA_FIXED_HEADER_LEN_MODE_DEFAULT
    bool "Enable fixed header length mode (implicit header)"
    help
        Enable fixed header length mode ( implicit header) to discard PHY header
        (PHDR).

config LORA_PAYLOAD_CRC_OFF_DEFAULT
    bool "Disable payload CRC"

config LORA_PAYLOAD_LENGTH_DEFAULT
    int "Payload Length"
    default 0
    help
        Configure the length of payload. The option is unused while using
        explicit header mode as PHDR carries the length information.

endif # KCONFIG_USEMODULE_LORA
```

## sys/net/network_layer/Kconfig
```kconfig
# Copyright (c) 2021 HAW Hamburg
#
# This file is subject to the terms and conditions of the GNU Lesser
# General Public License v2.1. See the file LICENSE in the top level
# directory for more details.
#
menu "Network Layer"

rsource "ipv4/addr/Kconfig"
rsource "ipv6/addr/Kconfig"

endmenu # Network Layer
```

## sys/net/network_layer/ipv6/addr/Kconfig
```kconfig
# Copyright (c) 2021 HAW Hamburg
#
# This file is subject to the terms and conditions of the GNU Lesser
# General Public License v2.1. See the file LICENSE in the top level
# directory for more details.
#

config MODULE_IPV6_ADDR
    bool "IPv6 address conversion"
    depends on TEST_KCONFIG
```

## sys/net/network_layer/ipv6/hdr/Kconfig
```kconfig
# Copyright (c) 2020 HAW Hamburg
#
# This file is subject to the terms and conditions of the GNU Lesser
# General Public License v2.1. See the file LICENSE in the top level
# directory for more details.
#

config MOD_IPV6_HDR
    bool "IPv6 header functionalities"
    select MOD_IPV6_ADDR
    select MOD_INET_CSUM
    help
        Stack-independent module with IPv6 header functionalities.
```

## sys/net/sock/Kconfig
```kconfig
# Copyright (c) 2019 HAW Hamburg
#
# This file is subject to the terms and conditions of the GNU Lesser
# General Public License v2.1. See the file LICENSE in the top level
# directory for more details.
#
menuconfig KCONFIG_USEMODULE_SOCK_UTIL
    bool "Configure SOCK utility functions"
    depends on USEMODULE_SOCK_UTIL

if KCONFIG_USEMODULE_SOCK_UTIL

config SOCK_SCHEME_MAXLEN
    int "Maximum length of the scheme part"
    default 16
    help
        This value is used in sock_urlsplit().

config SOCK_HOSTPORT_MAXLEN
    int "Maximum length of host:port part"
    default 64
    help
        This value is used in sock_urlsplit().

config SOCK_URLPATH_MAXLEN
    int "Maximum path length"
    default 64
    help
        This value is used in sock_urlsplit().

endif # KCONFIG_USEMODULE_SOCK_UTIL

menuconfig KCONFIG_USEMODULE_SOCK_DTLS
    bool "Configure SOCK DTLS"
    depends on USEMODULE_SOCK_DTLS

if KCONFIG_USEMODULE_SOCK_DTLS

config DTLS_HANDSHAKE_BUFSIZE_EXP
    int "Exponent for the DTLS buffer size (resulting in the buffer size 2^n)"
    default 8
    help
        As the buffer size ALWAYS needs to be power of two, this option
        represents the exponent of 2^n, which will be used as the size of the
        buffer. The buffer is used to hold credentials during DTLS handshakes.

config DTLS_CREDENTIALS_MAX
    int "Buffer size for TLS credential tags"
    default 4

config DTLS_PSK_ID_HINT_MAX_SIZE
    int "Maximum size for a PSK Identity hint string"
    default 32

endif # KCONFIG_USEMODULE_SOCK_DTLS
```

## sys/od/Kconfig
```kconfig
# Copyright (c) 2020 HAW Hamburg
#
# This file is subject to the terms and conditions of the GNU Lesser
# General Public License v2.1. See the file LICENSE in the top level
# directory for more details.

menuconfig MODULE_OD
    bool "OD Hex Dump"
    select MODULE_FMT
    depends on TEST_KCONFIG

config MODULE_OD_STRING
    bool "Print ASCII representation of the dumped data"
    depends on MODULE_OD
```

## sys/oneway-malloc/Kconfig
```kconfig
# Copyright (c) 2021 HAW Hamburg
#
# This file is subject to the terms and conditions of the GNU Lesser
# General Public License v2.1. See the file LICENSE in the top level
# directory for more details.
#

config MODULE_ONEWAY_MALLOC
    bool "One way malloc"
    depends on TEST_KCONFIG
    help
        A malloc implementation without free for boards where the
        toolchain does not implement dynamic memory allocation.
```

## sys/phydat/Kconfig
```kconfig
# Copyright (c) 2020 HAW Hamburg
#
# This file is subject to the terms and conditions of the GNU Lesser
# General Public License v2.1. See the file LICENSE in the top level
# directory for more details.
#

config MODULE_PHYDAT
    bool "Phydat"
    depends on TEST_KCONFIG
    select MODULE_FMT
    help
        Generic data container for physical data and utility functions.
```

## sys/posix/Kconfig
```kconfig
# Copyright (c) 2021 HAW Hamburg
#
# This file is subject to the terms and conditions of the GNU Lesser
# General Public License v2.1. See the file LICENSE in the top level
# directory for more details.
#

menu "Posix"
    depends on TEST_KCONFIG

config MODULE_POSIX_HEADERS
    bool

rsource "inet/Kconfig"
rsource "sleep/Kconfig"

endmenu # Posix
```

## sys/posix/pthread/Kconfig
```kconfig
# Copyright (c) 2022 Inria
#
# This file is subject to the terms and conditions of the GNU Lesser
# General Public License v2.1. See the file LICENSE in the top level
# directory for more details.
#

config MODULE_PTHREAD
    bool "Pthread Support"
    depends on TEST_KCONFIG
    select MODULE_TIMEX
    select MODULE_ZTIMER
    select MODULE_ZTIMER64_XTIMER_COMPAT if MODULE_ZTIMER_XTIMER_COMPAT
    select ZTIMER64_USEC
```

## sys/preprocessor/Kconfig
```kconfig
# Copyright (c) 2022 Otto-von-Guericke-Universität Magdeburg
#
# This file is subject to the terms and conditions of the GNU Lesser
# General Public License v2.1. See the file LICENSE in the top level
# directory for more details.
#

config MODULE_PREPROCESSOR
    bool "Preprocessor utilities"
    depends on TEST_KCONFIG

config MODULE_PREPROCESSOR_SUCCESSOR
    bool "Generate preprocessor_successor.h to do preprocessor based successor arithmetic"
    depends on TEST_KCONFIG
    select MODULE_PREPROCESSOR
```

## sys/ps/Kconfig
```kconfig
# Copyright (c) 2020 HAW Hamburg
#
# This file is subject to the terms and conditions of the GNU Lesser
# General Public License v2.1. See the file LICENSE in the top level
# directory for more details.
#

config MODULE_PS
    bool "UNIX like ps command"
    depends on TEST_KCONFIG
```

## sys/psa_crypto/Kconfig.asymmetric
```kconfig
# Copyright (c) 2021 HAW Hamburg
#
# This file is subject to the terms and conditions of the GNU Lesser
# General Public License v2.1. See the file LICENSE in the top level
# directory for more details.
#

menuconfig MODULE_PSA_ASYMMETRIC
    bool "PSA Asymmetric Crypto"
    select MODULE_PSA_KEY_MANAGEMENT

if MODULE_PSA_ASYMMETRIC

menuconfig MODULE_PSA_ASYMMETRIC_ECC_P192R1
    bool "ECC NIST-P192R1"
    select PSA_KEY_SIZE_192

if MODULE_PSA_ASYMMETRIC_ECC_P192R1

choice PSA_ASYMMETRIC_ECC_P192R1_BACKEND
    bool "ECC NIST-P192R1 Implementation"

config MODULE_PSA_ASYMMETRIC_ECC_P192R1_BACKEND_PERIPH
    bool "Hardware accelerated with peripheral"
    depends on HAS_PERIPH_ECC_P192R1
    select MODULE_PERIPH_ECC_P192R1

config MODULE_PSA_ASYMMETRIC_ECC_P192R1_BACKEND_MICROECC
    bool "Micro-ECC Package"
    select PACKAGE_MICRO-ECC
    select MODULE_PSA_UECC_P192

endchoice

endif # MODULE_PSA_ASYMMETRIC_ECC_P192R1

menuconfig MODULE_PSA_ASYMMETRIC_ECC_P256R1
    bool "ECC NIST-P256R1"
    select PSA_KEY_SIZE_256

if MODULE_PSA_ASYMMETRIC_ECC_P256R1

choice PSA_ASYMMETRIC_ECC_P256R1_BACKEND
    bool "ECC NIST-P256R1 Implementation"

config MODULE_PSA_ASYMMETRIC_ECC_P256R1_BACKEND_PERIPH
    bool "Hardware Accelerated"
    depends on HAS_PERIPH_ECC_P256R1
    select MODULE_PERIPH_ECC_P256R1

config MODULE_PSA_ASYMMETRIC_ECC_P256R1_BACKEND_MICROECC
    bool "Micro-ECC Package"
    select PACKAGE_MICRO-ECC
    select MODULE_PSA_UECC_P256

endchoice

endif # MODULE_PSA_ASYMMETRIC_ECC_P256R1

menuconfig MODULE_PSA_ASYMMETRIC_ECC_ED25519
    bool "ECC Edwards25519"
    select PSA_KEY_SIZE_256

if MODULE_PSA_ASYMMETRIC_ECC_ED25519

choice MODULE_PSA_ASYMMETRIC_ECC_ED25519_BACKEND
    bool "ECC Edwards25519 Implementation"

config MODULE_PSA_ASYMMETRIC_ECC_ED25519_BACKEND_PERIPH
    bool "Hardware Accelerated"
    depends on HAS_PERIPH_ECC_ED25519
    select MODULE_PERIPH_ECC_ED25519

config MODULE_PSA_ASYMMETRIC_ECC_ED25519_BACKEND_C25519
    bool "C25519 Package"
    select PACKAGE_C25519
    select MODULE_PSA_C25519_EDSIGN

endchoice

endif # MODULE_PSA_ASYMMETRIC_ECC_ED25519

endif # MODULE_PSA_ASYMMETRIC
```
