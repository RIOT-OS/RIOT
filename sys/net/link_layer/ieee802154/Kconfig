## sys/net/link_layer/ieee802154/Kconfig
```kconfig
# SPDX-FileCopyrightText: 2020 HAW Hamburg
# SPDX-License-Identifier: LGPL-2.1-only

menu "IEEE802.15.4"
    depends on USEMODULE_IEEE802154

choice
    bool "IEEE802.15.4 default PHY mode"
    default IEEE802154_DEFAULT_PHY_OQPSK
    help
        IEEE802.15.4 default mode

    config IEEE802154_DEFAULT_PHY_BPSK
        bool "BPSK"
        help
            Binary Phase Shift Keying

    config IEEE802154_DEFAULT_PHY_ASK
        bool "ASK"
        help
            Amplitude-Shift Keying

    config IEEE802154_DEFAULT_PHY_OQPSK
        bool "O-QPSK"
        help
            Offset Quadrature Phase-Shift Keying

    config IEEE802154_DEFAULT_PHY_MR_OQPSK
        bool "MR-O-QPSK"
        help
            Multi-Rate Offset Quadrature Phase-Shift Keying

    config IEEE802154_DEFAULT_PHY_MR_OFDM
        bool "MR-OFDM"
        help
            Multi-Rate Orthogonal Frequency-Division Multiplexing

    config IEEE802154_DEFAULT_PHY_MR_FSK
        bool "MR-FSK"
        help
            Multi-Rate Frequency Shift Keying

endchoice # IEEE802.15.4 default PHY mode

config IEEE802154_DEFAULT_SUBGHZ_CHANNEL
    int "IEEE802.15.4 default sub-GHZ channel"
    default 5

config IEEE802154_DEFAULT_CHANNEL
    int "IEEE802.15.4 default channel"
    default 26

config IEEE802154_DEFAULT_PANID
    hex "IEEE802.15.4 default PANID"
    default 0x0023
    range 0x0 0xFFFF

config IEEE802154_DEFAULT_TXPOWER
    int "IEEE802.15.4 default TX power (in dBm)"
    default 0

config IEEE802154_DEFAULT_CSMA_CA_MIN
    int "IEEE802.15.4 default CSMA-CA minimum backoff exponent"
    default 3

config IEEE802154_DEFAULT_CSMA_CA_RETRIES
    int "IEEE802.15.4 default CSMA-CA maximum number of retries"
    default 4

config IEEE802154_DEFAULT_CSMA_CA_MAX
    int "IEEE802.15.4 default CSMA-CA maximum backoff exponent"
    default 5

config IEEE802154_DEFAULT_MAX_FRAME_RETRANS
    int "IEEE802.15.4 default maximum frame retransmissions"
    default 4

config IEEE802154_AUTO_ACK_DISABLE
    bool "Disable Auto ACK support" if (!USEPKG_OPENWSN && !USEPKG_OPENDSME)
    default y if (USEPKG_OPENWSN || USEPKG_OPENDSME)

config IEEE802154_DSME_CAP_REDUCTION
    bool "Enable CAP reduction" if USEPKG_OPENDSME
    default n if USEPKG_OPENDSME

config IEEE802154_DSME_SUPERFRAME_ORDER
    int "Set the DSME superframe order" if USEPKG_OPENDSME
    default 3
    help
        The SO sets the slot duration to `60 * symbol_time_us * 2^SO` usecs.
        E.g for O-QPSK an SO=3 renders a slot duration of `60 * 16 * 8` = 7.6 ms and
        a superframe duration of 122.88 ms.

        Settings this value to 3 allows to transmit full IEEE 802.15.4 O-QPSK frames
        (127 bytes).

config IEEE802154_DSME_MULTISUPERFRAME_ORDER
    int "Set the DSME multisuperframe order" if USEPKG_OPENDSME
    default 3
    help
        The MO sets the number of superframes per multisuperframe to `2^(MO-SO)`.

config IEEE802154_DSME_BEACON_ORDER
    int "Set the DSME beacon order" if USEPKG_OPENDSME
    default 3
    help
        The BO sets the beacon interval to `2^(BO-SO)` superframes.

config IEEE802154_DSME_STATIC_GTS
    bool "Use static GTS allocation" if USEPKG_OPENDSME
    default 0
    help
        When set, the MAC implementation will not use scheduling functions.
        This requires that the upper layer allocates slots manually using NETOPT_GTS_ALLOC.

config IEEE802154_DSME_GTS_EXPIRATION
    int "Set expiration time of DSME GTS slot" if USEPKG_OPENDSME
    default 16
    help
        Sets the expiration time of DSME GTS slot (in number of idle slots). If DSME
        detects no activity, it will deallocate the GTS slot.

config IEEE802154_DSME_MAC_RESPONSE_WAIT_TIME
    int "Set expiration time of DSME GTS slot" if USEPKG_OPENDSME
    default 244
    help
        This configuration sets the maximum wait times for MAC commands (association,
        DSME GTS allocation, etc).
        The unit is "base superframe duration" (60 * symbol_time_us).

config IEEE802154_DSME_SCAN_DURATION
    int "Set the scan duration" if USEPKG_OPENDSME
    default 4
    help
        Set the scan duration for each channel to `60 * symbol_time_us *
        (2^scanDuration + 1)`

config IEEE802154_DSME_MIN_COORD_LQI
    int "Set the minimum LQI to consider a beacon from a coordinator valid" if USEPKG_OPENDSME
    default 100

config IEEE802154_DEFAULT_ACK_REQ
    bool "Request ACKs by default"
    default y

menuconfig KCONFIG_MODULE_IEEE802154_MAC
    bool "Configure IEEE802.15.4 MAC using Kconfig"
    depends on USEMODULE_IEEE802154_MAC
    help
        Configure IEEE802.15.4 MAC compile-time parameters using Kconfig.
        When disabled, the defaults from the public MAC header remain active
        and can still be overridden by the legacy macro names.

if KCONFIG_MODULE_IEEE802154_MAC

config IEEE802154_MAC_TXQ_LEN
    int "IEEE802.15.4 MAC TX queue length"
    default 4
    range 1 255
    help
        Number of frames that can be queued in one MAC TX queue.
        For indirect transmission this is the queue depth per destination
        slot.

config IEEE802154_MAC_TICK_INTERVAL_MS
    int "IEEE802.15.4 MAC tick interval in ms"
    default 1
    range 1 65535
    help
        Period of the MAC maintenance tick. The tick drives indirect frame
        expiration, association response waiting, and sleepy polling windows.

config IEEE802154_MAC_FRAME_TIMEOUT
    int "IEEE802.15.4 MAC indirect frame timeout in symbols"
    default 125000
    range 1 2147483647
    help
        Lifetime of queued indirect frames in symbols. For 2.4 GHz O-QPSK
        with a 16 us symbol time, the default is about 2 seconds.

config IEEE802154_MAC_TX_INDIRECTQ_SIZE
    int "IEEE802.15.4 MAC indirect destination slots"
    default 4
    range 1 31
    help
        Number of destination slots in the indirect transmission queue.
        Each slot contains IEEE802154_MAC_TXQ_LEN frames. The upper bound is
        limited by the 32-bit free-mask used by the queue implementation.

config IEEE802154_MAC_ASSOC_TABLE_SIZE
    int "IEEE802.15.4 MAC association alias table size"
    default IEEE802154_MAC_TX_INDIRECTQ_SIZE
    range 1 31
    help
        Number of associated-device address alias entries remembered by the
        MAC. This is used to match a device's extended and short addresses.

config IEEE802154_MAC_BASE_SLOT_DURATION
    int "IEEE802.15.4 MAC base slot duration in symbols"
    default 60
    range 1 65535

config IEEE802154_MAC_MAX_LOST_BEACONS
    int "IEEE802.15.4 MAC maximum lost beacons"
    default 4
    range 1 255

config IEEE802154_MAC_MIN_CAP_LENGTH
    int "IEEE802.15.4 MAC minimum CAP length in symbols"
    default 440
    range 1 65535

config IEEE802154_MAC_NUM_SUPERFRAME_SLOTS
    int "IEEE802.15.4 MAC superframe slots"
    default 16
    range 1 255

endif # KCONFIG_MODULE_IEEE802154_MAC

menu "IEEE802.15.4 Security"
    depends on USEMODULE_IEEE802154_SECURITY

    config IEEE802154_SEC_DEFAULT_KEY
        string "Default key to be used for encryption and decryption (>=16B)"
        default "pizza_margherita"

endmenu # IEEE802.15.4 Security
endmenu # IEEE802.15.4
```

## sys/net/link_layer/l2filter/Kconfig
```kconfig
# SPDX-FileCopyrightText: 2020 Freie Universität Berlin
# SPDX-License-Identifier: LGPL-2.1-only

menu "L2filter"
    depends on USEMODULE_L2FILTER

config L2FILTER_ADDR_MAXLEN
    int "Maximum length of addresses that can be stored in the filter list"
    default 8

config L2FILTER_LISTSIZE
    int "Number of slots in each filter list (filter entries per device)"
    default 8

endmenu # L2filter
```

## sys/net/netif/Kconfig
```kconfig
# SPDX-FileCopyrightText: 2020 Freie Universität Berlin
# SPDX-License-Identifier: LGPL-2.1-only

menu "Network Interfaces"
    depends on USEMODULE_NETIF

config NETIF_NAMELENMAX
    int "Maximum length for an interface name"
    default 8

endmenu # Network Interfaces
```

## sys/progress_bar/Kconfig
```kconfig
# SPDX-FileCopyrightText: 2021 Inria
# SPDX-License-Identifier: LGPL-2.1-only

menu "progress bar module"
    depends on USEMODULE_PROGRESS_BAR

config PROGRESS_BAR_LENGTH
    int "Progress bar length"
    default 25
    help
       Progress bar maximum characters length

config PROGRESS_BAR_FULL_CHARACTER
    string "Progress bar character"
    default "█"
    help
        The character that will be printed when the progress bar fills up.

config PROGRESS_BAR_EMPTY_CHARACTER
    string "Progress bar empty character"
    default " "
    help
         The character that will be printed when the progress bar empties.

config PROGRESS_BAR_PREFIX_CHARACTER
    string "Progress bar prefix"
    default "|"
    help
        Character displayed on the left of the progress bar

config PROGRESS_BAR_SUFFIX_CHARACTER
    string "Progress bar suffix"
    default "|"
    help
        Character displayed on the left of the progress bar

config PROGRESS_BAR_PREFIX_MAX_LENGTH
    int "Progress bar prefix max length"
    default 32

config PROGRESS_BAR_SUFFIX_MAX_LENGTH
    int "Progress bar suffix max length"
    default 32

endmenu # progress bar module
```

## sys/psa_crypto/Kconfig
```kconfig
# SPDX-FileCopyrightText: 2021 HAW Hamburg
# SPDX-License-Identifier: LGPL-2.1-only

if USEMODULE_PSA_CRYPTO

rsource "Kconfig.keys"

rsource "psa_se_mgmt/Kconfig"

endif # USEMODULE_PSA_CRYPTO
```

## sys/psa_crypto/Kconfig.keys
```kconfig
# SPDX-FileCopyrightText: 2021 HAW Hamburg
# SPDX-License-Identifier: LGPL-2.1-only

menu "PSA Key Management Configuration"

config PSA_PROTECTED_KEY_COUNT
    int "Specifies number of allocated protected key slots"
    default 5 if USEMODULE_PSA_SECURE_ELEMENT
    default 0

config PSA_ASYMMETRIC_KEYPAIR_COUNT
    int "Specifies number of allocated key pair slots"
    default 0

config PSA_SINGLE_KEY_COUNT
    int "Specifies number of allocated single key slots"
    default 0

endmenu # PSA Key Management Configuration
```

## sys/psa_crypto/psa_se_mgmt/Kconfig
```kconfig
# SPDX-FileCopyrightText: 2022 HAW Hamburg
# SPDX-License-Identifier: LGPL-2.1-only

if USEMODULE_PSA_SECURE_ELEMENT

config PSA_MAX_SE_COUNT
    int
    prompt "Maximum number of secure elements" if USEMODULE_PSA_SECURE_ELEMENT_MULTIPLE
    range 2 255 if USEMODULE_PSA_SECURE_ELEMENT_MULTIPLE
    range 1 255

endif # USEMODULE_PSA_SECURE_ELEMENT
```

## sys/shell/Kconfig
```kconfig
# SPDX-FileCopyrightText: 2020 HAW Hamburg
# SPDX-License-Identifier: LGPL-2.1-only

menu "Shell interpreter"
    depends on USEMODULE_SHELL

rsource "Kconfig.config"

endmenu # Shell interpreter
```

## sys/shell/Kconfig.config
```kconfig
# SPDX-FileCopyrightText: 2021 Freie Universität
# SPDX-License-Identifier: LGPL-2.1-only

config SHELL_SHUTDOWN_ON_EXIT
    bool "Shutdown RIOT on shell exit"
    default y if HAS_CPU_NATIVE
    help
        Some systems (e.g Ubuntu 20.04) close stdin on CTRL-D / EOF
        That means we can't just re-start the shell.
        Instead terminate RIOT, which is also the behavior a user would expect
        from a CLI application.

config SHELL_NO_ECHO
    bool "Disable echo"

config SHELL_NO_PROMPT
    bool "Disable prompt"
```

## sys/shell_lock/Kconfig
```kconfig
# SPDX-FileCopyrightText: 2023 Inria
# SPDX-License-Identifier: LGPL-2.1-only

if USEMODULE_SHELL_LOCK

config SHELL_LOCK_PASSWORD
    string "Lock password"
    default "password"

config SHELL_LOCK_AUTO_LOCK_TIMEOUT_MS
    int "Timeout in ms before automatic locking"
    default 7000

endif # USEMODULE_SHELL_LOCK
```

## sys/usb/usbus/cdc/acm/Kconfig
```kconfig
# SPDX-FileCopyrightText: 2020 HAW Hamburg
# SPDX-License-Identifier: LGPL-2.1-only

menu "USBUS CDC ACM"
    depends on USEMODULE_USBUS_CDC_ACM

config USBUS_CDC_ACM_STDIO_BUF_SIZE_EXP
    int "Buffer size for STDIN and STDOUT data (as exponent of 2^n)"
    depends on USEMODULE_STDIO_CDC_ACM
    default 7
    range 0 31
    help
        As buffer size ALWAYS needs to be power of two, this changes this option
        represents the exponent of 2^n, which will be used as the size of the
        buffer.

choice
    bool "USB CDC ACM bulk endpoint size"
    default USBUS_CDC_ACM_BULK_EP_SIZE_64
    help
        This configures the maximum amount of bytes (chars) sent per transfer
        over the USB connection.

    config USBUS_CDC_ACM_BULK_EP_SIZE_8
        bool "8"

    config USBUS_CDC_ACM_BULK_EP_SIZE_16
        bool "16"

    config USBUS_CDC_ACM_BULK_EP_SIZE_32
        bool "32"

    config USBUS_CDC_ACM_BULK_EP_SIZE_64
        bool "64"

endchoice

endmenu # USBUS CDC ACM
```

## sys/usb/usbus/dfu/Kconfig
```kconfig
# SPDX-FileCopyrightText: 2020 Mesotic SAS
# SPDX-License-Identifier: LGPL-2.1-only

menu "USBUS DFU"
    depends on USEMODULE_USBUS_DFU

config USB_DFU_DETACH_TIMEOUT_MS
    int
    range 0 65535
    prompt "DFU detach timeout (ms)"
    default 255
    help
        Indicates the detach timeout USB device should advertise to
        the host USB. Host USB should abort the pending operation if
        device doesnt detach after this timeout.

config CUSTOM_RIOTBOOT_MAGIC_ADDR
    bool "Use custom DFU magic address"
    help
        Say n to use the default address, which is the last in RAM.

config RIOTBOOT_MAGIC_ADDR
    int "DFU magic address"
    depends on CUSTOM_RIOTBOOT_MAGIC_ADDR

endmenu # USBUS DFU
```

## sys/usb/usbus/hid/Kconfig
```kconfig
# SPDX-FileCopyrightText: 2021 HAW Hamburg
# SPDX-License-Identifier: LGPL-2.1-only

config USBUS_HID_INTERRUPT_EP_SIZE
    int "Interrupt endpoint size in bytes"
    default 64
    depends on USEMODULE_USBUS_HID
```

## tests/build_system/external_board_dirs/esp-ci-boards/esp32s2-ci/Kconfig
```kconfig
# SPDX-FileCopyrightText: 2020 HAW Hamburg
# SPDX-FileCopyrightText: 2022 Gunar Schorcht
# SPDX-License-Identifier: LGPL-2.1-only

config BOARD
    default "esp32s2-ci" if BOARD_ESP32S2_CI

config BOARD_ESP32S2_CI
    bool
    default y
    select BOARD_COMMON_ESP32S2
    select CPU_MODEL_ESP32S2_MINI_1X_N4R2

source "$(RIOTBOARD)/common/esp32s2/Kconfig"
```

## tests/build_system/external_board_dirs/esp-ci-boards/esp32s3-ci/Kconfig
```kconfig
# SPDX-FileCopyrightText: 2020 HAW Hamburg
# SPDX-FileCopyrightText: 2022 Gunar Schorcht
# SPDX-License-Identifier: LGPL-2.1-only

config BOARD
    default "esp32s3-ci" if BOARD_ESP32S3_CI

config BOARD_ESP32S3_CI
    bool
    default y
    select BOARD_COMMON_ESP32S3
    select CPU_MODEL_ESP32S3_WROOM_1X_N8R8

source "$(RIOTBOARD)/common/esp32s3/Kconfig"
```

## tests/build_system/external_board_dirs/netdev-ci-boards/nrf52840-ci-eth/Kconfig
```kconfig
# SPDX-FileCopyrightText: 2022 HAW Hamburg
# SPDX-License-Identifier: LGPL-2.1-only

config BOARD
    default "nrf52840-ci-eth" if BOARD_NRF52840DK_CI_ETH

config BOARD_NRF52840DK_CI_ETH
    bool
    default y
    select BOARDS_COMMON_NRF52XXXDK
    select CPU_MODEL_NRF52840XXAA

source "$(RIOTBOARD)/common/nrf52xxxdk/Kconfig"
```
