## sys/net/gnrc/network_layer/ipv6/Kconfig
```kconfig
# Copyright (c) 2020 HAW Hamburg
#
# This file is subject to the terms and conditions of the GNU Lesser
# General Public License v2.1. See the file LICENSE in the top level
# directory for more details.
#
menu "IPv6"

menu "GNRC IPv6 module"
    depends on USEMODULE_GNRC_IPV6

config GNRC_IPV6_MSG_QUEUE_SIZE_EXP
    int "Exponent for the message queue size used for the IPv6 thread (as 2^n)"
    default 3
    help
        As the queue size ALWAYS needs to be power of two, this option
        represents the exponent of 2^n, which will be used as the size of
        the queue.

config GNRC_IPV6_STATIC_LLADDR_ENABLE
    bool "Add a static IPv6 link local address to any network interface"
    help
         This allows to specify a certain link local IPv6 address to be assigned
         to a network interface on startup, which might be handy for testing.

         A interface will keep its auto-generated link local address, too.

config GNRC_IPV6_STATIC_LLADDR
    string "Static link-local address"
    depends on GNRC_IPV6_STATIC_LLADDR_ENABLE
    default "fe80::cafe:cafe:cafe:1"
    help
         The address is configured on each interface and incremented by the
         interface PID.

config GNRC_IPV6_STATIC_LLADDR_IS_FIXED
    bool "Same link-local address on every interface"
    depends on GNRC_IPV6_STATIC_LLADDR_ENABLE
    help
         Dont add the interface PID to the least significant byte
         of the address.

endmenu # GNRC IPv6 module

rsource "blacklist/Kconfig"
rsource "ext/frag/Kconfig"
rsource "nib/Kconfig"
rsource "whitelist/Kconfig"
rsource "static_addr/Kconfig"

endmenu # IPv6
```

## sys/net/gnrc/network_layer/ipv6/ext/frag/Kconfig
```kconfig
# Copyright (c) 2019 HAW Hamburg
#
# This file is subject to the terms and conditions of the GNU Lesser
# General Public License v2.1. See the file LICENSE in the top level
# directory for more details.
#
menu "GNRC IPv6 fragmentation and reassembly"
    depends on USEMODULE_GNRC_IPV6_EXT_FRAG

config GNRC_IPV6_EXT_FRAG_SEND_SIZE
    int "Number of entries IPv6 in the send buffer"
    default 1
    help
        This limits the total amount of datagrams that can be fragmented at
        the same time.

config GNRC_IPV6_EXT_FRAG_RBUF_SIZE
    int "Number of IPv6 fragmentation reassembly entries"
    default 1
    help
        This limits the total amount of datagrams that can be reassembled at
        the same time.

config GNRC_IPV6_EXT_FRAG_LIMITS_POOL_SIZE
    int "Number of allocatable fragment limit objects"
    default 2
    help
        Number of total allocable gnrc_ipv6_ext_frag_limits_t objects. This is
        the maximum number of receivable fragments, shared between all
        fragmented datagrams.

config GNRC_IPV6_EXT_FRAG_RBUF_TIMEOUT_US
    int "Timeout for IPv6 fragmentation reassembly buffer entries"
    default 10000000
    help
        This value is expressed in microseconds.

config GNRC_IPV6_EXT_FRAG_RBUF_DO_NOT_OVERRIDE
    bool "Do not override oldest datagram when reassembly buffer is full"
    help
        When not set, it will cause the reassembly buffer to override the oldest
        entry when a fragment for a new datagram is received. When set to 1, no
        entry will be overwritten (they will still timeout normally)

endmenu # GNRC IPv6 fragmentation and reassembly
```

## sys/net/gnrc/network_layer/ipv6/hdr/Kconfig
```kconfig
# Copyright (c) 2020 HAW Hamburg
#
# This file is subject to the terms and conditions of the GNU Lesser
# General Public License v2.1. See the file LICENSE in the top level
# directory for more details.
#

config MOD_GNRC_IPV6_HDR
    bool "IPv6 header"
    default y
    depends on MOD_GNRC_PKTBUF
    select MOD_IPV6_HDR
```

## sys/net/gnrc/network_layer/ipv6/nib/Kconfig
```kconfig
# Copyright (c) 2020 HAW Hamburg
#
# This file is subject to the terms and conditions of the GNU Lesser
# General Public License v2.1. See the file LICENSE in the top level
# directory for more details.
#
menu "GNRC IPv6 NIB"
    depends on USEMODULE_GNRC_IPV6_NIB

config GNRC_IPV6_NIB_6LBR
    bool "6LoWPAN border router features"
    default y if USEMODULE_GNRC_IPV6_NIB_6LBR
    help
        Enable 6LoWPAN Border Router (6LBR) features.
        @see https://tools.ietf.org/html/rfc6775#section-2

config GNRC_IPV6_NIB_6LR
    bool "6LoWPAN router features"
    default y if USEMODULE_GNRC_IPV6_NIB_6LR || GNRC_IPV6_NIB_6LBR
    help
        Enable 6LoWPAN Router (6LR) features.
        @see https://tools.ietf.org/html/rfc6775#section-2

config GNRC_IPV6_NIB_6LN
    bool "6LoWPAN node features"
    default y if USEMODULE_GNRC_IPV6_NIB_6LN || GNRC_IPV6_NIB_6LR
    help
        Enable 6LoWPAN Node (6LN) features.
        @see https://tools.ietf.org/html/rfc6775#section-2

config GNRC_IPV6_NIB_ROUTER
    bool "Router features"
    default y if USEMODULE_GNRC_IPV6_NIB_ROUTER || GNRC_IPV6_NIB_6LR

config GNRC_IPV6_NIB_SLAAC
    bool "Stateless address auto-configuration"
    default y if USEMODULE_GNRC_IPV6_NIB_6LBR
    default n if USEMODULE_GNRC_IPV6_NIB_6LR || USEMODULE_GNRC_IPV6_NIB_6LN
    default y

config GNRC_IPV6_NIB_SLAAC_TEMPORARY_ADDRESSES
    bool "Use temporary addresses (rfc8981)"
    depends on GNRC_IPV6_NIB_SLAAC

config GNRC_IPV6_NIB_QUEUE_PKT
    bool "Use packet queue with address resolution"
    default n if USEMODULE_GNRC_IPV6_NIB_6LN || GNRC_IPV6_NIB_6LN
    default y

config GNRC_IPV6_NIB_ARSM
    bool "Use classic NDP address resolution state-machine"
    default y if USEMODULE_GNRC_IPV6_NIB_6LBR
    default n if USEMODULE_GNRC_IPV6_NIB_6LN && !GNRC_IPV6_NIB_6LR
    default y

config GNRC_IPV6_NIB_DNS
    bool "Support for DNS configuration options"
    default y if USEMODULE_GNRC_IPV6_NIB_DNS

config GNRC_IPV6_NIB_ADV_ROUTER
    bool "Activate router advertising at interface start-up"
    default n if USEMODULE_DHCPV6_CLIENT_IA_PD || USEMODULE_GNRC_UHCPC
    default n if USEMODULE_GNRC_IPV6_AUTO_SUBNETS
    default y if GNRC_IPV6_NIB_ROUTER && (!GNRC_IPV6_NIB_6LR || GNRC_IPV6_NIB_6LBR)

config GNRC_IPV6_NIB_ADD_RIO_IN_LAST_RA
    bool "Include a Route Information Option for subnets"
    default y if USEMODULE_GNRC_IPV6_AUTO_SUBNETS
    default n
    help
        on other interfaces in the last Router Advertisement
        generated by @ref gnrc_ipv6_nib_change_rtr_adv_iface

if GNRC_IPV6_NIB_ADD_RIO_IN_LAST_RA
comment "Activating inclusion of the Route Information Option"
comment "requires the `gnrc_ipv6_nib_rio` module."
endif

config GNRC_IPV6_NIB_DC
    bool "Destination cache"

config GNRC_IPV6_NIB_MULTIHOP_P6C
    bool "Multihop prefix and 6LoWPAN context distribution"
    default y if GNRC_IPV6_NIB_6LR

config GNRC_IPV6_NIB_NO_RTR_SOL
    bool "Disable router solicitations"
    help
        @warning Only set this if you know what youre doing.

if GNRC_IPV6_NIB_NO_RTR_SOL
comment "Disabling router solicitations will make your host have to wait longer"
comment "for router advertisements. This option is only meant for testing and"
comment "experimentation and should not be activated in production."
endif

config GNRC_IPV6_NIB_NUMOF
    int "Number of entries in NIB"
    default 16 if USEMODULE_GNRC_IPV6_NIB_6LBR
    default 1 if USEMODULE_GNRC_IPV6_NIB_6LN && !GNRC_IPV6_NIB_6LR
    default 4

config GNRC_IPV6_NIB_REACH_TIME_RESET
    int "Reset time for the reachability time (milliseconds)"
    default 7200000
    help
        @see [RFC 4861, section 6.3.4](https://tools.ietf.org/html/rfc4861#section-6.3.4).

config GNRC_IPV6_NIB_L2ADDR_MAX_LEN
    int "Maximum link-layer address length (aligned)"
    default 8

config GNRC_IPV6_NIB_DEFAULT_ROUTER_NUMOF
    int "Number of default routers in the default router list"
    default 1
    help
        @attention This number has direct influence on the maximum number of
        neighbors and duplicate address detection table entries.

config GNRC_IPV6_NIB_OFFL_NUMOF
    int "Number of off-link entries in NIB"
    default 8
    help
        @attention This number is equal to the maximum number of forwarding
        table and prefix list entries in NIB.

config GNRC_IPV6_NIB_ABR_NUMOF
    int "Number of authoritative border router entries in NIB"
    default 1
    depends on GNRC_IPV6_NIB_MULTIHOP_P6C
    help
        @warning Behavior for >2 currently not specified or tested.

if GNRC_IPV6_NIB_ABR_NUMOF > 2
comment "Warning: Behavior for more than 2 Authoritative Border Router entries"
comment "is currently not specified or tested."
endif

endmenu # GNRC IPv6 NIB
```

## sys/net/gnrc/network_layer/ipv6/static_addr/Kconfig
```kconfig
# Copyright (c) 2022 ML!PA Consulting GmbH
#
# This file is subject to the terms and conditions of the GNU Lesser
# General Public License v2.1. See the file LICENSE in the top level
# directory for more details.
#
menu "Static IPv6 addresses and routes"
    depends on USEMODULE_GNRC_IPV6_STATIC_ADDR

config GNRC_IPV6_STATIC_ADDR
    string "Static IPv6 address of the upstream interface"
    default "2001:db8::100"

config GNRC_IPV6_STATIC_ADDR_UPSTREAM
    int "ID of the upstream interface, use 0 to auto-select wired interface"
    default 0

config GNRC_IPV6_STATIC_PREFIX
    string "Static IPv6 prefix for the downstream network"
    default "2001:db8:8000::/48"

config GNRC_IPV6_STATIC_ADDR_DOWNSTREAM
    int "ID of the downstream interface, use 0 to auto-select wireless interface"
    default 0

config GNRC_IPV6_STATIC_DEFAULT_ROUTER
    string "Static IPv6 address of the default router"

endmenu # Static IPv6 addresses and routes
```

## sys/net/gnrc/network_layer/ndp/Kconfig
```kconfig
# Copyright (c) 2020 HAW Hamburg
#
# This file is subject to the terms and conditions of the GNU Lesser
# General Public License v2.1. See the file LICENSE in the top level
# directory for more details.
#

config MOD_GNRC_NDP
    bool "IPv6 Neighbor Discovery support"
    default y
    depends on MOD_GNRC_ICMPV6
    depends on MOD_GNRC_NETIF
    depends on MOD_GNRC_IPV6_NIB
```

## sys/net/gnrc/network_layer/schc/Kconfig
```kconfig
# Copyright (c) 2020 University of Ghent
#
# This file is subject to the terms and conditions of the GNU Lesser
# General Public License v2.1. See the file LICENSE in the top level
# directory for more details.
#

menuconfig KCONFIG_MODULE_GNRC_SCHC
    bool "Configure GNRC SCHC"
    depends on MODULE_GNRC_SCHC
    help
        Configure GNRC SCHC module using Kconfig.

if KCONFIG_MODULE_GNRC_SCHC

config GNRC_SCHC_MSG_QUEUE_SIZE_EXP
    int "Exponent for the message queue size for the SCHC thread (as 2^n)"
    default 3
    help
        As the queue size ALWAYS needs to be power of two, this option
        represents the exponent of 2^n, which will be used as the size of
        the queue.

endif # KCONFIG_MODULE_GNRC_SCHC
```

## sys/net/gnrc/network_layer/sixlowpan/Kconfig
```kconfig
# Copyright (c) 2020 HAW Hamburg
#
# This file is subject to the terms and conditions of the GNU Lesser
# General Public License v2.1. See the file LICENSE in the top level
# directory for more details.
#

menu "GNRC 6LoWPAN"
    depends on USEMODULE_GNRC_SIXLOWPAN

rsource "frag/Kconfig"
rsource "nd/Kconfig"

config GNRC_SIXLOWPAN_MSG_QUEUE_SIZE_EXP
    int "Exponent for the message queue size for the 6LoWPAN thread (as 2^n)"
    default 3
    help
        As the queue size ALWAYS needs to be power of two, this option
        represents the exponent of 2^n, which will be used as the size of
        the queue.

endmenu # GNRC 6LoWPAN
```

## sys/net/gnrc/network_layer/sixlowpan/ctx/Kconfig
```kconfig
# Copyright (c) 2020 HAW Hamburg
#
# This file is subject to the terms and conditions of the GNU Lesser
# General Public License v2.1. See the file LICENSE in the top level
# directory for more details.
#

config MOD_GNRC_SIXLOWPAN_CTX
    bool "Contexts for 6LoWPAN address compression"
    default y
    depends on MOD_XTIMER
    select MOD_IPV6_ADDR
```

## sys/net/gnrc/network_layer/sixlowpan/frag/rb/Kconfig
```kconfig
# Copyright (c) 2020 HAW Hamburg
#
# This file is subject to the terms and conditions of the GNU Lesser
# General Public License v2.1. See the file LICENSE in the top level
# directory for more details.
#
menuconfig KCONFIG_USEMODULE_GNRC_SIXLOWPAN_FRAG_RB
    bool "Configure GNRC 6LoWPAN Reassembly buffer"
    depends on USEMODULE_GNRC_SIXLOWPAN_FRAG_RB
    help
        Configure GNRC 6LoWPAN Reassembly buffer using Kconfig.

if KCONFIG_USEMODULE_GNRC_SIXLOWPAN_FRAG_RB

config GNRC_SIXLOWPAN_FRAG_RBUF_SIZE
    int "Size of the reassembly buffer"
    default 4

config GNRC_SIXLOWPAN_FRAG_RBUF_TIMEOUT_US
    int "Timeout for reassembly buffer entries in microseconds"
    default 3000000

config GNRC_SIXLOWPAN_FRAG_RBUF_DO_NOT_OVERRIDE
    bool "Do not override oldest datagram when reassembly buffer is full"
    help
        When not set, it will cause the reassembly buffer to override the oldest
        entry when a fragment for a new datagram is received. When set, only the
        oldest entry that is older than @ref
        CONFIG_GNRC_SIXLOWPAN_FRAG_RBUF_TIMEOUT_US will be overwritten (they
        will still timeout normally if reassembly buffer is not full).

config GNRC_SIXLOWPAN_FRAG_RBUF_DEL_TIMER
    int "Deletion timer for reassembly buffer entries in microseconds"
    default 0
    help
        Time to pass between completion of a datagram and the deletion
        of its reassembly buffer entry. If this value is 0, the entry
        is dropped immediately. Use this value to prevent re-creation
        of a reassembly buffer entry on late arriving link-layer
        uplicates.

endif # KCONFIG_USEMODULE_GNRC_SIXLOWPAN_FRAG_RB
```
