## sys/net/gnrc/network_layer/sixlowpan/frag/sfr/Kconfig
```kconfig
# Copyright (c) 2020 Freie Universität Berlin
#
# This file is subject to the terms and conditions of the GNU Lesser
# General Public License v2.1. See the file LICENSE in the top level
# directory for more details.
#
menu "GNRC 6LoWPAN Selective Fragment Recovery"
    depends on USEMODULE_GNRC_SIXLOWPAN_FRAG_SFR

config GNRC_SIXLOWPAN_SFR_MIN_FRAG_SIZE
    int "Default minimum value for fragment size (MinFragmentSize)"
    default 96

config GNRC_SIXLOWPAN_SFR_MAX_FRAG_SIZE
    int "Default maximum value for fragment size (MaxFragmentSize)"
    default 112
    help
        It must be lower than the minimum MTU along the path. A large value
        augments the chances of buffer bloat and transmission loss. The value
        must be less than 512 if the unit is defined for the PHY layer is the
        octet.

config GNRC_SIXLOWPAN_SFR_OPT_FRAG_SIZE
    int "Default value for fragment size that the sender should use to start with (OptFragmentSize)"
    default 112
    help
        Must be inclusively between @ref GNRC_SIXLOWPAN_SFR_MIN_FRAG_SIZE and
        @ref GNRC_SIXLOWPAN_SFR_MAX_FRAG_SIZE

config GNRC_SIXLOWPAN_SFR_USE_ECN
    bool "Indicates whether the sender should react to Explicit Content Notification (UseECN)"
    default true if USEMODULE_GNRC_SIXLOWPAN_FRAG_SFR_CONGURE
    default false
    help
        When the sender reacts to Explicit Congestion Notification (ECN) its
        window size will vary between @ref
        CONFIG_GNRC_SIXLOWPAN_SFR_MIN_WIN_SIZE and @ref
        CONFIG_GNRC_SIXLOWPAN_SFR_MAX_WIN_SIZE.

if GNRC_SIXLOWPAN_SFR_USE_ECN && !USEMODULE_GNRC_SIXLOWPAN_FRAG_SFR_CONGURE
comment "Warning: Reaction to ECN requires module `gnrc_sixlowpan_frag_sfr_congure`"
endif

config GNRC_SIXLOWPAN_SFR_MIN_WIN_SIZE
    int "Default minimum value of window size that the sender can use (MinWindowSize)"
    default 1
    range 1 32

config GNRC_SIXLOWPAN_SFR_MAX_WIN_SIZE
    int "Default maximum value of window size that the sender can use (MaxWindowSize)"
    default 16
    range 1 32

config GNRC_SIXLOWPAN_SFR_OPT_WIN_SIZE
    int "Default value of window size that the sender should start with (OptWindowSize)"
    default 16
    range 1 32
    help
        Must be inclusively between @ref GNRC_SIXLOWPAN_SFR_MIN_WIN_SIZE and
        @ref GNRC_SIXLOWPAN_SFR_MAX_WIN_SIZE

config GNRC_SIXLOWPAN_SFR_INTER_FRAME_GAP_US
    int "Default minimum amount of time between transmissions in microseconds (InterFrameGap)"
    default 100
    help
        All packets to a same destination, and in particular fragments, may be
        subject to receive while transmitting and hidden terminal collisions
        with the next or the previous transmission as the fragments progress
        along a same path. The InterFrameGap protects the propagation of to one
        transmission before the next one is triggered and creates a duty cycle
        that controls the ratio of air and memory in intermediate nodes that a
        particular datagram will use.

config GNRC_SIXLOWPAN_SFR_MIN_ARQ_TIMEOUT_MS
    int "Minimum RFRAG-ACK timeout in msec before a node takes a next action (MinARQTimeOut)"
    default 350

config GNRC_SIXLOWPAN_SFR_MAX_ARQ_TIMEOUT_MS
    int "Maximum RFRAG-ACK timeout in msec before a node takes a next action (MaxARQTimeOut)"
    default 700

config GNRC_SIXLOWPAN_SFR_OPT_ARQ_TIMEOUT_MS
    int "Default RFRAG-ACK timeout in msec before a node takes a next action (OptARQTimeOut)"
    default 700
    help
        Must be inclusively between @ref GNRC_SIXLOWPAN_SFR_MIN_ARQ_TIMEOUT_MS
        and @ref GNRC_SIXLOWPAN_SFR_MAX_ARQ_TIMEOUT_MS

config GNRC_SIXLOWPAN_SFR_FRAG_RETRIES
    int "The maximum number of retries for a particular fragment (MaxFragRetries)"
    default 2

config GNRC_SIXLOWPAN_SFR_DG_RETRIES
    int "The maximum number of retries from scratch for a particular datagram (MaxDatagramRetries)"
    default 0

menu "SFR ECN based on the message queue of the incoming netif"
    depends on USEMODULE_GNRC_SIXLOWPAN_FRAG_SFR_ECN_IF_IN

config GNRC_SIXLOWPAN_SFR_ECN_IF_IN_NUM
    int "The numerator for the factor for when to mark ECN on incoming netif queue state"
    default 1
    help
        When `gnrc_sixlowpan_frag_sfr_ecn_if_in` is compiled in, nodes will set
        the ECN bit of an RFRAG header when the message queue of the incoming `netif`
        is filled by
        @ref CONFIG_GNRC_SIXLOWPAN_SFR_ECN_IF_IN_NUM / @ref CONFIG_GNRC_SIXLOWPAN_SFR_ECN_IF_IN_DEN

config GNRC_SIXLOWPAN_SFR_ECN_IF_IN_DEN
    int "The denominator for the factor for when to mark ECN on incoming netif queue state"
    default 2
    help
        When `gnrc_sixlowpan_frag_sfr_ecn_if_in` is compiled in, nodes will set the
        ECN bit of an RFRAG header when the message queue of the incoming `netif` is
        filled by
        @ref CONFIG_GNRC_SIXLOWPAN_SFR_ECN_IF_IN_NUM / @ref CONFIG_GNRC_SIXLOWPAN_SFR_ECN_IF_IN_DEN
endmenu # SFR ECN based on the message queue of the incoming netif

menu "SFR ECN based on the output queue of the outgoing netif"
    depends on USEMODULE_GNRC_SIXLOWPAN_FRAG_SFR_ECN_IF_OUT

config GNRC_SIXLOWPAN_SFR_ECN_IF_OUT_NUM
    int "The numerator for the factor for when to mark ECN on the outgoing netif's output queue state"
    default 1
    help
        When `gnrc_sixlowpan_frag_sfr_ecn_if_out` is compiled in, nodes will set
        the ECN bit of an RFRAG header when the output queue of the outgoing `netif`
        is filled by
        @ref CONFIG_GNRC_SIXLOWPAN_SFR_ECN_IF_OUT_NUM / @ref CONFIG_GNRC_SIXLOWPAN_SFR_ECN_IF_OUT_DEN

config GNRC_SIXLOWPAN_SFR_ECN_IF_OUT_DEN
    int "The denominator for the factor for when to mark ECN on the outgoing netif output queue state"
    default 2
    help
        When `gnrc_sixlowpan_frag_sfr_ecn_if_out` is compiled in, nodes will set the
        ECN bit of an RFRAG header when the output queue of the outgoing `netif` is
        filled by
        @ref CONFIG_GNRC_SIXLOWPAN_SFR_ECN_IF_OUT_NUM / @ref CONFIG_GNRC_SIXLOWPAN_SFR_ECN_IF_OUT_DEN
endmenu # SFR ECN based on the output queue of the outgoing netif

menu "SFR ECN based on SFR's frame queue"
    depends on USEMODULE_GNRC_SIXLOWPAN_FRAG_SFR_ECN_FQUEUE

config GNRC_SIXLOWPAN_SFR_ECN_FQUEUE_NUM
    int "The numerator for the factor for when to mark ECN on frame queue state"
    default 1
    help
        When `gnrc_sixlowpan_frag_sfr_ecn_fqueue` is compiled in, nodes will set the
        ECN bit of an RFRAG header when the frame queue for SFR is filled by
        @ref CONFIG_GNRC_SIXLOWPAN_SFR_ECN_FQUEUE_NUM / @ref CONFIG_GNRC_SIXLOWPAN_SFR_ECN_FQUEUE_DEN

config GNRC_SIXLOWPAN_SFR_ECN_FQUEUE_DEN
    int "The denominator for the factor for when to mark ECN on frame queue state"
    default 2
    help
        When `gnrc_sixlowpan_frag_sfr_ecn_fqueue` is compiled in, nodes will set the
        ECN bit of an RFRAG header when the frame queue for SFR is filled by
        @ref CONFIG_GNRC_SIXLOWPAN_SFR_ECN_FQUEUE_NUM / @ref CONFIG_GNRC_SIXLOWPAN_SFR_ECN_FQUEUE_DEN
endmenu # SFR ECN based on SFR's frame queue

config GNRC_SIXLOWPAN_SFR_MOCK_ARQ_TIMER
    bool "Deactivate automatic handling of ARQ timer"
    help
        This requires an external source (e.g. a test application) to call
        @ref gnrc_sixlowpan_frag_sfr_arq_timeout() for
        @ref net_gnrc_sixlowpan_frag_sfr to still work properly.

endmenu # GNRC 6LoWPAN Selective Fragment Recovery
```

## sys/net/gnrc/network_layer/sixlowpan/iphc/Kconfig
```kconfig
# Copyright (c) 2020 HAW Hamburg
#
# This file is subject to the terms and conditions of the GNU Lesser
# General Public License v2.1. See the file LICENSE in the top level
# directory for more details.
#

config MOD_GNRC_SIXLOWPAN_IPHC
    bool "IPv6 header compression (IPHC)"
    default y
    depends on MOD_GNRC_IPV6
    depends on MOD_GNRC_SIXLOWPAN
    depends on MOD_GNRC_SIXLOWPAN_CTX
    select MOD_GNRC_SIXLOWPAN_IPHC_NHC

config MOD_GNRC_SIXLOWPAN_IPHC_NHC
    bool
    # TODO: Add description?
```

## sys/net/gnrc/pktbuf/Kconfig
```kconfig
# Copyright (c) 2020 Freie Universitaet Berlin
#
# This file is subject to the terms and conditions of the GNU Lesser
# General Public License v2.1. See the file LICENSE in the top level
# directory for more details.
#
menu "GNRC Packet Buffer"
    depends on USEMODULE_GNRC_PKTBUF_STATIC

config GNRC_PKTBUF_SIZE
    int "Maximum size of the static packet buffer"
    default 6144
    help
        Set the value to 0 to allow dynamic memory management to allocate
        packets. The rational here is to have enough space for 4 full-MTU IPv6
        packets (2 incoming, 2 outgoing; 2 * 2 * 1280 B = 5 KiB) + Meta-Data
        (roughly estimated to 1 KiB; might be smaller).

endmenu # GNRC Packet Buffer
```

## sys/net/gnrc/routing/rpl/Kconfig
```kconfig
# Copyright (c) 2020 HAW Hamburg
#
# This file is subject to the terms and conditions of the GNU Lesser
# General Public License v2.1. See the file LICENSE in the top level
# directory for more details.
#

menu "RPL routing protocol"
    depends on USEMODULE_GNRC_RPL

menu "Trickle parameters"

config GNRC_RPL_DEFAULT_DIO_INTERVAL_DOUBLINGS
    int "DIO interval doublings"
    default 20
    help
        @see https://tools.ietf.org/html/rfc6550#section-8.3.1

config GNRC_RPL_DEFAULT_DIO_INTERVAL_MIN
    int "DIO interval minimum"
    default 3
    help
        @see https://tools.ietf.org/html/rfc6550#section-8.3.1

config GNRC_RPL_DEFAULT_DIO_REDUNDANCY_CONSTANT
    int "DIO redundancy constant"
    default 10
    help
        @see https://tools.ietf.org/html/rfc6550#section-8.3.1

endmenu # Trickle parameters


menu "Default parent and route entry lifetime"

config GNRC_RPL_DEFAULT_LIFETIME
    int "Default lifetime"
    default 5
    help
        The default lifetime will be multiplied but the lifetime unit to obtain
        the resulting lifetime.
        @see https://tools.ietf.org/html/rfc6550#section-6.7.6
        "DODAG Configuration"

config GNRC_RPL_LIFETIME_UNIT
    int "Lifetime unit"
    default 60

endmenu # Default parent and route entry lifetime


menu "Parameters used for DAO handling"

config GNRC_RPL_DAO_SEND_RETRIES
    int "Send retries"
    default 4

config GNRC_RPL_DAO_ACK_DELAY
    int "Acknowledge delay in milliseconds [ms]"
    default 3000

config GNRC_RPL_DAO_DELAY_LONG
    int "Long delay for DAOs in milliseconds [ms]"
    default 60000

config GNRC_RPL_DAO_DELAY_DEFAULT
    int "Default delay for DAOs in milliseconds [ms]"
    default 1000

config GNRC_RPL_DAO_DELAY_JITTER
    int "Jitter for DAOs in milliseconds [ms]"
    default 1000

config GNRC_RPL_CLEANUP_TIME
    int "Cleanup interval in milliseconds [ms]"
    default 5000

endmenu # Parameters used for DAO handling


choice
    bool "Mode of Operation"
    default GNRC_RPL_MOP_STORING_MODE_NO_MC

config GNRC_RPL_MOP_NO_DOWNWARD_ROUTES
    bool "No downward routes"

config GNRC_RPL_MOP_NON_STORING_MODE
    bool "Non storing"

config GNRC_RPL_MOP_STORING_MODE_NO_MC
    bool "Storing and no multicast"

config GNRC_RPL_MOP_STORING_MODE_MC
    bool "Storing and multicast"

endchoice


config GNRC_RPL_WITHOUT_PIO
    bool "Exclude Prefix Information Options from DIOs"

config GNRC_RPL_DODAG_CONF_OPTIONAL_ON_JOIN
    bool "Optional DODAG_CONF when joining a DODAG"
    help
        This will use the default trickle parameters until a DODAG_CONF is
        received from the parent. The DODAG_CONF is requested once from the
        parent while joining the DODAG. The standard behaviour is to request a
        DODAG_CONF and join once a DODAG once a DODAG_CONF is received.

config GNRC_RPL_WITHOUT_VALIDATION
    bool "Disable RPL control message validation"
    help
        By default, all incoming control messages get checked for validation.
        This validation can be disabled in case the involved RPL implementations
        are known to produce valid messages.

config GNRC_RPL_DEFAULT_MIN_HOP_RANK_INCREASE
    int "Default minimum hop rank increase"
    default 256
    help
        @see https://tools.ietf.org/html/rfc6550#section-17

config GNRC_RPL_DEFAULT_MAX_RANK_INCREASE
    int "Maximum rank increase"
    default 0

config GNRC_RPL_DEFAULT_INSTANCE
    int "Default Instance ID"
    default 0

config GNRC_RPL_PARENT_TIMEOUT_DIS_RETRIES
    int "Number of DIS retries"
    default 3
    help
        This is the number of DIS retries before the parent times out.

config GNRC_RPL_DEFAULT_NETIF
    int "Default network interface to run the protocol on"
    default 0
    depends on USEMODULE_AUTO_INIT_GNRC_RPL

config GNRC_RPL_MSG_QUEUE_SIZE_EXP
    int "Exponent for the thread's message queue size (as 2^n)"
    default 3
    help
        As the queue size ALWAYS needs to be power of two, this option
        represents the exponent of 2^n, which will be used as the size of
        the queue.

endmenu # RPL routing protocol
```
