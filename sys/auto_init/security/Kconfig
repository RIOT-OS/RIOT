## sys/auto_init/security/Kconfig
```kconfig
# Copyright (c) 2022 Inria
#
# This file is subject to the terms and conditions of the GNU Lesser
# General Public License v2.1. See the file LICENSE in the top level
# directory for more details.
#

config MODULE_AUTO_INIT_SECURITY
    bool "Security auto initialization module"
    depends on TEST_KCONFIG
```

## sys/base64/Kconfig
```kconfig
# Copyright (c) 2021 HAW Hamburg
#
# This file is subject to the terms and conditions of the GNU Lesser
# General Public License v2.1. See the file LICENSE in the top level
# directory for more details.
#

config MODULE_BASE64
    bool "Base64 codec"
    depends on TEST_KCONFIG

config MODULE_BASE64URL
    bool "Base64 URL codec"
    depends on TEST_KCONFIG
    select MODULE_BASE64
```

## sys/bhp/Kconfig
```kconfig
# Copyright (c) 2022 HAW Hamburg
#
# This file is subject to the terms and conditions of the GNU Lesser
# General Public License v2.1. See the file LICENSE in the top level
# directory for more details.
#

menu "Bottom Half Processor"

config HAVE_BHP_IRQ_HANDLER
    bool
    select MODULE_BHP
    help
        "Indicates that a module exposes an IRQ Handler to be offloaded to a
         Bottom Half Processor mechanism."

config MODULE_BHP
    bool

config MODULE_BHP_EVENT
    bool "Enable event based Bottom Half Processor implementation"
    depends on MODULE_EVENT
    depends on MODULE_BHP

config MODULE_BHP_MSG
    bool "Enable message based Bottom Half Processor implementation"
    depends on MODULE_CORE_MSG
    depends on MODULE_BHP

endmenu
```

## sys/bus/Kconfig
```kconfig
# Copyright (c) 2022 HAW Hamburg
#
# This file is subject to the terms and conditions of the GNU Lesser
# General Public License v2.1. See the file LICENSE in the top level
# directory for more details.
#

menuconfig MODULE_SYS_BUS
    bool "System buses"
    select MODULE_CORE_MSG_BUS
    help
        System buses subsystem.

config MODULE_SYS_BUS_POWER
    bool "Power bus"
    depends on MODULE_SYS_BUS
```

## sys/chunked_ringbuffer/Kconfig
```kconfig
# SPDX-FileCopyrightText: 2022 HAW Hamburg
# SPDX-License-Identifier: LGPL-2.1-only

config CHUNK_NUM_MAX
    int "Maximum number of chunks to store"
    depends on USEMODULE_CHUNKED_RINGBUFFER
    default 4
```

## sys/clif/Kconfig
```kconfig
# Copyright (c) 2023 Inria
#
# This file is subject to the terms and conditions of the GNU Lesser
# General Public License v2.1. See the file LICENSE in the top level
# directory for more details.
#

config MODULE_CLIF
    bool "CoRE Link format encoding and decoding library"
    depends on TEST_KCONFIG
```

## sys/color/Kconfig
```kconfig
# Copyright (c) 2020 HAW Hamburg
#
# This file is subject to the terms and conditions of the GNU Lesser
# General Public License v2.1. See the file LICENSE in the top level
# directory for more details.
#

config MODULE_COLOR
    bool "Handling RGB and HSV color"
    depends on TEST_KCONFIG
```

## sys/configuration/Kconfig
```kconfig
# Copyright (c) 2023 ML!PA Consulting GmbH
#
# This file is subject to the terms and conditions of the GNU Lesser
# General Public License v2.1. See the file LICENSE in the top level
# directory for more details.
#

menuconfig MODULE_CONFIGURATION
    bool "Runtime Configuration Module"
    help
        Backend agnostic runtime configuration module.

if MODULE_CONFIGURATION

config CONFIGURATION_DEPTH_MAX
    int "Maximum number of nested configuration items"

endif # MODULE_CONFIGURATION
```

## sys/congure/abe/Kconfig
```kconfig
# SPDX-FileCopyrightText: 2021 Freie Universität Berlin
# SPDX-License-Identifier: LGPL-2.1-only

if USEMODULE_CONGURE_ABE
rsource "Kconfig.config"
endif # USEMODULE_CONGURE_ABE
```

## sys/congure/mock/Kconfig
```kconfig
config MODULE_CONGURE_MOCK
    bool "CongURE mock implementation for testing"
    depends on MODULE_CONGURE
```

## sys/congure/quic/Kconfig
```kconfig
config MODULE_CONGURE_QUIC
    bool "CongURE implementation of QUIC's congestion control"
    depends on MODULE_CONGURE
    depends on MODULE_ZTIMER
```

## sys/congure/reno/Kconfig
```kconfig
config MODULE_CONGURE_RENO
    bool "CongURE implementation of TCP Reno"
    depends on MODULE_CONGURE
    select MODULE_CONGURE_RENO_METHODS

config MODULE_CONGURE_RENO_METHODS
    bool "Send driver methods for the CongURE implementation of TCP Reno"
    depends on MODULE_SEQ
    help
        Many other congestion control mechanisms are just adaptations of TCP
        Reno, so this makes the methods of @ref sys_congure_reno available to
        other @ref sys_congure modules. Use module `congure_reno_methods` to
        only compile in these modules, but not the driver for
        `congure_reno_snd_t` or @ref congure_reno_snd_setup().
```

## sys/cpp11-compat/Kconfig
```kconfig
# Copyright (C) 2022 Inria
#
# This file is subject to the terms and conditions of the GNU Lesser
# General Public License v2.1. See the file LICENSE in the top level
# directory for more details.
#

config MODULE_CPP11-COMPAT
    bool "C++11 wrapper for RIOT"
    depends on TEST_KCONFIG
    depends on HAS_CPP
    depends on HAS_LIBSTDCPP

    select MODULE_CPP
    select MODULE_CPP_NEW_DELETE
    select MODULE_XTIMER
    select MODULE_TIMEX
    select MODULE_ZTIMER64_XTIMER_COMPAT if MODULE_ZTIMER_XTIMER_COMPAT
```

## sys/cpp_new_delete/Kconfig
```kconfig
# Copyright (C) 2021 Gunar Schorcht
#
# This file is subject to the terms and conditions of the GNU Lesser
# General Public License v2.1. See the file LICENSE in the top level
# directory for more details.
#

config MODULE_CPP_NEW_DELETE
    bool
    depends on TEST_KCONFIG
    depends on MODULE_CPP
    help
        On some platforms libstdc++ is not used or not available, like on
        the AVR. Such platforms can use this module to implement the C++
        new and delete operators using malloc and free respectively. However,
        to be thread-safe, a thread-safe implementation of malloc and free
        must be present.
```

## sys/crypto/Kconfig
```kconfig
# Copyright (c) 2021 HAW Hamburg
#
# This file is subject to the terms and conditions of the GNU Lesser
# General Public License v2.1. See the file LICENSE in the top level
# directory for more details.
#

menu "Crypto"

config MODULE_CRYPTO
    bool "Common cryptographic functionalities"
    depends on TEST_KCONFIG

choice
    bool "Crypto block ciphers API implementation"
    optional
    depends on TEST_KCONFIG
    help
        The common Crypto block ciphers API has multiple implementations. Choose
        one of the following.

config CRYPTO_AES
    bool "AES"
    select MODULE_CRYPTO

endchoice

menu "Crypto AES options"
depends on CRYPTO_AES

config MODULE_CRYPTO_AES_128
    bool "AES-128"
    default y

config MODULE_CRYPTO_AES_192
    bool "AES-192"

config MODULE_CRYPTO_AES_256
    bool "AES-256"

config MODULE_CRYPTO_AES_PRECALCULATED
    bool "Pre-calculate T tables"

config MODULE_CRYPTO_AES_UNROLL
    bool "Unroll loop in AES"
    help
        This unrolls a loop in AES, but it uses more flash.

endmenu # Crypto AES options

rsource "modes/Kconfig"

endmenu # Crypto
```

## sys/crypto/modes/Kconfig
```kconfig
# Copyright (c) 2021 HAW Hamburg
#
# This file is subject to the terms and conditions of the GNU Lesser
# General Public License v2.1. See the file LICENSE in the top level
# directory for more details.
#

config MODULE_CIPHER_MODES
    bool "Modes for block ciphers"
    depends on MODULE_CRYPTO
    help
        Include common code for block cipher modes, such as CBC, ECB or OCB.
```

## sys/crypto/psa_riot_cipher/Kconfig
```kconfig
# Copyright (c) 2021 HAW Hamburg
#
# This file is subject to the terms and conditions of the GNU Lesser
# General Public License v2.1. See the file LICENSE in the top level
# directory for more details.
#

config MODULE_PSA_RIOT_CIPHER_AES_128_ECB
    bool
    depends on MODULE_PSA_CRYPTO
    select MODULE_CRYPTO_AES_128
    select MODULE_PSA_RIOT_CIPHER

config MODULE_PSA_RIOT_CIPHER_AES_128_CBC
    bool
    depends on MODULE_PSA_CRYPTO
    select MODULE_CRYPTO_AES_128
    select MODULE_PSA_RIOT_CIPHER

config MODULE_PSA_RIOT_CIPHER_AES_192_CBC
    bool
    depends on MODULE_PSA_CRYPTO
    select MODULE_CRYPTO_AES_192
    select MODULE_PSA_RIOT_CIPHER

config MODULE_PSA_RIOT_CIPHER_AES_256_CBC
    bool
    depends on MODULE_PSA_CRYPTO
    select MODULE_CRYPTO_AES_192
    select MODULE_PSA_RIOT_CIPHER

config MODULE_PSA_RIOT_CIPHER
    bool
    select MODULE_PSA_RIOT_CIPHER_AES_COMMON
    select MODULE_CIPHER_MODES

config MODULE_PSA_RIOT_CIPHER_AES_COMMON
    bool
```

## sys/cxx_ctor_guards/Kconfig
```kconfig
# Copyright (c) 2021 HAW Hamburg
#
# This file is subject to the terms and conditions of the GNU Lesser
# General Public License v2.1. See the file LICENSE in the top level
# directory for more details.
#

config MODULE_CXX_CTOR_GUARDS
    bool "C++ constructor guards for static instances"
    depends on TEST_KCONFIG
    help
        C++ constructor guards for thread-safe initialization of static instances.
        Warning! this module is likely only compatible with g++.
```

## sys/debug_irq_disable/Kconfig
```kconfig
# SPDX-FileCopyrightText: 2022 Benjamin Valentin
# SPDX-License-Identifier: LGPL-2.1-only

config DEBUG_IRQ_DISABLE_THRESHOLD
    int "Suppress Threshold"
    default 1
    depends on USEMODULE_DEBUG_IRQ_DISABLE
    help
        Threshold (in CPU ticks) below which periods with IRQs disabled are not printed.
        Use this to prevent *a lot* of output when debugging.
```

## sys/ecc/Kconfig
```kconfig
# Copyright (c) 2023 Inria
#
# This file is subject to the terms and conditions of the GNU Lesser
# General Public License v2.1. See the file LICENSE in the top level
# directory for more details.
#

menuconfig MODULE_ECC
    bool "Error Correction Code (ECC) algorithms"
    depends on TEST_KCONFIG
    help
        Provides Golay1412, Hamming256 and Repetition algorithms.

if MODULE_ECC

menu "ECC algorithms"

config MODULE_ECC_GOLAY1412
    bool "Golay1412 Error Correction Code (ECC) algorithm"
    help
        Provides Golay1412 ECC algorithm.

config MODULE_ECC_HAMMING256
    bool "Hamming256 Error Correction Code (ECC) algorithm"
    help
        Provides Hamming256 ECC algorithm.

config MODULE_ECC_REPETITION
    bool "Repetition Error Correction Code (ECC) algorithm"
    help
        Provides Repetition ECC algorithm.

endmenu  # ECC algorithms

endif
```

## sys/entropy_source/Kconfig
```kconfig
# SPDX-FileCopyrightText: 2020 HAW Hamburg
# SPDX-License-Identifier: LGPL-2.1-only

menu "Entropy sources"
    depends on USEMODULE_ENTROPY_SOURCE

config ENTROPY_SOURCE_TESTS_WIN
    int "Window size for Adaptive Proportion Test"
    default 512
    depends on ENTROPY_SOURCE_ADC_HEALTH_TEST || ENTROPY_SOURCE_ZERO_HEALTH_TEST
    help
        In (NIST SP 800-90B 4.4.2) a window size of 512 samples is recommended for non-binary
        sources. Typically, RIOT use cases will not request as many samples, thus, it might be worth
        considering a smaller window size so the test is more likely to complete a cycle. It is
        noteworthy that a cutoff value calculated by @ref entropy_source_test_prop_cutoff that is
        greater than the window size may lead to undetected errors.

config ENTROPY_SOURCE_NEUMANN_ABORT
    int "Abort factor for von Neumann extractor"
    default 5
    help
        Abort factor for von Neumann extractor. The algorithms runs as long as no bit
        changes appear in subsequent samples. This define adds a factor that
        aborts the procedure after (factor * requested length) samples.

rsource "adc_noise/Kconfig"
rsource "zero_entropy/Kconfig"

endmenu # Entropy sources
```

## sys/entropy_source/adc_noise/Kconfig
```kconfig
# Copyright (c) 2020 HAW Hamburg
#
# This file is subject to the terms and conditions of the GNU Lesser
# General Public License v2.1. See the file LICENSE in the top level
# directory for more details.

menu "ADC Noise entropy source module"
    depends on USEMODULE_ENTROPY_SOURCE_ADC_NOISE

choice
    bool "ADC default sampling resolution"
    default ENTROPY_SOURCE_ADC_RES_10BIT
    help
        This parameter sets the ADC sampling resolution. Please note that not all
        platforms support every value.

config ENTROPY_SOURCE_ADC_RES_6BIT
    bool "6 Bit"

config ENTROPY_SOURCE_ADC_RES_8BIT
    bool "8 Bit"

config ENTROPY_SOURCE_ADC_RES_10BIT
    bool "10 Bit"

config ENTROPY_SOURCE_ADC_RES_12BIT
    bool "12 Bit"

config ENTROPY_SOURCE_ADC_RES_14BIT
    bool "14 Bit"

config ENTROPY_SOURCE_ADC_RES_16BIT
    bool "16 Bit"

endchoice

config ENTROPY_SOURCE_ADC_LINE_NUM
    int "ADC line"
    range 0 16
    default 0
    help
        The ADC line maps to an I/O pin. This number acts as index to an array
        of predefined ADC devices that contain the pin definition. Typically,
        the array is defined by a board in a periph_conf.h file. Please note that
        a board is not required to specify a minimum number of lines.

config ENTROPY_SOURCE_ADC_HMIN
    int "Estimated entropy per sample [2^16 * bit/sample]"
    range 1 524288
    default 0
    help
        The entropy value needs to be estimated and evaluated thoroughly before
        deployment! To avoid float, the entropy value per one byte sample needs
        to be manually multiplied by 2^16 before configuring it (e.g., to
        an entropy value of 1 bit/sample, a value of 1 * 65536 needs to be set) .
        We default to zero which is an invalid configuration to enforce a
        thoughtful investigation on the actual entropy properties.

config ENTROPY_SOURCE_ADC_HEALTH_TEST
    bool "Enable health test"
    help
        Health tests are performed on every sample, if enabled. Thus, they
        slow down the entropy gathering process. Detected failures are reported by return
        value but they do not stop execution.

config ENTROPY_SOURCE_ADC_COND
    bool "Enable conditioning"
    help
        Conditioning increases runtime of the entropy generation process. Currently, a von
        Neumann extractor is involved which has an nondeterministic runtime.

endmenu # ADC Noise entropy source module
```

## sys/entropy_source/zero_entropy/Kconfig
```kconfig
# SPDX-FileCopyrightText: 2020 HAW Hamburg
# SPDX-License-Identifier: LGPL-2.1-only

menu "zero entropy source module"
    depends on USEMODULE_ENTROPY_SOURCE_ZERO_ENTROPY

config ENTROPY_SOURCE_ZERO_HMIN
    int "Estimated entropy per sample (byte)"
    default 58982
    help
        This is a dummy default value for testing. The zero entropy module does not
        contain any entropy at all.

config ENTROPY_SOURCE_ZERO_HEALTH_TEST
    bool "Enable health test"
    default y
    help
        Enable health test by default. Testing is the only purpose of this module.

config ENTROPY_SOURCE_ZERO_COND
    bool "Enable conditioning"
    help
        Disable conditioning by default. Conditioning is useless for zeros only. The von
        Neumann extractor would never finish and wait for the stop criterion given by
        @ref CONFIG_ENTROPY_SOURCE_NEUMANN_ABORT.

endmenu # zero entropy source module
```
