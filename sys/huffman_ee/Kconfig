## sys/huffman_ee/Kconfig
```kconfig
# SPDX-FileCopyrightText: 2026 Harshita
# SPDX-License-Identifier: LGPL-2.1-only

menu "Energy-aware Huffman coding"
    depends on USEMODULE_HUFFMAN_EE

config HUFFMAN_EE_MAX_SYMBOLS
    int "Maximum number of symbols in one table"
    default 256
    range 1 32767
    help
        Largest alphabet a huffman_ee table can hold. The build functions
        need about 16 bytes of stack per symbol, and the exact builders
        about 60 bytes per symbol.

endmenu # Energy-aware Huffman coding
```

## sys/net/gnrc/netif/pktq/Kconfig
```kconfig
menu "packet queues for GNRC network interface"
    depends on USEMODULE_GNRC_NETIF_PKTQ

config GNRC_NETIF_PKTQ_POOL_SIZE
    int "Packet queue pool size for all network interfaces"
    default 16

config GNRC_NETIF_PKTQ_TIMER_US
    int "Time in microseconds for when to try to send a queued packet at the latest"
    default 5000
    help
        Set to -1 to deactivate dequeuing by timer. For this it has to be ensured
        that none of the notifications by the driver are missed!

config GNRC_NETIF_PKTQ_MAX_BUSY_RETRIES
    int "Maximum number of retries of a queued packet when the medium is busy"
    default 3
    range 0 255
    help
        For netdevs implementing confirm_send(), -EBUSY on TX confirmation
        means that the medium was busy, e.g. CSMA-CA failed. The packet is
        then retried from the packet queue at most this number of times
        before it is dropped. With 0, the packet is dropped right away.

endmenu # packet queues for GNRC network interface
```
