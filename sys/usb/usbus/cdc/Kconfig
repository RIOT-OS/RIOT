## sys/usb/usbus/cdc/ecm/Kconfig
```kconfig
# Copyright (c) 2020 HAW Hamburg
#
# This file is subject to the terms and conditions of the GNU Lesser
# General Public License v2.1. See the file LICENSE in the top level
# directory for more details.
#
menuconfig KCONFIG_USEMODULE_USBUS_CDC_ECM
    bool "Configure USBUS CDC ECM"
    depends on USEMODULE_USBUS_CDC_ECM
    depends on KCONFIG_USEMODULE_USBUS
    help
        Configure the USBUS CDC ECM module via Kconfig.

if KCONFIG_USEMODULE_USBUS_CDC_ECM

config USBUS_CDC_ECM_CONFIG_SPEED_IND
    bool "Configure upload and download speeds independently"

config USBUS_CDC_ECM_CONFIG_SPEED
    int
    prompt "Link throughput (bits/second)" if !USBUS_CDC_ECM_CONFIG_SPEED_IND
    default 1000000
    help
        This defines a common up and down link throughput in bits/second. The
        USB peripheral will report this to the host. This doesn't affect the
        actual throughput, only what the peripheral reports to the host.

config USBUS_CDC_ECM_CONFIG_SPEED_DOWNSTREAM
    int
    prompt "Link download speed (bits/second)" if USBUS_CDC_ECM_CONFIG_SPEED_IND
    default USBUS_CDC_ECM_CONFIG_SPEED
    help
        This is the link download speed, defined in bits/second, that the USB
        peripheral will report to the host.

config USBUS_CDC_ECM_CONFIG_SPEED_UPSTREAM
    int
    prompt "Link upload speed (bits/second)" if USBUS_CDC_ECM_CONFIG_SPEED_IND
    default USBUS_CDC_ECM_CONFIG_SPEED
    help
        This is the link upload speed, defined in bits/second, that the USB
        peripheral will report to the host.

endif # KCONFIG_USEMODULE_USBUS_CDC_ECM
```

## sys/usb/usbus/msc/Kconfig
```kconfig
if USEMODULE_USBUS_MSC

config USBUS_MSC_AUTO_MTD
    bool "Automatically export all MTD devices via USB"
    default true
    help
        This will automatically export all MTD devices that follow
        the default naming scheme on startup.

config USBUS_MSC_VENDOR_ID
    string "MSC Vendor ID"
    default "RIOT-OS"

config USBUS_MSC_PRODUCT_ID
    string "MSC Product ID"
    default "RIOT_MSC_DISK"

config USBUS_MSC_PRODUCT_REV
    string "MSC Product Revision"
    default "1.0"

endif # USEMODULE_USBUS_MSC
```

## sys/usb_board_reset/Kconfig
```kconfig
# Copyright (c) 2021 HAW Hamburg
#
# This file is subject to the terms and conditions of the GNU Lesser
# General Public License v2.1. See the file LICENSE in the top level
# directory for more details.
#

config MODULE_USB_BOARD_RESET
    bool "Trigger a board reset via USB CDC ACM"
    depends on TEST_KCONFIG
    depends on MODULE_USBUS_CDC_ACM
```

## sys/ut_process/Kconfig
```kconfig
# Copyright (c) 2023 Inria
#
# This file is subject to the terms and conditions of the GNU Lesser
# General Public License v2.1. See the file LICENSE in the top level
# directory for more details.
#

config MODULE_UT_PROCESS
    bool "URI template processor"
    depends on TEST_KCONFIG

    select MODULE_FMT
```

## sys/uuid/Kconfig
```kconfig
# Copyright (c) 2023 Inria
#
# This file is subject to the terms and conditions of the GNU Lesser
# General Public License v2.1. See the file LICENSE in the top level
# directory for more details.
#

config MODULE_UUID
    bool "RFC 4122 compliant UUID's"
    depends on TEST_KCONFIG

    select MODULE_HASHES
    select MODULE_RANDOM
    select MODULE_FMT
```

## sys/vfs/Kconfig
```kconfig
# Copyright (c) 2021 HAW Hamburg
#
# This file is subject to the terms and conditions of the GNU Lesser
# General Public License v2.1. See the file LICENSE in the top level
# directory for more details.
#

config MODULE_VFS
    bool "Virtual File System (VFS)"
    depends on TEST_KCONFIG
    select MODULE_POSIX_HEADERS

config MODULE_VFS_DEFAULT
    bool "Use default (board specific) file systems and mount points"
    depends on MODULE_VFS
    imply MODULE_VFS_AUTO_MOUNT

config MODULE_VFS_AUTO_MOUNT
    bool "Automatically mount configured file systems"
    depends on MODULE_VFS

config MODULE_VFS_AUTO_FORMAT
    bool "Automatically format configured file systems if mount fails"
    depends on MODULE_VFS
```

## sys/xtimer/Kconfig
```kconfig
# Copyright (c) 2020 HAW Hamburg
#
# This file is subject to the terms and conditions of the GNU Lesser
# General Public License v2.1. See the file LICENSE in the top level
# directory for more details.
#

menuconfig MODULE_XTIMER
    bool "xtimer"
    depends on HAS_PERIPH_TIMER
    select MODULE_PERIPH_TIMER
    select MODULE_DIV if !MODULE_ZTIMER_XTIMER_COMPAT
    select ZTIMER_USEC if !MODULE_XTIMER_NO_ZTIMER_DEFAULT
    help
        Include xtimer module. xtimer requires a low-level timer implementation
        that can be provided either by a peripheral timer or the ztimer module
        when MODULE_XTIMER_ON_ZTIMER is enabled.

if MODULE_XTIMER

config MODULE_XTIMER_NO_ZTIMER_DEFAULT
    bool "xtimer does not select ztimer"

config MODULE_AUTO_INIT_XTIMER
    bool "Auto-init xtimer"
    default y if MODULE_AUTO_INIT && !MODULE_ZTIMER_XTIMER_COMPAT

endif # MODULE_XTIMER
```

## sys/ztimer/Kconfig
```kconfig
# Copyright (c) 2021 HAW Hamburg
#
# This file is subject to the terms and conditions of the GNU Lesser
# General Public License v2.1. See the file LICENSE in the top level
# directory for more details.
#

menu "ztimer - High level timer abstraction layer"

config ZTIMER_CUSTOM_BACKEND_CONFIGURATION
    bool "Override default backend selection"

config MODULE_ZTIMER_NO_PERIPH_RTT
    bool "Disable ztimer_periph_rtt auto-inclusion"
    help
        This module disables the auto-inclusion of ztimer_periph_rtt as a backend
        for ztimer_msec and ztimer_sec.

menu "Backends"
    visible if ZTIMER_CUSTOM_BACKEND_CONFIGURATION

config MODULE_ZTIMER_PERIPH_RTC
    bool "RTC peripheral"
    depends on HAS_PERIPH_RTC
    select MODULE_PERIPH_RTC

config MODULE_ZTIMER_PERIPH_RTT
    bool "RTT peripheral"
    depends on HAS_PERIPH_RTT
    select MODULE_PERIPH_RTT

config MODULE_ZTIMER_PERIPH_PTP
    bool "PTP peripheral"
    depends on HAS_PERIPH_PTP_TIMER
    select MODULE_PERIPH_PTP_TIMER

config MODULE_ZTIMER_PERIPH_TIMER
    bool "Timer peripheral"
    depends on HAS_PERIPH_TIMER
    select MODULE_PERIPH_TIMER

endmenu # Backends

menu "Clocks"

# TODO: this extra indirection in the entry point for ztimer_usec is required
# to allow xtimer compatibility modules to depend on ztimer being there while
# still selecting ztimer_usec.
config ZTIMER_USEC
    bool "Microseconds"
    select MODULE_ZTIMER_USEC
    select MODULE_ZTIMER_PERIPH_TIMER
    select MODULE_ZTIMER

config MODULE_ZTIMER_USEC
    bool

config MODULE_ZTIMER_MSEC
    bool "Milliseconds"
    select MODULE_ZTIMER

choice
    bool "Backend"
    depends on MODULE_ZTIMER_MSEC
    default ZTIMER_MSEC_BACKEND_RTT if !MODULE_ZTIMER_NO_PERIPH_RTT

config ZTIMER_MSEC_BACKEND_TIMER
    bool "Timer"
    select MODULE_ZTIMER_PERIPH_TIMER

config ZTIMER_MSEC_BACKEND_RTT
    bool "RTT"
    depends on HAS_PERIPH_RTT
    select MODULE_ZTIMER_PERIPH_RTT

endchoice

config MODULE_ZTIMER_SEC
    bool "Seconds"
    select MODULE_ZTIMER

choice
    bool "Backend"
    depends on MODULE_ZTIMER_SEC
    default ZTIMER_SEC_BACKEND_RTT if !MODULE_ZTIMER_NO_PERIPH_RTT

config ZTIMER_SEC_BACKEND_TIMER
    bool "Timer"
    select MODULE_ZTIMER_PERIPH_TIMER

config ZTIMER_SEC_BACKEND_RTT
    bool "RTT"
    depends on HAS_PERIPH_RTT
    select MODULE_ZTIMER_PERIPH_RTT

config ZTIMER_SEC_BACKEND_RTC
    bool "RTC"
    depends on HAS_PERIPH_RTC
    select MODULE_ZTIMER_PERIPH_RTC

endchoice

endmenu # Clocks

menu "Frequency conversion"
    depends on MODULE_ZTIMER

config MODULE_ZTIMER_CONVERT_MULDIV64
    bool "64-bits arithmetic conversion"
    select MODULE_ZTIMER_CONVERT
    help
        muldiv64 is very precise, but the overhead is the highest. On MCUs
        without hardware division this might not be a good choice.

config MODULE_ZTIMER_CONVERT_FRAC
    bool "Fractional conversion"
    select MODULE_ZTIMER_CONVERT
    select MODULE_FRAC
    help
        Frac can be used for arbitrary frequency conversions, but trades in
        precision to gain speed. In cases where shift conversion cannot be used,
        this is likely the best trade off.

config MODULE_ZTIMER_CONVERT_SHIFT
    bool "Shift conversion"
    select MODULE_ZTIMER_CONVERT
    help
        Shift conversion is both fast and super precise, but cannot work for
        arbitrary frequencies. It's kind of a software prescaler for the
        underlying clock. So if the hardware clock frequency and the target
        clock frequency differ by a factor that is a power of two, this is the
        best choice - otherwise it is simply not usable.

config MODULE_ZTIMER_CONVERT
    bool

endmenu # Frequency conversion


menu "xtimer and evtimer compatibility"

choice
    bool "xtimer compatibility"
    depends on MODULE_XTIMER && MODULE_ZTIMER && MODULE_ZTIMER_PERIPH_TIMER

config MODULE_XTIMER_ON_ZTIMER
    bool "ztimer_usec as timer backend for xtimer"
    select MODULE_ZTIMER_USEC

config MODULE_ZTIMER_XTIMER_COMPAT
    bool "map xtimer calls to ztimer"
    select MODULE_DIV
    select MODULE_ZTIMER_USEC
    help
        This is a wrapper of xtimer API on ztimer_usec and is currently
        incomplete. Unless doing testing, use xtimer on ztimer.

endchoice

comment "The ztimer xtimer compatibility module is incomplete, consider using MODULE_XTIMER_ON_ZTIMER instead."
    depends on MODULE_ZTIMER_XTIMER_COMPAT

config MODULE_EVTIMER_ON_ZTIMER
    bool "Use ztimer_msec as timer backend for evtimer"
    depends on MODULE_ZTIMER_MSEC
    select MODULE_ZTIMER_NOW64

endmenu # xtimer compatibility

config MODULE_ZTIMER
    bool
    depends on TEST_KCONFIG
    select MODULE_ZTIMER_CORE
    select MODULE_ZTIMER_CONVERT_FRAC
    select MODULE_ZTIMER_CONVERT_SHIFT
    select MODULE_ZTIMER_EXTEND

if MODULE_ZTIMER

config MODULE_AUTO_INIT_ZTIMER
    bool "Auto initialize ztimer"
    depends on MODULE_AUTO_INIT
    select MODULE_ZTIMER_INIT
    default y

config MODULE_ZTIMER_NOW64
    bool "Use a 64-bits result for ztimer_now()"

config MODULE_ZTIMER_OVERHEAD
    bool "Overhead measurement functionalities"

config MODULE_ZTIMER_MOCK
    bool "Mock backend (for testing only)"
    help
        This ztimer module implements a virtual clock that can be used for
        unittests. It can be manually adjusted to different timestamps and
        manually fired to simulate different scenarios and test the ztimer
        implementation using this as a backing timer.

config MODULE_ZTIMER_INIT
    bool

config MODULE_ZTIMER_CORE
    bool

config MODULE_ZTIMER_EXTEND
    bool

endif # MODULE_ZTIMER

endmenu
```

## sys/ztimer64/Kconfig
```kconfig
# Copyright (c) 2021 Inria
#
# This file is subject to the terms and conditions of the GNU Lesser
# General Public License v2.1. See the file LICENSE in the top level
# directory for more details.
#

menu "ztimer64 - High level timer abstraction layer"

config MODULE_ZTIMER64_USEC
    bool "Microseconds 64bit Timer"
    select MODULE_ZTIMER64
    depends on MODULE_ZTIMER_USEC

config MODULE_ZTIMER64_MSEC
    bool "Milliseconds 64bit Timer"
    select MODULE_ZTIMER64
    depends on MODULE_ZTIMER_MSEC

config MODULE_ZTIMER64_SEC
    bool "Milliseconds 64bit Timer"
    select MODULE_ZTIMER64
    depends on MODULE_ZTIMER_SEC

config MODULE_ZTIMER64_INIT
    bool

config MODULE_ZTIMER64
    bool
    depends on TEST_KCONFIG

if MODULE_ZTIMER64
config MODULE_AUTO_INIT_ZTIMER64
    bool "Auto initialize ztimer64"
    depends on MODULE_AUTO_INIT
    select MODULE_ZTIMER_INIT
    select MODULE_ZTIMER64_INIT
    default y
endif # MODULE_ZTIMER64

endmenu
```

## tests/build_system/cpp_exclude/external_modules/module_exclude/Kconfig
```kconfig
# Copyright (C) 2022 Inria
#
# This file is subject to the terms and conditions of the GNU Lesser
# General Public License v2.1. See the file LICENSE in the top level
# directory for more details.
#

config MODULE_MODULE_EXCLUDE
    bool "Exclude module"
    depends on TEST_KCONFIG
    depends on HAS_CPP
    depends on HAS_LIBSTDCPP
```

## tests/build_system/external_board_dirs/esp-ci-boards/esp32c3-ci/Kconfig
```kconfig
# Copyright (c) 2020 HAW Hamburg
#               2022 Gunar Schorcht
#
# This file is subject to the terms and conditions of the GNU Lesser
# General Public License v2.1. See the file LICENSE in the top level
# directory for more details.

config BOARD
    default "esp32c3-ci" if BOARD_ESP32C3_CI

config BOARD_ESP32C3_CI
    bool
    default y
    select BOARD_COMMON_ESP32C3
    select CPU_MODEL_ESP32C3_MINI_1X

source "$(RIOTBOARD)/common/esp32c3/Kconfig"
```

## tests/build_system/external_board_dirs/esp-ci-boards/esp32c6-ci/Kconfig
```kconfig
# SPDX-FileCopyrightText: 2025 Gunar Schorcht
# SPDX-License-Identifier: LGPL-2.1-only

config BOARD
    default "esp32c6-ci" if BOARD_ESP32C6_CI

config BOARD_ESP32C6_CI
    bool
    default y
    select BOARD_COMMON_ESP32C6
    select CPU_MODEL_ESP32C6_MINI_1X_X4

source "$(RIOTBOARD)/common/esp32c6/Kconfig"
```

## tests/build_system/external_board_dirs/esp-ci-boards/esp32h2-ci/Kconfig
```kconfig
# SPDX-FileCopyrightText: 2025 Gunar Schorcht
# SPDX-License-Identifier: LGPL-2.1-only

config BOARD
    default "esp32h2-ci" if BOARD_ESP32H2_CI

config BOARD_ESP32H2_CI
    bool
    default y
    select BOARD_COMMON_ESP32H2
    select CPU_MODEL_ESP32H2_MINI_1X_H4S

source "$(RIOTBOARD)/common/esp32h2/Kconfig"
```

## tests/build_system/external_pkg_dirs/external_pkgs/external_pkg/Kconfig
```kconfig
# Copyright (c) 2022 Niklaus Leuenberger
#
# This file is subject to the terms and conditions of the GNU Lesser
# General Public License v2.1. See the file LICENSE in the top level
# directory for more details.

config PACKAGE_EXTERNAL_PKG
    bool "external_pkg package"
    depends on TEST_KCONFIG
```

## tests/build_system/external_pkg_dirs/external_pkgs/external_pkg_not_used/Kconfig
```kconfig
# Copyright (c) 2022 Niklaus Leuenberger
#
# This file is subject to the terms and conditions of the GNU Lesser
# General Public License v2.1. See the file LICENSE in the top level
# directory for more details.

config PACKAGE_EXTERNAL_PKG_NOT_USED
    bool "external_pkg_not_used package"
    depends on TEST_KCONFIG
```

## tests/build_system/kconfig/Kconfig
```kconfig
menu "Application"

menuconfig KCONFIG_APP_MSG_1
    bool "Configure message 1"
    default y
    help
        This will enable configuring the first message via Kconfig

if KCONFIG_APP_MSG_1

config APP_MSG_1_TEXT
    string "Message 1 text"
    default "Message 1 defined in Kconfig file"

endif # KCONFIG_APP_MSG_1

config APP_MSG_2
    bool "Message 2"
    help
        Activate printing the second message

endmenu # Application
```

## tests/build_system/kconfig/external_modules/external_module_2/Kconfig
```kconfig
menuconfig KCONFIG_EXTERNAL_MODULE_2
    bool "Configure external module message 2"
    default y
    help
        This will enable configuring the external module message

if KCONFIG_EXTERNAL_MODULE_2

config EXTERNAL_MODULE_2_MESSAGE
    string "External module 2 text"
    default "External Message 2 defined in Kconfig file"

endif # KCONFIG_EXTERNAL_MODULE_2
```

## tests/build_system/kconfig/external_pkgs/external_pkg_1/Kconfig
```kconfig
menuconfig KCONFIG_EXTERNAL_PKG_1
    bool "Configure external package message 1"
    default y
    help
        This will enable configuring the external package message

if KCONFIG_EXTERNAL_PKG_1

config EXTERNAL_PKG_1_MESSAGE
    string "External package 1 text"
    default "External package message 1 defined in Kconfig file"

endif # KCONFIG_EXTERNAL_PKG_1
```
