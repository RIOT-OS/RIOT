## boards/common/kw41z/Kconfig
```kconfig
# Copyright (c) 2020 HAW Hamburg
#
# This file is subject to the terms and conditions of the GNU Lesser
# General Public License v2.1. See the file LICENSE in the top level
# directory for more details.

config BOARD_COMMON_KW41Z
    bool
    default y
    select CPU_MODEL_MKW41Z512VHT4
```

## boards/common/microbit/Kconfig
```kconfig
# Copyright (c) 2021 Inria
#
# This file is subject to the terms and conditions of the GNU Lesser
# General Public License v2.1. See the file LICENSE in the top level
# directory for more details.

config MODULE_MICROBIT
    bool "BBC micro:bit specific LED matrix handling"
    select MODULE_ZTIMER
    select ZTIMER_USEC
    select MODULE_MINEPLEX
```

## boards/common/msb-430/Kconfig
```kconfig
# SPDX-FileCopyrightText: 2020 HAW Hamburg
# SPDX-License-Identifier: LGPL-2.1-only

config BOARD_COMMON_MSB_430
    bool
    default y
    select CPU_MODEL_MSP430F1612
```

## boards/common/nrf51/Kconfig
```kconfig
# Copyright (c) 2020 HAW Hamburg
#
# This file is subject to the terms and conditions of the GNU Lesser
# General Public License v2.1. See the file LICENSE in the top level
# directory for more details.

config BOARD_COMMON_NRF51
    bool
    select HAS_PERIPH_RTT
    select HAS_PERIPH_TIMER

    select HAVE_SAUL_NRF_TEMPERATURE

config MODULE_BOARDS_COMMON_NRF51
    bool
    depends on TEST_KCONFIG
    help
       Common code of NRF51 boards

choice NRF5X_RADIO_BACKEND
    default MODULE_NRFMIN
endchoice
```

## boards/common/nrf52/Kconfig
```kconfig
# Copyright (c) 2020 HAW Hamburg
#
# This file is subject to the terms and conditions of the GNU Lesser
# General Public License v2.1. See the file LICENSE in the top level
# directory for more details.

config BOARD_COMMON_NRF52
    bool
    select HAS_PERIPH_RTT
    select HAS_PERIPH_TIMER
    select HAS_RIOTBOOT

    select HAVE_SAUL_NRF_TEMPERATURE
```

## boards/common/nrf52xxxdk/Kconfig
```kconfig
# Copyright (c) 2020 HAW Hamburg
#
# This file is subject to the terms and conditions of the GNU Lesser
# General Public License v2.1. See the file LICENSE in the top level
# directory for more details.

config BOARDS_COMMON_NRF52XXXDK
    bool
    select BOARD_COMMON_NRF52

source "$(RIOTBOARD)/common/nrf52/Kconfig"
```

## boards/common/nucleo/Kconfig
```kconfig
# SPDX-FileCopyrightText: 2021 HAW Hamburg
# SPDX-License-Identifier: LGPL-2.1-only

rsource "../stm32/Kconfig"
```

## boards/common/nucleo144/Kconfig
```kconfig
# SPDX-FileCopyrightText: 2020 Inria
# SPDX-License-Identifier: LGPL-2.1-only

config BOARD_COMMON_NUCLEO144
    bool

    # Clock configuration
    select BOARD_HAS_HSE if !CPU_FAM_L4 && !CPU_FAM_L5
    select BOARD_HAS_LSE

source "$(RIOTBOARD)/common/nucleo/Kconfig"
source "$(RIOTBOARD)/common/stm32/Kconfig"
```

## boards/common/nucleo32/Kconfig
```kconfig
# SPDX-FileCopyrightText: 2020 Inria
# SPDX-License-Identifier: LGPL-2.1-only

config BOARD_COMMON_NUCLEO32
    bool

    # Clock configuration
    select BOARD_HAS_LSE if (CPU_FAM_L0 || CPU_FAM_L4) && !BOARD_NUCLEO_L011K4

source "$(RIOTBOARD)/common/nucleo/Kconfig"
source "$(RIOTBOARD)/common/stm32/Kconfig"
```

## boards/common/nucleo64/Kconfig
```kconfig
# SPDX-FileCopyrightText: 2020 Inria
# SPDX-License-Identifier: LGPL-2.1-only

config BOARD_COMMON_NUCLEO64
    bool

    # Clock configuration
    select BOARD_HAS_HSE if !CPU_FAM_G0 && !CPU_FAM_L0 && !CPU_FAM_L1 && !CPU_FAM_L4
    select BOARD_HAS_LSE if !BOARD_NUCLEO_L152RE

source "$(RIOTBOARD)/common/nucleo/Kconfig"
source "$(RIOTBOARD)/common/stm32/Kconfig"
```

## boards/common/qn908x/Kconfig
```kconfig
# SPDX-FileCopyrightText: 2020 iosabi
# SPDX-License-Identifier: LGPL-2.1-only

config BOARD_COMMON_QN908X
    bool
    depends on CPU_FAM_QN908X
    # Add common board support here.
```

## boards/common/remote/Kconfig
```kconfig
# SPDX-FileCopyrightText: 2020 HAW Hamburg
# SPDX-License-Identifier: LGPL-2.1-only

config BOARD_COMMON_REMOTE
    bool
    default y
    select CPU_MODEL_CC2538SF53
```

## boards/common/samdx1-arduino-bootloader/Kconfig
```kconfig
# Copyright (c) 2021 HAW Hamburg
#
# This file is subject to the terms and conditions of the GNU Lesser
# General Public License v2.1. See the file LICENSE in the top level
# directory for more details.

config MODULE_BOARDS_COMMON_SAMDX1-ARDUINO-BOOTLOADER
    bool
    default y if MODULE_STDIO_CDC_ACM
    imply MODULE_USB_BOARD_RESET
    depends on TEST_KCONFIG
    help
       Common code of samdx1 boards with an arduino bootloader
```

## boards/common/saml1x/Kconfig
```kconfig
# Copyright (c) 2020 HAW Hamburg
#
# This file is subject to the terms and conditions of the GNU Lesser
# General Public License v2.1. See the file LICENSE in the top level
# directory for more details.

config BOARD_COMMON_SAML1X
    bool
    select HAS_PERIPH_ADC
    select HAS_PERIPH_DAC
    select HAS_PERIPH_I2C
    select HAS_PERIPH_PWM
    select HAS_PERIPH_RTC
    select HAS_PERIPH_RTT
    select HAS_PERIPH_SPI
    select HAS_PERIPH_TIMER
    select HAS_PERIPH_UART
    select HAS_RIOTBOOT

    select HAVE_SAUL_GPIO

config MODULE_BOARDS_COMMON_SAML1X
    bool
    depends on TEST_KCONFIG
    depends on BOARD_COMMON_SAML1X
    default y
    help
        Board specific code for the Microchip SAML10 and SAML11 Xplained Pro
        boards.
```

## boards/common/silabs/Kconfig
```kconfig
# Copyright (c) 2020 HAW Hamburg
#
# This file is subject to the terms and conditions of the GNU Lesser
# General Public License v2.1. See the file LICENSE in the top level
# directory for more details.

config BOARD_COMMON_SILABS
    bool
    select HAS_ARDUINO
    select HAS_EFM32_CORETEMP
    select HAS_RIOTBOOT

config MODULE_BOARDS_COMMON_SILABS
    bool
    depends on TEST_KCONFIG
    depends on BOARD_COMMON_SILABS
    default y
    help
        Common silabs board code.

rsource "drivers/Kconfig"
```

## boards/common/silabs/drivers/Kconfig
```kconfig
# Copyright (c) 2021 HAW Hamburg
#
# This file is subject to the terms and conditions of the GNU Lesser
# General Public License v2.1. See the file LICENSE in the top level
# directory for more details.
#

rsource "aem/Kconfig"
rsource "bc/Kconfig"
rsource "pic/Kconfig"
```

## boards/common/silabs/drivers/pic/Kconfig
```kconfig
# Copyright (c) 2021 HAW Hamburg
#
# This file is subject to the terms and conditions of the GNU Lesser
# General Public License v2.1. See the file LICENSE in the top level
# directory for more details.
#

config MODULE_SILABS_PIC
    bool
    depends on TEST_KCONFIG
    depends on BOARD_COMMON_SILABS
    depends on HAS_PERIPH_I2C
    select MODULE_PERIPH_I2C
    help
        Power-and-interrupt controller driver for silabs boards.
```

## boards/common/slwstk6000b/Kconfig
```kconfig
# SPDX-FileCopyrightText: 2020 HAW Hamburg
# SPDX-License-Identifier: LGPL-2.1-only

config BOARD_COMMON_SLWSTK6000B
    bool
    select BOARD_COMMON_SILABS

source "$(RIOTBOARD)/common/silabs/Kconfig"
```

## boards/common/sodaq/Kconfig
```kconfig
# Copyright (c) 2020 HAW Hamburg
#
# This file is subject to the terms and conditions of the GNU Lesser
# General Public License v2.1. See the file LICENSE in the top level
# directory for more details.

config BOARD_COMMON_SODAQ
    bool
    select HAS_PERIPH_ADC
    select HAS_PERIPH_I2C
    select HAS_PERIPH_RTC
    select HAS_PERIPH_RTT
    select HAS_PERIPH_SPI
    select HAS_PERIPH_TIMER
    select HAS_PERIPH_UART
    select HAS_PERIPH_USBDEV
    select HAS_ARDUINO
    select HAS_HIGHLEVEL_STDIO

    select HAVE_SAUL_GPIO

config MODULE_BOARDS_COMMON_SODAQ
    bool
    depends on TEST_KCONFIG
    help
        Common code for Sodaq boards.

source "$(RIOTBOARD)/common/samdx1-arduino-bootloader/Kconfig"
```

## boards/common/stm32/Kconfig
```kconfig
# Copyright (c) 2020 Inria
#
# This file is subject to the terms and conditions of the GNU Lesser
# General Public License v2.1. See the file LICENSE in the top level
# directory for more details.
#

config BOARD_HAS_HSE
    bool
    help
        Indicates that the board is providing an HSE oscillator

config BOARD_HAS_LSE
    bool
    help
        Indicates that the board is providing an LSE oscillator
```

## boards/common/stm32/Kconfig.g0
```kconfig
# Copyright (c) 2020 Inria
#
# This file is subject to the terms and conditions of the GNU Lesser
# General Public License v2.1. See the file LICENSE in the top level
# directory for more details.
#

menu "STM32 G0 clock configuration"
    depends on CPU_FAM_G0

choice
bool "Clock source selection"
default USE_CLOCK_PLL

config USE_CLOCK_PLL
    bool "PLL"

config USE_CLOCK_HSE
    bool "Direct High frequency external oscillator (HSE)"
    depends on BOARD_HAS_HSE

config USE_CLOCK_HSI
    bool "Direct High frequency internal oscillator (HSI16)"

endchoice

if USE_CLOCK_PLL
config CLOCK_PLL_M
    int "M: PLLIN division factor"
    default 1
    range 1 8

config CLOCK_PLL_N
    int "N: PLLIN multiply factor"
    default 20
    range 8 86

config CLOCK_PLL_R
    int "Q: VCO division factor"
    default 6 if BOARD_HAS_HSE
    default 5 if !BOARD_HAS_HSE
    range 2 8
endif

choice
bool "HSISYS division factor"
default CLOCK_HSISYS_DIV_1
depends on USE_CLOCK_HSI

config CLOCK_HSISYS_DIV_1
    bool "Divide HSISYS by 1"

config CLOCK_HSISYS_DIV_2
    bool "Divide HSISYS by 2"

config CLOCK_HSISYS_DIV_4
    bool "Divide HSISYS by 4"

config CLOCK_HSISYS_DIV_8
    bool "Divide HSISYS by 8"

config CLOCK_HSISYS_DIV_16
    bool "Divide HSISYS by 16"

config CLOCK_HSISYS_DIV_32
    bool "Divide HSISYS by 32"

config CLOCK_HSISYS_DIV_64
    bool "Divide HSISYS by 64"

config CLOCK_HSISYS_DIV_128
    bool "Divide HSISYS by 128"

endchoice

config CLOCK_HSISYS_DIV
    int
    default 1 if CLOCK_HSISYS_DIV_1
    default 2 if CLOCK_HSISYS_DIV_2
    default 4 if CLOCK_HSISYS_DIV_4
    default 8 if CLOCK_HSISYS_DIV_8
    default 16 if CLOCK_HSISYS_DIV_16
    default 32 if CLOCK_HSISYS_DIV_32
    default 64 if CLOCK_HSISYS_DIV_64
    default 128 if CLOCK_HSISYS_DIV_128

choice
bool "APB prescaler (division factor of HCLK to produce PCLK)"
default CLOCK_APB1_DIV_1

config CLOCK_APB1_DIV_1
    bool "Divide HCLK by 1"

config CLOCK_APB1_DIV_2
    bool "Divide HCLK by 2"

config CLOCK_APB1_DIV_4
    bool "Divide HCLK by 4"

config CLOCK_APB1_DIV_8
    bool "Divide HCLK by 8"

config CLOCK_APB1_DIV_16
    bool "Divide HCLK by 16"

endchoice

config CLOCK_APB1_DIV
    int
    default 1 if CLOCK_APB1_DIV_1
    default 2 if CLOCK_APB1_DIV_2
    default 4 if CLOCK_APB1_DIV_4
    default 8 if CLOCK_APB1_DIV_8
    default 16 if CLOCK_APB1_DIV_16

endmenu

source "$(RIOTBOARD)/common/stm32/Kconfig"
```

## boards/common/weact-f4x1cx/Kconfig
```kconfig
# SPDX-FileCopyrightText: 2020 Benjamin Valentin
# SPDX-License-Identifier: LGPL-2.1-only

config BOARD_COMMON_WEACT_F4X1CX
    bool

    # Clock configuration
    select BOARD_HAS_HSE
    select BOARD_HAS_LSE

config CLOCK_HSE
    default 25000000

source "$(RIOTBOARD)/common/stm32/Kconfig"
```

## boards/crazyflie/Kconfig
```kconfig
# Copyright (c) 2025 Leonard Herbst
#
# This file is subject to the terms and conditions of the GNU Lesser
# General Public License v2.1. See the file LICENSE in the top level
# directory for more details.

config BOARD
    default "crazyflie" if BOARD_CRAZYFLIE

config BOARD_CRAZYFLIE
    bool
    default y
    select CPU_MODEL_STM32F405RG

    # Put defined MCU peripherals here (in alphabetical order)

    # Put other features for this board (in alphabetical order)
```

## boards/derfmega128/Kconfig
```kconfig
# SPDX-FileCopyrightText: 2020 HAW Hamburg
# SPDX-License-Identifier: LGPL-2.1-only

config BOARD
    default "derfmega128" if BOARD_DERFMEGA128

config BOARD_DERFMEGA128
    bool
    default y
    select CPU_MODEL_ATMEGA128RFA1
```

## boards/derfmega256/Kconfig
```kconfig
# SPDX-FileCopyrightText: 2020 HAW Hamburg
# SPDX-License-Identifier: LGPL-2.1-only

config BOARD
    default "derfmega256" if BOARD_DERFMEGA256

config BOARD_DERFMEGA256
    bool
    default y
    select CPU_MODEL_ATMEGA256RFR2
```
