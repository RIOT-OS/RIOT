## boards/esp32s3-devkit/Kconfig
```kconfig
# Copyright (c) 2020 HAW Hamburg
#               2022 Gunar Schorcht
#
# This file is subject to the terms and conditions of the GNU Lesser
# General Public License v2.1. See the file LICENSE in the top level
# directory for more details.

config BOARD
    default "esp32s3-devkit" if BOARD_ESP32S3_DEVKIT

config BOARD_VERSION
    string
    default "esp32s3-devkitc-1-n8" if BOARD_VERSION_ESP32S3_DEVKITC_1_N8
    default "esp32s3-devkitc-1-n8r2" if BOARD_VERSION_ESP32S3_DEVKITC_1_N8R2
    default "esp32s3-devkitc-1-n8r8" if BOARD_VERSION_ESP32S3_DEVKITC_1_N8R8
    default "esp32s3-devkitc-1-n16r8v" if BOARD_VERSION_ESP32S3_DEVKITC_1_N16R8V
    default "esp32s3-devkitc-1-n32r8v" if BOARD_VERSION_ESP32S3_DEVKITC_1_N32R8V
    default "esp32s3-devkitc-1u-n8" if BOARD_VERSION_ESP32S3_DEVKITC_1U_N8
    default "esp32s3-devkitc-1u-n8r2" if BOARD_VERSION_ESP32S3_DEVKITC_1U_N8R2
    default "esp32s3-devkitc-1u-n8r8" if BOARD_VERSION_ESP32S3_DEVKITC_1U_N8R8
    default "esp32s3-devkitm-1-n8" if BOARD_VERSION_ESP32S3_DEVKITM_1_N8
    default "esp32s3-devkitm-1u-n8" if BOARD_VERSION_ESP32S3_DEVKITM_1U_N8
    help
        Set variable BOARD_VERSION for the make system.

config BOARD_ESP32S3_DEVKIT
    bool
    default y
    select BOARD_COMMON_ESP32S3
    select CPU_MODEL_ESP32S3_WROOM_1X_N8 if BOARD_VERSION_ESP32S3_DEVKITC_1_N8
    select CPU_MODEL_ESP32S3_WROOM_1X_N8R2 if BOARD_VERSION_ESP32S3_DEVKITC_1_N8R2
    select CPU_MODEL_ESP32S3_WROOM_1X_N8R8 if BOARD_VERSION_ESP32S3_DEVKITC_1_N8R8
    select CPU_MODEL_ESP32S3_WROOM_1X_N16R8V if BOARD_VERSION_ESP32S3_DEVKITC_1_N16R8V
    select CPU_MODEL_ESP32S3_WROOM_1X_N32R8V if BOARD_VERSION_ESP32S3_DEVKITC_1_N32R8V
    select CPU_MODEL_ESP32S3_WROOM_1X_N8 if BOARD_VERSION_ESP32S3_DEVKITC_1U_N8
    select CPU_MODEL_ESP32S3_WROOM_1X_N8R2 if BOARD_VERSION_ESP32S3_DEVKITC_1U_N8R2
    select CPU_MODEL_ESP32S3_WROOM_1X_N8R8 if BOARD_VERSION_ESP32S3_DEVKITC_1U_N8R8
    select CPU_MODEL_ESP32S3_MINI_1X_N8 if BOARD_VERSION_ESP32S3_DEVKITM_1_N8
    select CPU_MODEL_ESP32S3_MINI_1X_N8 if BOARD_VERSION_ESP32S3_DEVKITM_1U_N8

    choice
        bool "ESP32-S3-DevKit board version"
        default BOARD_VERSION_ESP32S3_DEVKITC_1_N8

        config BOARD_VERSION_ESP32S3_DEVKITC_1_N8
            bool "ESP32-S3-DevKitC-1-N8"
        config BOARD_VERSION_ESP32S3_DEVKITC_1_N8R2
            bool "ESP32-S3-DevKitC-1-N8R2"
        config BOARD_VERSION_ESP32S3_DEVKITC_1_N8R8
            bool "ESP32-S3-DevKitC-1-N8R8"
        config BOARD_VERSION_ESP32S3_DEVKITC_1_N16R8V
            bool "ESP32-S3-DevKitC-1-N16R8V"
        config BOARD_VERSION_ESP32S3_DEVKITC_1_N32R8V
            bool "ESP32-S3-DevKitC-1-N32R8V"
        config BOARD_VERSION_ESP32S3_DEVKITC_1U_N8
            bool "ESP32-S3-DevKitC-1U-N8"
        config BOARD_VERSION_ESP32S3_DEVKITC_1U_N8R2
            bool "ESP32-S3-DevKitC-1U-N8R2"
        config BOARD_VERSION_ESP32S3_DEVKITC_1U_N8R8
            bool "ESP32-S3-DevKitC-1U-N8R8"
        config BOARD_VERSION_ESP32S3_DEVKITM_1_N8
            bool "ESP32-S3-DevKitM-1-N8"
        config BOARD_VERSION_ESP32S3_DEVKITM_1U_N8
            bool "ESP32-S3-DevKitM-1U-N8"
    endchoice

source "$(RIOTBOARD)/common/esp32s3/Kconfig"
```

## boards/esp32s3-pros3/Kconfig
```kconfig
# SPDX-FileCopyrightText: 2020 HAW Hamburg
# SPDX-FileCopyrightText: 2023 Gunar Schorcht
# SPDX-License-Identifier: LGPL-2.1-only

config BOARD
    default "esp32s3-pros3" if BOARD_ESP32S3_PROS3

config BOARD_ESP32S3_PROS3
    bool
    default y
    select BOARD_COMMON_ESP32S3
    select CPU_MODEL_ESP32S3

source "$(RIOTBOARD)/common/esp32s3/Kconfig"
```

## boards/esp32s3-seeedstudio/Kconfig
```kconfig
# Copyright (c) 2024 TUDresden
#               2024 Isikcan 'Jon' Yilmaz - TUDresden
#
# This file is subject to the terms and conditions of the GNU Lesser
# General Public License v2.1. See the file LICENSE in the top level
# directory for more details.

config BOARD
    default "esp32s3-seeedstudio" if BOARD_ESP32S3_SEEEDSTUDIO

config BOARD_ESP32S3_SEEEDSTUDIO
    bool
    default y
    select BOARD_COMMON_ESP32S3
    select CPU_MODEL_ESP32S3

source "$(RIOTBOARD)/common/esp32s3/Kconfig"
```

## boards/esp32s3-usb-otg/Kconfig
```kconfig
# SPDX-FileCopyrightText: 2020 HAW Hamburg
# SPDX-FileCopyrightText: 2022 Gunar Schorcht
# SPDX-License-Identifier: LGPL-2.1-only

config BOARD
    default "esp32s3-usb-otg" if BOARD_ESP32S3_USB_OTG

config BOARD_ESP32S3_USB_OTG
    bool
    default y
    select BOARD_COMMON_ESP32S3
    select CPU_MODEL_ESP32S3_MINI_1X_N8

source "$(RIOTBOARD)/common/esp32s3/Kconfig"
```

## boards/esp32s3-wt32-sc01-plus/Kconfig
```kconfig
# Copyright (c) 2020 HAW Hamburg
#               2023 Gunar Schorcht
#
# This file is subject to the terms and conditions of the GNU Lesser
# General Public License v2.1. See the file LICENSE in the top level
# directory for more details.

config BOARD
    default "esp32s3-wt32-sc01-plus" if BOARD_ESP32S3_WT32_SC01_PLUS

config BOARD_ESP32S3_WT32_SC01_PLUS
    bool
    default y
    select BOARD_COMMON_ESP32S3
    select CPU_MODEL_ESP32S3_WROOM_1X_N16R2

source "$(RIOTBOARD)/common/esp32s3/Kconfig"
```

## boards/esp8266-esp-12x/Kconfig
```kconfig
# SPDX-FileCopyrightText: 2020 HAW Hamburg
# SPDX-License-Identifier: LGPL-2.1-only

config BOARD
    default "esp8266-esp-12x" if BOARD_ESP8266_ESP_12X

config BOARD_ESP8266_ESP_12X
    bool
    default y
    select BOARD_COMMON_ESP8266
    select CPU_MODEL_ESP8266_ESP_12X

source "$(RIOTBOARD)/common/esp8266/Kconfig"
```

## boards/esp8266-olimex-mod/Kconfig
```kconfig
# SPDX-FileCopyrightText: 2020 HAW Hamburg
# SPDX-License-Identifier: LGPL-2.1-only

config BOARD
    default "esp8266-olimex-mod" if BOARD_ESP8266_OLIMEX_MOD

config BOARD_ESP8266_OLIMEX_MOD
    bool
    default y
    select BOARD_COMMON_ESP8266
    select CPU_MODEL_ESP8266_ESP_12X

source "$(RIOTBOARD)/common/esp8266/Kconfig"
```

## boards/esp8266-sparkfun-thing/Kconfig
```kconfig
# SPDX-FileCopyrightText: 2020 HAW Hamburg
# SPDX-License-Identifier: LGPL-2.1-only

config BOARD
    default "esp8266-sparkfun-thing" if BOARD_ESP8266_SPARKFUN_THING

config BOARD_ESP8266_SPARKFUN_THING
    bool
    default y
    select BOARD_COMMON_ESP8266
    select CPU_MODEL_ESP8266EX

source "$(RIOTBOARD)/common/esp8266/Kconfig"
```

## boards/f4vi1/Kconfig
```kconfig
# Copyright (c) 2020 Inria
#
# This file is subject to the terms and conditions of the GNU Lesser
# General Public License v2.1. See the file LICENSE in the top level
# directory for more details.
#

config BOARD
    default "f4vi1" if BOARD_F4VI1

config BOARD_F4VI1
    bool
    default y
    select CPU_MODEL_STM32F415RG

    # Clock configuration
    select BOARD_HAS_HSE
    select BOARD_HAS_LSE

config CLOCK_HSE
    default 16000000

config CLOCK_PLL_M
    default 16

config CLOCK_PLL_N
    default 336 if USEMODULE_PERIPH_USBDEV
    default 360

source "$(RIOTBOARD)/common/stm32/Kconfig"
```

## boards/feather-m0-lora/Kconfig
```kconfig
# SPDX-FileCopyrightText: 2020 HAW Hamburg
# SPDX-License-Identifier: LGPL-2.1-only

config BOARD
    default "feather-m0-lora" if BOARD_FEATHER_M0_LORA

config BOARD_FEATHER_M0_LORA
    bool
    default y
    select BOARD_FEATHER_M0_BASE

source "$(RIOTBOARD)/feather-m0/Kconfig.feather-m0-base"
```

## boards/feather-m0-wifi/Kconfig
```kconfig
# SPDX-FileCopyrightText: 2020 HAW Hamburg
# SPDX-License-Identifier: LGPL-2.1-only

config BOARD
    default "feather-m0-wifi" if BOARD_FEATHER_M0_WIFI

config BOARD_FEATHER_M0_WIFI
    bool
    default y
    select BOARD_FEATHER_M0_BASE

source "$(RIOTBOARD)/feather-m0/Kconfig.feather-m0-base"
```

## boards/feather-m0/Kconfig
```kconfig
# SPDX-FileCopyrightText: 2020 HAW Hamburg
# SPDX-License-Identifier: LGPL-2.1-only

config BOARD
    default "feather-m0" if BOARD_FEATHER_M0

config BOARD_FEATHER_M0
    bool
    default y
    select BOARD_FEATHER_M0_BASE

rsource "Kconfig.feather-m0-base"
```

## boards/feather-nrf52840-sense/Kconfig
```kconfig
# Copyright (c) 2023 HAW Hamburg
#
# This file is subject to the terms and conditions of the GNU Lesser
# General Public License v2.1. See the file LICENSE in the top level
# directory for more details.

config BOARD
    default "feather-nrf52840-sense" if BOARD_FEATHER_NRF52840_SENSE

config BOARD_FEATHER_NRF52840_SENSE
    bool
    default y
    select BOARD_COMMON_NRF52
    select CPU_MODEL_NRF52840XXAA

source "$(RIOTBOARD)/common/nrf52/Kconfig"
```

## boards/feather-nrf52840/Kconfig
```kconfig
# Copyright (c) 2020 HAW Hamburg
#
# This file is subject to the terms and conditions of the GNU Lesser
# General Public License v2.1. See the file LICENSE in the top level
# directory for more details.

config BOARD
    default "feather-nrf52840" if BOARD_FEATHER_NRF52840

config BOARD_FEATHER_NRF52840
    bool
    default y
    select BOARD_COMMON_NRF52
    select CPU_MODEL_NRF52840XXAA

source "$(RIOTBOARD)/common/nrf52/Kconfig"
```

## boards/firefly/Kconfig
```kconfig
# Copyright (c) 2020 HAW Hamburg
#
# This file is subject to the terms and conditions of the GNU Lesser
# General Public License v2.1. See the file LICENSE in the top level
# directory for more details.

config BOARD
    default "firefly" if BOARD_FIREFLY

config BOARD_FIREFLY
    bool
    default y
    select BOARD_COMMON_REMOTE

source "$(RIOTBOARD)/common/remote/Kconfig"
```

## boards/fox/Kconfig
```kconfig
# Copyright (c) 2020 Inria
#
# This file is subject to the terms and conditions of the GNU Lesser
# General Public License v2.1. See the file LICENSE in the top level
# directory for more details.
#

config BOARD
    default "fox" if BOARD_FOX

config BOARD_FOX
    bool
    default y
    select CPU_MODEL_STM32F103RE

    # Put defined MCU peripherals here (in alphabetical order)
    select HAS_PERIPH_I2C
    select HAS_PERIPH_RTC
    select HAS_PERIPH_RTT
    select HAS_PERIPH_SPI
    select HAS_PERIPH_TIMER
    select HAS_PERIPH_UART
```

## boards/frdm-k22f/Kconfig
```kconfig
# Copyright (c) 2020 HAW Hamburg
#
# This file is subject to the terms and conditions of the GNU Lesser
# General Public License v2.1. See the file LICENSE in the top level
# directory for more details.

config BOARD
    default "frdm-k22f" if BOARD_FRDM_K22F

config BOARD_FRDM_K22F
    bool
    default y
    select CPU_MODEL_MK22FN512VLH12
```

## boards/frdm-k64f/Kconfig
```kconfig
# SPDX-FileCopyrightText: 2020 HAW Hamburg
# SPDX-License-Identifier: LGPL-2.1-only

config BOARD
    default "frdm-k64f" if BOARD_FRDM_K64F

config BOARD_FRDM_K64F
    bool
    default y
    select CPU_MODEL_MK64FN1M0VLL12
```

## boards/frdm-kl43z/Kconfig
```kconfig
# SPDX-FileCopyrightText: 2020 Benjamin Valentin
# SPDX-License-Identifier: LGPL-2.1-only

config BOARD
    default "frdm-kl43z" if BOARD_FRDM_KL43Z

config BOARD_FRDM_KL43Z
    bool
    default y
    select CPU_MODEL_MKL43Z256VLH4
```

## boards/frdm-kw41z/Kconfig
```kconfig
# Copyright (c) 2020 HAW Hamburg
#
# This file is subject to the terms and conditions of the GNU Lesser
# General Public License v2.1. See the file LICENSE in the top level
# directory for more details.

config BOARD
    default "frdm-kw41z" if BOARD_FRDM_KW41Z

config BOARD_FRDM_KW41Z
    bool
    default y
    select BOARD_COMMON_KW41Z

source "$(RIOTBOARD)/common/kw41z/Kconfig"
```

## boards/gba_cartridge/Kconfig
```kconfig
# SPDX-FileCopyrightText: 2023 HAW Hamburg
# SPDX-License-Identifier: LGPL-2.1-only

config BOARD
    default "gba" if BOARD_GBA

config BOARD_GBA
    bool
    default y
    select CPU_MODEL_ARM7TDMI_GBA
```

## boards/gd32e230c-eval/Kconfig
```kconfig
# Copyright (c) 2023 BISSELL Homecare, Inc.
#
# This file is subject to the terms and conditions of the GNU Lesser
# General Public License v2.1. See the file LICENSE in the top level
# directory for more details.

config BOARD
    default "gd32e230c-eval" if BOARD_GD32E230C_EVAL

config BOARD_GD32E230C_EVAL
    bool
    default y
    select CPU_MODEL_GD32E230C

    select HAS_PERIPH_ADC
    select HAS_PERIPH_I2C
    select HAS_PERIPH_PWM
    #select HAS_PERIPH_RTC
    select HAS_PERIPH_SPI
    select HAS_PERIPH_TIMER
    select HAS_PERIPH_UART
    select HAVE_SAUL_GPIO

#config FORCE_USB_STDIO
    #default y
```

## boards/gd32vf103v-eval/Kconfig
```kconfig
# Copyright (c) 2023 BISSELL Homecare, Inc.
#
# This file is subject to the terms and conditions of the GNU Lesser
# General Public License v2.1. See the file LICENSE in the top level
# directory for more details.

config BOARD
    default "gd32vf103v-eval" if BOARD_GD32VF103V_EVAL

config BOARD_GD32VF103V_EVAL
    bool
    default y
    select CPU_MODEL_GD32VF103VBT6

    # Put defined MCU peripherals here (in alphabetical order)
    select HAS_PERIPH_ADC
    select HAS_PERIPH_I2C
    select HAS_PERIPH_PWM
    select HAS_PERIPH_SPI
    select HAS_PERIPH_TIMER
    select HAS_PERIPH_UART
    select HAVE_SAUL_GPIO

    # Put other features for this board (in alphabetical order)
```

## boards/generic-cc2538-cc2592-dk/Kconfig
```kconfig
# SPDX-FileCopyrightText: 2020 HAW Hamburg
# SPDX-License-Identifier: LGPL-2.1-only

config BOARD
    default "generic-cc2538-cc2592-dk" if BOARD_GENERIC_CC2538_CC2592_DK

config BOARD_GENERIC_CC2538_CC2592_DK
    bool
    default y
    select CPU_MODEL_CC2538SF53
```

## boards/hamilton/Kconfig
```kconfig
# SPDX-FileCopyrightText: 2020 HAW Hamburg
# SPDX-License-Identifier: LGPL-2.1-only

config BOARD
    default "hamilton" if BOARD_HAMILTON

config BOARD_HAMILTON
    bool
    default y
    select CPU_MODEL_SAMR21E18A
```
