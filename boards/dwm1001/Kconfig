## boards/dwm1001/Kconfig
```kconfig
# SPDX-FileCopyrightText: 2020 HAW Hamburg
# SPDX-License-Identifier: LGPL-2.1-only

config BOARD
    default "dwm1001" if BOARD_DWM1001

config BOARD_DWM1001
    bool
    default y
    select BOARD_COMMON_NRF52
    select CPU_MODEL_NRF52832XXAA

source "$(RIOTBOARD)/common/nrf52/Kconfig"
```

## boards/e104-bt5010a-tb/Kconfig
```kconfig
# SPDX-FileCopyrightText: 2020 Benjamin Valentin
# SPDX-License-Identifier: LGPL-2.1-only

config BOARD
    default "e104-bt5010a-tb" if BOARD_E104_BT5010A_TB

config BOARD_E104_BT5010A_TB
    bool
    default y
    select BOARD_COMMON_E104_BT50XXA_TB
    select CPU_MODEL_NRF52810XXAA

source "$(RIOTBOARD)/common/e104-bt50xxa-tb/Kconfig"
```

## boards/e104-bt5011a-tb/Kconfig
```kconfig
# SPDX-FileCopyrightText: 2020 Benjamin Valentin
# SPDX-License-Identifier: LGPL-2.1-only

config BOARD
    default "e104-bt5011a-tb" if BOARD_E104_BT5011A_TB

config BOARD_E104_BT5011A_TB
    bool
    default y
    select BOARD_COMMON_E104_BT50XXA_TB
    select CPU_MODEL_NRF52811XXAA

source "$(RIOTBOARD)/common/e104-bt50xxa-tb/Kconfig"
```

## boards/e180-zg120b-tb/Kconfig
```kconfig
# SPDX-FileCopyrightText: 2020 HAW Hamburg
# SPDX-License-Identifier: LGPL-2.1-only

config BOARD
    default "e180-zg120b-tb" if BOARD_E180_ZG120B_TB

config BOARD_E180_ZG120B_TB
    bool
    default y
    select CPU_MODEL_EFR32MG1B232F256GM32

source "$(RIOTBOARD)/common/silabs/Kconfig"
```

## boards/ek-lm4f120xl/Kconfig
```kconfig
# SPDX-FileCopyrightText: 2020 HAW Hamburg
# SPDX-License-Identifier: LGPL-2.1-only

config BOARD
    default "ek-lm4f120xl" if BOARD_EK_LM4F120XL

config BOARD_EK_LM4F120XL
    bool
    default y
    select CPU_MODEL_LM4F120H5QR
```

## boards/elecrow-crowpanel-esp32s3-rotary-128/Kconfig
```kconfig
# SPDX-FileCopyrightText: 2026 Technische Universität Hamburg
# SPDX-License-Identifier: LGPL-2.1-only

config BOARD
    default "boards_elecrow-crowpanel-esp32s3-rotary-128" if BOARD_ELECROW_CROWPANEL_ESP32S3_ROTARY_128

config BOARD_ELECROW_CROWPANEL_ESP32S3_ROTARY_128
    bool
    default y
    select BOARD_COMMON_ESP32S3
    select CPU_MODEL_ESP32S3R8

source "$(RIOTBOARD)/common/esp32s3/Kconfig"
```

## boards/esp32-ethernet-kit-v1_0/Kconfig.esp32-ethernet-kit
```kconfig
config BOARD_ESP32_ETHERNET_KIT
    bool
    default y
    select BOARD_COMMON_ESP32
    select CPU_MODEL_ESP32_WROVER_B
    select HAS_ESP_JTAG
    select HAS_ESP_ETH
    select HAS_PERIPH_ADC
    select HAS_PERIPH_ETH
    select HAS_PERIPH_I2C
    select HAS_PERIPH_PWM
    select HAS_PERIPH_SPI if !MODULE_ESP_JTAG

source "$(RIOTBOARD)/common/esp32/Kconfig"
```

## boards/esp32-ethernet-kit-v1_1/Kconfig
```kconfig
# SPDX-FileCopyrightText: 2020 HAW Hamburg
# SPDX-FileCopyrightText: 2020 Google LLC
# SPDX-License-Identifier: LGPL-2.1-only

config BOARD
    default "esp32-ethernet-kit-v1_1" if BOARD_ESP32_ETHERNET_KIT_V1_1

config BOARD_ESP32_ETHERNET_KIT_V1_1
    bool
    default y
    select BOARD_COMMON_ESP32
    select CPU_MODEL_ESP32_WROVER_B

source "$(RIOTBOARD)/common/esp32/Kconfig"
```

## boards/esp32-ethernet-kit-v1_2/Kconfig
```kconfig
# SPDX-FileCopyrightText: 2020 HAW Hamburg
# SPDX-FileCopyrightText: 2020 Google LLC
# SPDX-License-Identifier: LGPL-2.1-only

config BOARD
    default "esp32-ethernet-kit-v1_2" if BOARD_ESP32_ETHERNET_KIT_V1_2

config BOARD_ESP32_ETHERNET_KIT_V1_2
    bool
    default y
    select BOARD_COMMON_ESP32
    select CPU_MODEL_ESP32_WROVER_E

source "$(RIOTBOARD)/common/esp32/Kconfig"
```

## boards/esp32-heltec-lora32-v2/Kconfig
```kconfig
# SPDX-FileCopyrightText: 2020 HAW Hamburg
# SPDX-License-Identifier: LGPL-2.1-only

config BOARD
    default "esp32-heltec-lora32-v2" if BOARD_ESP32_HELTEC_LORA32_V2

config BOARD_ESP32_HELTEC_LORA32_V2
    bool
    default y
    select BOARD_COMMON_ESP32
    select CPU_MODEL_ESP32_D0WD

source "$(RIOTBOARD)/common/esp32/Kconfig"
```

## boards/esp32-mh-et-live-minikit/Kconfig
```kconfig
# Copyright (c) 2020 HAW Hamburg
#
# This file is subject to the terms and conditions of the GNU Lesser
# General Public License v2.1. See the file LICENSE in the top level
# directory for more details.

config BOARD
    default "esp32-mh-et-live-minikit" if BOARD_ESP32_MH_ET_LIVE_MINIKIT

config BOARD_ESP32_MH_ET_LIVE_MINIKIT
    bool
    default y
    select BOARD_COMMON_ESP32
    select CPU_MODEL_ESP32_WROOM_32

source "$(RIOTBOARD)/common/esp32/Kconfig"
```

## boards/esp32-olimex-evb/Kconfig
```kconfig
# SPDX-FileCopyrightText: 2020 HAW Hamburg
# SPDX-License-Identifier: LGPL-2.1-only

config BOARD
    default "esp32-olimex-evb" if BOARD_ESP32_OLIMEX_EVB

config BOARD_ESP32_OLIMEX_EVB
    bool
    default y
    select BOARD_COMMON_ESP32
    select CPU_MODEL_ESP32_WROOM_32

source "$(RIOTBOARD)/common/esp32/Kconfig"
```

## boards/esp32-ttgo-t-beam/Kconfig
```kconfig
# Copyright (c) 2020 HAW Hamburg
#
# This file is subject to the terms and conditions of the GNU Lesser
# General Public License v2.1. See the file LICENSE in the top level
# directory for more details.

config BOARD
    default "esp32-ttgo-t-beam" if BOARD_ESP32_TTGO_T_BEAM

config BOARD_ESP32_TTGO_T_BEAM
    bool
    default y
    select BOARD_COMMON_ESP32
    select CPU_MODEL_ESP32_D0WD

source "$(RIOTBOARD)/common/esp32/Kconfig"
```

## boards/esp32-wemos-d1-r32/Kconfig
```kconfig
# SPDX-FileCopyrightText: 2025 Gunar Schorcht
# SPDX-License-Identifier: LGPL-2.1-only

config BOARD
    default "esp32-wemos-d1-r2" if BOARD_ESP32_WEMOS_D1_R32

config BOARD_ESP32_WEMOS_D1_R32
    bool
    default y
    select BOARD_COMMON_ESP32
    select CPU_MODEL_ESP32_WROOM_32

source "$(RIOTBOARD)/common/esp32/Kconfig"
```

## boards/esp32-wemos-lolin-d32-pro/Kconfig
```kconfig
# SPDX-FileCopyrightText: 2020 HAW Hamburg
# SPDX-License-Identifier: LGPL-2.1-only

config BOARD
    default "esp32-wemos-lolin-d32-pro" if BOARD_ESP32_WEMOS_LOLIN_D32_PRO

config BOARD_ESP32_WEMOS_LOLIN_D32_PRO
    bool
    default y
    select BOARD_COMMON_ESP32
    select CPU_MODEL_ESP32_WROVER

source "$(RIOTBOARD)/common/esp32/Kconfig"
```

## boards/esp32-wroom-32/Kconfig
```kconfig
# SPDX-FileCopyrightText: 2020 HAW Hamburg
# SPDX-License-Identifier: LGPL-2.1-only

config BOARD
    default "esp32-wroom-32" if BOARD_ESP32_WROOM_32

config BOARD_ESP32_WROOM_32
    bool
    default y
    select BOARD_COMMON_ESP32
    select CPU_MODEL_ESP32_WROOM_32

source "$(RIOTBOARD)/common/esp32/Kconfig"
```

## boards/esp32-wrover-kit/Kconfig
```kconfig
# SPDX-FileCopyrightText: 2020 HAW Hamburg
# SPDX-License-Identifier: LGPL-2.1-only

config BOARD
    default "esp32-wrover-kit" if BOARD_ESP32_WROVER_KIT

config BOARD_ESP32_WROVER_KIT
    bool
    default y
    select BOARD_COMMON_ESP32
    select CPU_MODEL_ESP32_WROVER

source "$(RIOTBOARD)/common/esp32/Kconfig"
```

## boards/esp32c3-devkit/Kconfig
```kconfig
# SPDX-FileCopyrightText: 2020 HAW Hamburg
# SPDX-FileCopyrightText: 2022 Gunar Schorcht
# SPDX-License-Identifier: LGPL-2.1-only

config BOARD
    default "esp32c3-devkit" if BOARD_ESP32C3_DEVKIT

config BOARD_ESP32C3_DEVKIT
    bool
    default y
    select BOARD_COMMON_ESP32C3
    select CPU_MODEL_ESP32C3_MINI_1X

source "$(RIOTBOARD)/common/esp32c3/Kconfig"
```

## boards/esp32c3-wemos-mini/Kconfig
```kconfig
# Copyright (c) 2020 HAW Hamburg
#               2022 Gunar Schorcht
#
# This file is subject to the terms and conditions of the GNU Lesser
# General Public License v2.1. See the file LICENSE in the top level
# directory for more details.

config BOARD
    default "esp32c3-wemos-mini" if BOARD_ESP32C3_WEMOS_MINI

config BOARD_ESP32C3_WEMOS_MINI
    bool
    default y
    select BOARD_COMMON_ESP32C3
    select CPU_MODEL_ESP32C3_FH4

    choice
        bool "Wemos ESP32-C3 mini board version"
        default BOARD_VERSION_ESP32C3_WEMOS_MINI_V2_1_0
        config BOARD_VERSION_ESP32C3_WEMOS_MINI_V1_0_0
            bool "Version 1.0.0"
        config BOARD_VERSION_ESP32C3_WEMOS_MINI_V2_1_0
            bool "Version 2.1.0"
        help
            There are different versions on the market which differ in the pin
            layout for ADC channels and the SPI interface. In addition,
            version 2.1.0 has an RGB LED connected to GPIO7 instead of an LED.
            Select your version for correct peripheral configuration. If your
            board has a RGB LED, it is version 2.1.0 or newer, otherwise it is
            version 1.0.0
    endchoice

source "$(RIOTBOARD)/common/esp32c3/Kconfig"
```

## boards/esp32c6-devkit/Kconfig
```kconfig
# SPDX-FileCopyrightText: 2025 Gunar Schorcht
# SPDX-License-Identifier: LGPL-2.1-only

config BOARD
    default "esp32c6-devkit" if BOARD_ESP32C6_DEVKIT

config BOARD_ESP32C6_DEVKIT
    bool
    default y
    select BOARD_COMMON_ESP32C6
    select CPU_MODEL_ESP32C6_MINI_1X_X4

source "$(RIOTBOARD)/common/esp32c6/Kconfig"
```

## boards/esp32h2-devkit/Kconfig
```kconfig
# SPDX-FileCopyrightText: 2025 Gunar Schorcht
# SPDX-License-Identifier: LGPL-2.1-only

config BOARD
    default "esp32h2-devkit" if BOARD_ESP32H2_DEVKIT

config BOARD_ESP32H2_DEVKIT
    bool
    default y
    select BOARD_COMMON_ESP32H2
    select CPU_MODEL_ESP32H2_MINI_1X_H4S

source "$(RIOTBOARD)/common/esp32h2/Kconfig"
```

## boards/esp32s2-devkit/Kconfig
```kconfig
# SPDX-FileCopyrightText: 2020 HAW Hamburg
# SPDX-FileCopyrightText: 2022 Gunar Schorcht
# SPDX-License-Identifier: LGPL-2.1-only

config BOARD
    default "esp32s2-devkit" if BOARD_ESP32S2_DEVKIT

config BOARD_ESP32S2_DEVKIT
    bool
    default y
    select BOARD_COMMON_ESP32S2
    select CPU_MODEL_ESP32S2_MINI_1X_N4 if BOARD_VERSION_ESP32S2_DEVKITM_1
    select CPU_MODEL_ESP32S2_MINI_1X_N4 if BOARD_VERSION_ESP32S2_DEVKITM_1U
    select CPU_MODEL_ESP32S2_MINI_1X_N4R2 if BOARD_VERSION_ESP32S2_DEVKITM_1R
    select CPU_MODEL_ESP32S2_MINI_1X_N4R2 if BOARD_VERSION_ESP32S2_DEVKITM_1RU
    select CPU_MODEL_ESP32S2_SOLO_N4 if BOARD_VERSION_ESP32S2_DEVKITC_1
    select CPU_MODEL_ESP32S2_SOLO_N4 if BOARD_VERSION_ESP32S2_DEVKITC_1U
    select CPU_MODEL_ESP32S2_SOLO_N4R2 if BOARD_VERSION_ESP32S2_DEVKITC_1R
    select CPU_MODEL_ESP32S2_SOLO_N4R2 if BOARD_VERSION_ESP32S2_DEVKITC_1RU
    select CPU_MODEL_ESP32S2_WROOM if BOARD_VERSION_ESP32S2_SAOLA_1M
    select CPU_MODEL_ESP32S2_WROOM if BOARD_VERSION_ESP32S2_SAOLA_1MI
    select CPU_MODEL_ESP32S2_WROVER_N4R2 if BOARD_VERSION_ESP32S2_SAOLA_1R
    select CPU_MODEL_ESP32S2_WROVER_N4R2 if BOARD_VERSION_ESP32S2_SAOLA_1RI

    choice
        bool "ESP32-S2-DevKit board version"
        default BOARD_VERSION_ESP32S2_DEVKITC_1

        config BOARD_VERSION_ESP32S2_DEVKITM_1
            bool "ESP32-S2-DevKitM-1"
        config BOARD_VERSION_ESP32S2_DEVKITM_1U
            bool "ESP32-S2-DevKitM-1U"
        config BOARD_VERSION_ESP32S2_DEVKITM_1R
            bool "ESP32-S2-DevKitM-1R"
        config BOARD_VERSION_ESP32S2_DEVKITM_1RU
            bool "ESP32-S2-DevKitM-1RU"
        config BOARD_VERSION_ESP32S2_DEVKITC_1
            bool "ESP32-S2-DevKitC-1"
        config BOARD_VERSION_ESP32S2_DEVKITC_1U
            bool "ESP32-S2-DevKitC-1U"
        config BOARD_VERSION_ESP32S2_DEVKITC_1R
            bool "ESP32-S2-DevKitC-1R"
        config BOARD_VERSION_ESP32S2_DEVKITC_1RU
            bool "ESP32-S2-DevKitC-1RU"
        config BOARD_VERSION_ESP32S2_SAOLA_1M
            bool "ESP32-S2-SAOLA-1M"
        config BOARD_VERSION_ESP32S2_SAOLA_1MI
            bool "ESP32-S2-SAOLA-1MI"
        config BOARD_VERSION_ESP32S2_SAOLA_1R
            bool "ESP32-S2-SAOLA-1R"
        config BOARD_VERSION_ESP32S2_SAOLA_1RI
            bool "ESP32-S2-SAOLA-1RI"
    endchoice

source "$(RIOTBOARD)/common/esp32s2/Kconfig"
```

## boards/esp32s2-lilygo-ttgo-t8/Kconfig
```kconfig
# Copyright (c) 2020 HAW Hamburg
#               2022 Gunar Schorcht
#
# This file is subject to the terms and conditions of the GNU Lesser
# General Public License v2.1. See the file LICENSE in the top level
# directory for more details.

config BOARD
    default "esp32s2-lilygo-ttgo-t8" if BOARD_ESP32S2_LILYGO_TTGO_T8

config BOARD_ESP32S2_LILYGO_TTGO_T8
    bool
    default y
    select BOARD_COMMON_ESP32S2
    select CPU_MODEL_ESP32S2

menu "LILYGO TTGO T8 ESP32-S2 Board configurations"
    depends on BOARD_ESP32S2_LILYGO_TTGO_T8

    config ESP32S2_LILYGO_TTGO_T8_USB
        bool "USB interface is used instead of USB-to-UART bridge"
        help
            The USB D-/D+ signals are connected via DIP switches either to the
            USB-to-UART bridge (default) or to GPIO19/GPIO20 of the ESP32-S2.
            To use the USB interface of the ESP32-S2, the USB D-/D+ signals
            must be connected to GPIO19 and GPIO20 and this option has to be
            enabled.

    config ESP32S2_LILYGO_TTGO_T8_32K_XTAL
        bool "32.768 kHz crystal is used"
        default y
        help
            GPIO15 and GPIO16 of the ESP32-S2 are connected via DIP switches
            either with the on-board 32.768 kHz crystal (default) or the
            according pins at the extension headers. If the pins at the
            extension headers are used instead, disable this option.

endmenu

source "$(RIOTBOARD)/common/esp32s2/Kconfig"
```

## boards/esp32s2-wemos-mini/Kconfig
```kconfig
# SPDX-FileCopyrightText: 2022 Benjamin Valentin
# SPDX-License-Identifier: LGPL-2.1-only

config BOARD
    default "esp32s2-wemos-mini" if BOARD_ESP32S2_WEMOS_MINI

config BOARD_ESP32S2_WEMOS_MINI
    bool
    default y
    select BOARD_COMMON_ESP32S2
    select CPU_MODEL_ESP32S2_FN4R2

source "$(RIOTBOARD)/common/esp32s2/Kconfig"
```

## boards/esp32s3-box/Kconfig
```kconfig
# SPDX-FileCopyrightText: 2020 HAW Hamburg
# SPDX-FileCopyrightText: 2023 Gunar Schorcht
# SPDX-License-Identifier: LGPL-2.1-only

config BOARD
    default "esp32s3-box" if BOARD_ESP32S3_BOX

config BOARD_ESP32S3_BOX
    bool
    default y
    select BOARD_COMMON_ESP32S3
    select CPU_MODEL_ESP32S3_WROOM_1X_N16R8

source "$(RIOTBOARD)/common/esp32s3/Kconfig"
```
