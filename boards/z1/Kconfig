## cpu/atxmega/Kconfig.XMEGAD
```kconfig
## CPU Models
# XMEGA - D3
config CPU_MODEL_XMEGA32D3
    bool
    select CPU_CORE_ATXMEGA_D3

config CPU_MODEL_XMEGA64D3
    bool
    select CPU_CORE_ATXMEGA_D3

config CPU_MODEL_XMEGC128D3
    bool
    select CPU_CORE_ATXMEGA_D3

config CPU_MODEL_XMEGC192D3
    bool
    select CPU_CORE_ATXMEGA_D3

config CPU_MODEL_XMEGA256D3
    bool
    select CPU_CORE_ATXMEGA_D3

config CPU_MODEL_XMEGA384D3
    bool
    select CPU_CORE_ATXMEGA_D3

# XMEGA - D4
config CPU_MODEL_XMEGA16D4
    bool
    select CPU_CORE_ATXMEGA_D4

config CPU_MODEL_XMEGA32D4
    bool
    select CPU_CORE_ATXMEGA_D4

config CPU_MODEL_XMEGA64D4
    bool
    select CPU_CORE_ATXMEGA_D4

config CPU_MODEL_XMEGA128D4
    bool
    select CPU_CORE_ATXMEGA_D4

config CPU_MODEL
    default "atxmega32d3"    if CPU_MODEL_XMEGA32D3
    default "atxmega64d3"    if CPU_MODEL_XMEGA64D3
    default "atxmega128d3"   if CPU_MODEL_XMEGC128D3
    default "atxmega192d3"   if CPU_MODEL_XMEGC192D3
    default "atxmega256d3"   if CPU_MODEL_XMEGA256D3
    default "atxmega384d3"   if CPU_MODEL_XMEGA384D3

    default "atxmega16d4"    if CPU_MODEL_XMEGA16D4
    default "atxmega32d4"    if CPU_MODEL_XMEGA32D4
    default "atxmega64d4"    if CPU_MODEL_XMEGA64D4
    default "atxmega128d4"   if CPU_MODEL_XMEGA128D4
```

## cpu/atxmega/Kconfig.XMEGAE
```kconfig
## CPU Models
config CPU_MODEL_XMEGA8E5
    bool
    select CPU_CORE_ATXMEGA_E5

config CPU_MODEL_XMEGA16E5
    bool
    select CPU_CORE_ATXMEGA_E5

config CPU_MODEL_XMEGA32E5
    bool
    select CPU_CORE_ATXMEGA_E5

config CPU_MODEL
    default "atxmega8e5"     if CPU_MODEL_XMEGA8E5
    default "atxmega16e5"    if CPU_MODEL_XMEGA16E5
    default "atxmega32e5"    if CPU_MODEL_XMEGA32E5
```

## cpu/atxmega/ebi/Kconfig
```kconfig
# Copyright (c) 2021 HAW Hamburg
#
# This file is subject to the terms and conditions of the GNU Lesser
# General Public License v2.1. See the file LICENSE in the top level
# directory for more details.
#

config MODULE_ATXMEGA_EBI
    bool
    depends on TEST_KCONFIG
    depends on CPU_COMMON_ATXMEGA
    depends on HAS_ATXMEGA_EBI
    default y if CPU_CORE_ATXMEGA_A1
    help
        Low-level EBI (External BUS Interface) driver.

config HAS_ATXMEGA_EBI
    bool
    help
        Indicates that the External Bus Interface is present.
```

## cpu/atxmega/periph/Kconfig
```kconfig
# Copyright (c) 2021 HAW Hamburg
#
# This file is subject to the terms and conditions of the GNU Lesser
# General Public License v2.1. See the file LICENSE in the top level
# directory for more details.
#

config MODULE_ATXMEGA_PERIPH
    bool
    depends on TEST_KCONFIG
    depends on CPU_COMMON_ATXMEGA
    default y
    help
        Common ATXmega peripheral drivers.

config MODULE_PERIPH_NVM
    bool
    depends on MODULE_ATXMEGA_PERIPH
    depends on HAS_PERIPH_NVM
    default y if MODULE_PERIPH_CPUID
    help
        Internal ATXmega Non Volatile Memory (NVM) driver.
```
