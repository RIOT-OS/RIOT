## boards/z1/Kconfig
```kconfig
# SPDX-FileCopyrightText: 2020 HAW Hamburg
# SPDX-License-Identifier: LGPL-2.1-only

config BOARD
    default "z1" if BOARD_Z1

config BOARD_Z1
    bool
    default y
    select CPU_MODEL_MSP430F2617
```

## boards/zigduino/Kconfig
```kconfig
# Copyright (c) 2021 Benjamin Valentin
#
# This file is subject to the terms and conditions of the GNU Lesser
# General Public License v2.1. See the file LICENSE in the top level
# directory for more details.


config BOARD
    default "zigduino" if BOARD_ZIGDUINO

config BOARD_ZIGDUINO
    bool
    default y
    select CPU_MODEL_ATMEGA128RFA1
```

## core/Kconfig
```kconfig
# Copyright (c) 2020 HAW Hamburg
#
# This file is subject to the terms and conditions of the GNU Lesser
# General Public License v2.1. See the file LICENSE in the top level
# directory for more details.
#

menu "RIOT Core"

config THREAD_NAMES
    bool "Store thread name strings"
    help
        By default, thread names are not stored if DEVELHELP is not used.
        Use this parameter to store them for non-devel builds.

endmenu # RIOT Core
```

## cpu/Kconfig
```kconfig
# SPDX-FileCopyrightText: 2020 HAW Hamburg
# SPDX-License-Identifier: LGPL-2.1-only

#   +-----------+
#   | CPU_MODEL |
#   +-----------+
#        || selects
#        \/
#  +------------+
#  |  CPU_FAM   |
#  +------------+
#        || selects
#        \/
#  +------------+
#  |  CPU_CORE  |
#  +------------+
#        || selects
#        \/
#   +----------+
#   | CPU_ARCH |
#   +----------+

config CPU
    string
    help
        Name of the currently selected CPU. This reflects the Makefile variable
        used by the build system as entry point in the cpu folder.

config CPU_MODEL
    string
    help
        Model of the currently selected CPU.

config CPU_FAM
    string
    help
        Family of the currently selected CPU. It is an identifier that
        represents a sub-group of a Manufacturers CPU's. All CPU models
        belonging to the same family, usually share the same core and have
        similar register mapping.

config CPU_CORE
    string
    help
        Core of the currently selected CPU.

config CPU_ARCH
    string
    help
        Architecture of the currently selected CPU.
```

## cpu/Kconfig.features
```kconfig
# Copyright (c) 2020 HAW Hamburg
#
# This file is subject to the terms and conditions of the GNU Lesser
# General Public License v2.1. See the file LICENSE in the top level
# directory for more details.
#

config HAS_ARCH_32BIT
    bool
    help
        Indicates that the current architecture is a 32-bit one.

config HAS_CPP
    bool
    help
        Indicates that C++ is supported.

config HAS_CPU_CHECK_ADDRESS
    bool
    help
        Indicates that it is possible to check if an address is valid.

config HAS_PERIPH_PM
    bool
    help
        Indicates that a Power Management driver is present.

config HAS_SSP
    bool
    help
        Indicates that Stack Smashing protection is present.
```

## cpu/arm7_common/Kconfig
```kconfig
# SPDX-FileCopyrightText: 2020 HAW Hamburg
# SPDX-License-Identifier: LGPL-2.1-only

config CPU_ARCH_ARMV4T
    bool

config CPU_CORE_ARM7TDMI_S
    bool
    select CPU_ARCH_ARMV4T

## Common CPU symbols
config CPU_ARCH
    default "armv4t" if CPU_ARCH_ARMV4T

config CPU_CORE
    default "arm7tdmi_s" if CPU_CORE_ARM7TDMI_S
```

## cpu/arm7_common/periph/Kconfig
```kconfig
# Copyright (c) 2021 HAW Hamburg
#
# This file is subject to the terms and conditions of the GNU Lesser
# General Public License v2.1. See the file LICENSE in the top level
# directory for more details.
#

config MODULE_ARM7_COMMON_PERIPH
    bool
    depends on TEST_KCONFIG
    depends on HAS_ARCH_ARM7
    default y
    help
      Common arm7 peripheral code.
```

## cpu/atmega1281/Kconfig
```kconfig
# SPDX-FileCopyrightText: 2020 HAW Hamburg
# SPDX-License-Identifier: LGPL-2.1-only

## CPU Models
config CPU_MODEL_ATMEGA1281
    bool
    select CPU_FAM_ATMEGA128

## Common CPU symbols
config CPU_MODEL
    default "atmega1281" if CPU_MODEL_ATMEGA1281

config CPU
    default "atmega1281" if CPU_MODEL_ATMEGA1281

source "$(RIOTCPU)/atmega_common/Kconfig"
```

## cpu/atmega1284p/Kconfig
```kconfig
# SPDX-FileCopyrightText: 2020 HAW Hamburg
# SPDX-License-Identifier: LGPL-2.1-only

## CPU Models
config CPU_MODEL_ATMEGA1284P
    bool
    select CPU_FAM_ATMEGA128

## Common CPU symbols
config CPU_MODEL
    default "atmega1284p" if CPU_MODEL_ATMEGA1284P

config CPU
    default "atmega1284p" if CPU_MODEL_ATMEGA1284P

source "$(RIOTCPU)/atmega_common/Kconfig"
```

## cpu/atmega128rfa1/Kconfig
```kconfig
# Copyright (c) 2020 HAW Hamburg
#
# This file is subject to the terms and conditions of the GNU Lesser
# General Public License v2.1. See the file LICENSE in the top level
# directory for more details.
#

## CPU Models
config CPU_MODEL_ATMEGA128RFA1
    bool
    select CPU_FAM_ATMEGA128

## Common CPU symbols
config CPU_MODEL
    default "atmega128rfa1" if CPU_MODEL_ATMEGA128RFA1

config CPU
    default "atmega128rfa1" if CPU_MODEL_ATMEGA128RFA1

source "$(RIOTCPU)/atmega_common/Kconfig"
```

## cpu/atmega2560/Kconfig
```kconfig
# SPDX-FileCopyrightText: 2020 HAW Hamburg
# SPDX-License-Identifier: LGPL-2.1-only

config CPU_FAM_ATMEGA256
    bool
    select CPU_COMMON_ATMEGA

## CPU Models
config CPU_MODEL_ATMEGA2560
    bool
    select CPU_FAM_ATMEGA256

## Common CPU symbols
config CPU_FAM
    default "atmega256" if CPU_FAM_ATMEGA256

config CPU_MODEL
    default "atmega2560" if CPU_MODEL_ATMEGA2560

config CPU
    default "atmega2560" if CPU_FAM_ATMEGA256

source "$(RIOTCPU)/atmega_common/Kconfig"
```

## cpu/atmega256rfr2/Kconfig
```kconfig
# SPDX-FileCopyrightText: 2020 HAW Hamburg
# SPDX-License-Identifier: LGPL-2.1-only

config CPU_FAM_ATMEGA256RF
    bool
    select CPU_COMMON_ATMEGA

## CPU Models
config CPU_MODEL_ATMEGA256RFR2
    bool
    select CPU_FAM_ATMEGA256RF

## Common CPU symbols
config CPU_FAM
    default "atmega256rf" if CPU_FAM_ATMEGA256RF

config CPU_MODEL
    default "atmega256rfr2" if CPU_MODEL_ATMEGA256RFR2

config CPU
    default "atmega256rfr2" if CPU_MODEL_ATMEGA256RFR2

source "$(RIOTCPU)/atmega_common/Kconfig"
```

## cpu/atmega328p/Kconfig
```kconfig
# SPDX-FileCopyrightText: 2020 HAW Hamburg
# SPDX-License-Identifier: LGPL-2.1-only

config CPU_FAM_ATMEGA328
    bool
    select CPU_COMMON_ATMEGA

## CPU Models
config CPU_MODEL_ATMEGA328P
    bool
    select CPU_FAM_ATMEGA328

## Common CPU symbols
config CPU_FAM
    default "atmega328" if CPU_FAM_ATMEGA328

config CPU_MODEL
    default "atmega328p" if CPU_MODEL_ATMEGA328P

config CPU
    default "atmega328p" if CPU_FAM_ATMEGA328

source "$(RIOTCPU)/atmega_common/Kconfig"
```

## cpu/atmega32u4/Kconfig
```kconfig
# SPDX-FileCopyrightText: 2020 HAW Hamburg
# SPDX-License-Identifier: LGPL-2.1-only

config CPU_FAM_ATMEGA32
    bool
    select CPU_COMMON_ATMEGA

## CPU Models
config CPU_MODEL_ATMEGA32U4
    bool
    select CPU_FAM_ATMEGA32

## Common CPU symbols
config CPU_FAM
    default "atmega32" if CPU_FAM_ATMEGA32

config CPU_MODEL
    default "atmega32u4" if CPU_MODEL_ATMEGA32U4

config CPU
    default "atmega32u4" if CPU_MODEL_ATMEGA32U4

source "$(RIOTCPU)/atmega_common/Kconfig"
```

## cpu/atmega8/Kconfig
```kconfig
# Copyright (c) 2020 HAW Hamburg
#
# This file is subject to the terms and conditions of the GNU Lesser
# General Public License v2.1. See the file LICENSE in the top level
# directory for more details.
#

config CPU_FAM_ATMEGA8
    bool
    select CPU_COMMON_ATMEGA

## CPU Models
config CPU_MODEL_ATMEGA8
    bool
    select CPU_FAM_ATMEGA8

## Common CPU symbols
config CPU_FAM
    default "atmega8" if CPU_FAM_ATMEGA8

config CPU_MODEL
    default "atmega8" if CPU_MODEL_ATMEGA8

config CPU
    default "atmega8" if CPU_FAM_ATMEGA8

source "$(RIOTCPU)/atmega_common/Kconfig"
```

## cpu/atmega_common/Kconfig
```kconfig
# SPDX-FileCopyrightText: 2020 HAW Hamburg
# SPDX-License-Identifier: LGPL-2.1-only

config CPU_COMMON_ATMEGA
    bool

# Define ATMega128 family here as it is used by different CPUs
config CPU_FAM_ATMEGA128
    bool
    select CPU_COMMON_ATMEGA
    select CPU_CORE_AVR

## Common CPU symbols
config CPU_FAM
    default "atmega128" if CPU_FAM_ATMEGA128

source "$(RIOTCPU)/avr8_common/Kconfig"
```

## cpu/atmega_common/periph/Kconfig
```kconfig
# Copyright (c) 2021 HAW Hamburg
#
# This file is subject to the terms and conditions of the GNU Lesser
# General Public License v2.1. See the file LICENSE in the top level
# directory for more details.
#

if TEST_KCONFIG && CPU_COMMON_ATMEGA

config MODULE_ATMEGA_COMMON_PERIPH
    bool
    default y
    help
        Common ATmega peripheral drivers.

config MODULE_ATMEGA_PCINT
    bool
    depends on HAS_ATMEGA_PCINT0 || HAS_ATMEGA_PCINT1 || HAS_ATMEGA_PCINT2 || HAS_ATMEGA_PCINT3
    help
      Say y to enable all the present Pin Change Interrupt banks.

config MODULE_ATMEGA_PCINT0
    bool
    depends on HAS_ATMEGA_PCINT0
    default MODULE_ATMEGA_PCINT
    help
        Say y to enable PIC bank 0.

config MODULE_ATMEGA_PCINT1
    bool
    depends on HAS_ATMEGA_PCINT1
    default MODULE_ATMEGA_PCINT
    help
        Say y to enable PIC bank 1.

config MODULE_ATMEGA_PCINT2
    bool
    depends on HAS_ATMEGA_PCINT2
    default MODULE_ATMEGA_PCINT
    help
        Say y to enable PIC bank 2.

config MODULE_ATMEGA_PCINT3
    bool
    depends on HAS_ATMEGA_PCINT3
    default MODULE_ATMEGA_PCINT
    help
        Say y to enable PIC bank 3.

endif # TEST_KCONFIG && CPU_COMMON_ATMEGA

## Declaration of specific features
config HAS_ATMEGA_PCINT0
    bool
    help
        Indicates that the Pin Change Interrupt bank 0 is present.

config HAS_ATMEGA_PCINT1
    bool
    help
        Indicates that the Pin Change Interrupt bank 1 is present.

config HAS_ATMEGA_PCINT2
    bool
    help
        Indicates that the Pin Change Interrupt bank 2 is present.

config HAS_ATMEGA_PCINT3
    bool
    help
        Indicates that the Pin Change Interrupt bank 3 is present.
```

## cpu/atxmega/Kconfig
```kconfig
# Copyright (c) 2020 HAW Hamburg
# Copyright (c) 2021 Gerson Fernando Budke
#
# This file is subject to the terms and conditions of the GNU Lesser
# General Public License v2.1. See the file LICENSE in the top level
# directory for more details.
#

config CPU_COMMON_ATXMEGA
    bool

config CPU_CORE_ATXMEGA_A1
    bool
    select CPU_COMMON_ATXMEGA

config CPU_CORE_ATXMEGA_A3
    bool
    select CPU_COMMON_ATXMEGA

config CPU_CORE_ATXMEGA_A4
    bool
    select CPU_COMMON_ATXMEGA

config CPU_CORE_ATXMEGA_B1
    bool
    select CPU_COMMON_ATXMEGA

config CPU_CORE_ATXMEGA_B3
    bool
    select CPU_COMMON_ATXMEGA

config CPU_CORE_ATXMEGA_C3
    bool
    select CPU_COMMON_ATXMEGA

config CPU_CORE_ATXMEGA_C4
    bool
    select CPU_COMMON_ATXMEGA

config CPU_CORE_ATXMEGA_D3
    bool
    select CPU_COMMON_ATXMEGA

config CPU_CORE_ATXMEGA_D4
    bool
    select CPU_COMMON_ATXMEGA

config CPU_CORE_ATXMEGA_E5
    bool
    select CPU_COMMON_ATXMEGA

config CPU
    default "atxmega" if CPU_COMMON_ATXMEGA

source "$(RIOTCPU)/atxmega/Kconfig.XMEGAA"
source "$(RIOTCPU)/atxmega/Kconfig.XMEGAB"
source "$(RIOTCPU)/atxmega/Kconfig.XMEGAC"
source "$(RIOTCPU)/atxmega/Kconfig.XMEGAD"
source "$(RIOTCPU)/atxmega/Kconfig.XMEGAE"

source "$(RIOTCPU)/avr8_common/Kconfig"
```

## cpu/atxmega/Kconfig.XMEGAA
```kconfig
## CPU Models
# XMEGA - A1/A1U
config CPU_MODEL_XMEGA64A1
    bool
    select CPU_CORE_ATXMEGA_A1

config CPU_MODEL_XMEGA128A1
    bool
    select CPU_CORE_ATXMEGA_A1

config CPU_MODEL_XMEGA64A1U
    bool
    select CPU_CORE_ATXMEGA_A1

config CPU_MODEL_XMEGA128A1U
    bool
    select CPU_CORE_ATXMEGA_A1

# XMEGA - A3/A3U/A3BU
config CPU_MODEL_XMEGA64A3
    bool
    select CPU_CORE_ATXMEGA_A3

config CPU_MODEL_XMEGA128A3
    bool
    select CPU_CORE_ATXMEGA_A3

config CPU_MODEL_XMEGA192A3
    bool
    select CPU_CORE_ATXMEGA_A3

config CPU_MODEL_XMEGA256A3
    bool
    select CPU_CORE_ATXMEGA_A3

config CPU_MODEL_XMEGA64A3U
    bool
    select CPU_CORE_ATXMEGA_A3

config CPU_MODEL_XMEGA128A3U
    bool
    select CPU_CORE_ATXMEGA_A3

config CPU_MODEL_XMEGA192A3U
    bool
    select CPU_CORE_ATXMEGA_A3

config CPU_MODEL_XMEGA256A3U
    bool
    select CPU_CORE_ATXMEGA_A3

config CPU_MODEL_XMEGA256A3BU
    bool
    select CPU_CORE_ATXMEGA_A3

# XMEGA - A4/A4U
config CPU_MODEL_XMEGA16A4
    bool
    select CPU_CORE_ATXMEGA_A4

config CPU_MODEL_XMEGA32A4
    bool
    select CPU_CORE_ATXMEGA_A4

config CPU_MODEL_XMEGA16A4U
    bool
    select CPU_CORE_ATXMEGA_A4

config CPU_MODEL_XMEGA32A4U
    bool
    select CPU_CORE_ATXMEGA_A4

config CPU_MODEL_XMEGA64A4U
    bool
    select CPU_CORE_ATXMEGA_A4

config CPU_MODEL_XMEGA128A4U
    bool
    select CPU_CORE_ATXMEGA_A4

config CPU_MODEL
    string
    default "atxmega64a1"    if CPU_MODEL_XMEGA64A1
    default "atxmega128a1"   if CPU_MODEL_XMEGA128A1
    default "atxmega192a1"   if CPU_MODEL_XMEGA192A1
    default "atxmega256a1"   if CPU_MODEL_XMEGA256A1
    default "atxmega64a1u"   if CPU_MODEL_XMEGA64A1U
    default "atxmega128a1u"  if CPU_MODEL_XMEGA128A1U

    default "atxmega64a3"    if CPU_MODEL_XMEGA64A3
    default "atxmega128a3"   if CPU_MODEL_XMEGA128A3
    default "atxmega192a3"   if CPU_MODEL_XMEGA192A3
    default "atxmega256a3"   if CPU_MODEL_XMEGA256A3
    default "atxmega64a3u"   if CPU_MODEL_XMEGA64A3U
    default "atxmega128a3u"  if CPU_MODEL_XMEGA128A3U
    default "atxmega192a3u"  if CPU_MODEL_XMEGA192A3U
    default "atxmega256a3u"  if CPU_MODEL_XMEGA256A3U
    default "atxmega256a3bu" if CPU_MODEL_XMEGA256A3BU

    default "atxmega16a4"    if CPU_MODEL_XMEGA16A4
    default "atxmega32a4"    if CPU_MODEL_XMEGA32A4
    default "atxmega16a4u"   if CPU_MODEL_XMEGA16A4U
    default "atxmega32a4u"   if CPU_MODEL_XMEGA32A4U
    default "atxmega64a4u"   if CPU_MODEL_XMEGA64A4U
    default "atxmega128a4u"  if CPU_MODEL_XMEGA128A4U
```

## cpu/atxmega/Kconfig.XMEGAB
```kconfig
## CPU Models
# XMEGA - B1
config CPU_MODEL_XMEGA64B1
    bool
    select CPU_CORE_ATXMEGA_B1

config CPU_MODEL_XMEGA128B1
    bool
    select CPU_CORE_ATXMEGA_B1

# XMEGA - B3
config CPU_MODEL_XMEGA64B3
    bool
    select CPU_CORE_ATXMEGA_B3

config CPU_MODEL_XMEGA128B3
    bool
    select CPU_CORE_ATXMEGA_B3

config CPU_MODEL
    default "atxmega64b3"    if CPU_MODEL_XMEGA64B3
    default "atxmega128b3"   if CPU_MODEL_XMEGA128B3

    default "atxmega64b1"    if CPU_MODEL_XMEGA64B1
    default "atxmega128b1"   if CPU_MODEL_XMEGA128B1
```

## cpu/atxmega/Kconfig.XMEGAC
```kconfig
## CPU Models
# XMEGA - C3
config CPU_MODEL_XMEGA32C3
    bool
    select CPU_CORE_ATXMEGA_C3

config CPU_MODEL_XMEGA64C3
    bool
    select CPU_CORE_ATXMEGA_C3

config CPU_MODEL_XMEGC128C3
    bool
    select CPU_CORE_ATXMEGA_C3

config CPU_MODEL_XMEGC192C3
    bool
    select CPU_CORE_ATXMEGA_C3

config CPU_MODEL_XMEGA256C3
    bool
    select CPU_CORE_ATXMEGA_C3

config CPU_MODEL_XMEGA384C3
    bool
    select CPU_CORE_ATXMEGA_C3

# XMEGA - C4
config CPU_MODEL_XMEGA16C4
    bool
    select CPU_CORE_ATXMEGA_C4

config CPU_MODEL_XMEGA32C4
    bool
    select CPU_CORE_ATXMEGA_C4

config CPU_MODEL
    default "atxmega32c3"    if CPU_MODEL_XMEGA32C3
    default "atxmega64c3"    if CPU_MODEL_XMEGA64C3
    default "atxmega128c3"   if CPU_MODEL_XMEGC128C3
    default "atxmega192c3"   if CPU_MODEL_XMEGC192C3
    default "atxmega256c3"   if CPU_MODEL_XMEGA256C3
    default "atxmega384c3"   if CPU_MODEL_XMEGA384C3

    default "atxmega16c4"    if CPU_MODEL_XMEGA16C4
    default "atxmega32c4"    if CPU_MODEL_XMEGA32C4
```
