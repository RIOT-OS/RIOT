## boards/nucleo-l011k4/Kconfig
```kconfig
# SPDX-FileCopyrightText: 2020 Inria
# SPDX-License-Identifier: LGPL-2.1-only

config BOARD
    default "nucleo-l011k4" if BOARD_NUCLEO_L011K4

config BOARD_NUCLEO_L011K4
    bool
    default y
    select BOARD_COMMON_NUCLEO32
    select CPU_MODEL_STM32L011K4

source "$(RIOTBOARD)/common/nucleo32/Kconfig"
```

## boards/nucleo-l031k6/Kconfig
```kconfig
# Copyright (c) 2020 Inria
#
# This file is subject to the terms and conditions of the GNU Lesser
# General Public License v2.1. See the file LICENSE in the top level
# directory for more details.
#

config BOARD
    default "nucleo-l031k6" if BOARD_NUCLEO_L031K6

config BOARD_NUCLEO_L031K6
    bool
    default y
    select BOARD_COMMON_NUCLEO32
    select CPU_MODEL_STM32L031K6

source "$(RIOTBOARD)/common/nucleo32/Kconfig"
```

## boards/nucleo-l053r8/Kconfig
```kconfig
# Copyright (c) 2020 Inria
#
# This file is subject to the terms and conditions of the GNU Lesser
# General Public License v2.1. See the file LICENSE in the top level
# directory for more details.
#

config BOARD
    default "nucleo-l053r8" if BOARD_NUCLEO_L053R8

config BOARD_NUCLEO_L053R8
    bool
    default y
    select BOARD_COMMON_NUCLEO64
    select CPU_MODEL_STM32L053R8

    # Put defined MCU peripherals here (in alphabetical order)
    select HAS_PERIPH_PWM
    select HAS_PERIPH_RTC
    select HAS_PERIPH_RTT
    select HAS_PERIPH_SPI
    select HAS_PERIPH_TIMER
    select HAS_PERIPH_UART

source "$(RIOTBOARD)/common/nucleo64/Kconfig"
```

## boards/nucleo-l073rz/Kconfig
```kconfig
# Copyright (c) 2020 Inria
#
# This file is subject to the terms and conditions of the GNU Lesser
# General Public License v2.1. See the file LICENSE in the top level
# directory for more details.
#

config BOARD
    default "nucleo-l073rz" if BOARD_NUCLEO_L073RZ

config BOARD_NUCLEO_L073RZ
    bool
    default y
    select BOARD_COMMON_NUCLEO64
    select CPU_MODEL_STM32L073RZ

source "$(RIOTBOARD)/common/nucleo64/Kconfig"
```

## boards/nucleo-l152re/Kconfig
```kconfig
# Copyright (c) 2020 Inria
#
# This file is subject to the terms and conditions of the GNU Lesser
# General Public License v2.1. See the file LICENSE in the top level
# directory for more details.
#

config BOARD
    default "nucleo-l152re" if BOARD_NUCLEO_L152RE

config BOARD_NUCLEO_L152RE
    bool
    default y
    select BOARD_COMMON_NUCLEO64
    select CPU_MODEL_STM32L152RE

source "$(RIOTBOARD)/common/nucleo64/Kconfig"
```

## boards/nucleo-l412kb/Kconfig
```kconfig
# SPDX-FileCopyrightText: 2020 Inria
# SPDX-License-Identifier: LGPL-2.1-only

config BOARD
    default "nucleo-l412kb" if BOARD_NUCLEO_L412KB

config BOARD_NUCLEO_L412KB
    bool
    default y
    select BOARD_COMMON_NUCLEO32
    select CPU_MODEL_STM32L412KB

source "$(RIOTBOARD)/common/nucleo32/Kconfig"
```

## boards/nucleo-l432kc/Kconfig
```kconfig
# Copyright (c) 2020 Inria
#
# This file is subject to the terms and conditions of the GNU Lesser
# General Public License v2.1. See the file LICENSE in the top level
# directory for more details.
#

config BOARD
    default "nucleo-l432kc" if BOARD_NUCLEO_L432KC

config BOARD_NUCLEO_L432KC
    bool
    default y
    select BOARD_COMMON_NUCLEO32
    select CPU_MODEL_STM32L432KC

source "$(RIOTBOARD)/common/nucleo32/Kconfig"
```

## boards/nucleo-l433rc/Kconfig
```kconfig
# SPDX-FileCopyrightText: 2020 Inria
# SPDX-License-Identifier: LGPL-2.1-only

config BOARD
    default "nucleo-l433rc" if BOARD_NUCLEO_L433RC

config BOARD_NUCLEO_L433RC
    bool
    default y
    select BOARD_COMMON_NUCLEO64
    select CPU_MODEL_STM32L433RC

source "$(RIOTBOARD)/common/nucleo64/Kconfig"
```

## boards/nucleo-l452re/Kconfig
```kconfig
# SPDX-FileCopyrightText: 2020 Inria
# SPDX-License-Identifier: LGPL-2.1-only

config BOARD
    default "nucleo-l452re" if BOARD_NUCLEO_L452RE

config BOARD_NUCLEO_L452RE
    bool
    default y
    select BOARD_COMMON_NUCLEO64
    select CPU_MODEL_STM32L452RE

source "$(RIOTBOARD)/common/nucleo64/Kconfig"
```

## boards/nucleo-l476rg/Kconfig
```kconfig
# SPDX-FileCopyrightText: 2020 Inria
# SPDX-License-Identifier: LGPL-2.1-only

config BOARD
    default "nucleo-l476rg" if BOARD_NUCLEO_L476RG

config BOARD_NUCLEO_L476RG
    bool
    default y
    select BOARD_COMMON_NUCLEO64
    select CPU_MODEL_STM32L476RG

source "$(RIOTBOARD)/common/nucleo64/Kconfig"
```

## boards/nucleo-l496zg/Kconfig
```kconfig
# SPDX-FileCopyrightText: 2020 Inria
# SPDX-License-Identifier: LGPL-2.1-only

config BOARD
    default "nucleo-l496zg" if BOARD_NUCLEO_L496ZG

config BOARD_NUCLEO_L496ZG
    bool
    default y
    select BOARD_COMMON_NUCLEO144
    select CPU_MODEL_STM32L496ZG

source "$(RIOTBOARD)/common/nucleo144/Kconfig"
```

## boards/nucleo-l4r5zi/Kconfig
```kconfig
# SPDX-FileCopyrightText: 2020 Inria
# SPDX-License-Identifier: LGPL-2.1-only

config BOARD
    default "nucleo-l4r5zi" if BOARD_NUCLEO_L4R5ZI

config BOARD_NUCLEO_L4R5ZI
    bool
    default y
    select BOARD_COMMON_NUCLEO144
    select CPU_MODEL_STM32L4R5ZI

source "$(RIOTBOARD)/common/nucleo144/Kconfig"
```

## boards/nucleo-l552ze-q/Kconfig
```kconfig
# Copyright (c) 2020 Inria
#
# This file is subject to the terms and conditions of the GNU Lesser
# General Public License v2.1. See the file LICENSE in the top level
# directory for more details.
#

config BOARD
    default "nucleo-l552ze-q" if BOARD_NUCLEO_L552ZE_Q

config BOARD_NUCLEO_L552ZE_Q
    bool
    default y
    select BOARD_COMMON_NUCLEO144
    select CPU_MODEL_STM32L552ZE

source "$(RIOTBOARD)/common/nucleo144/Kconfig"
```

## boards/nucleo-wl55jc/Kconfig
```kconfig
# Copyright (c) 2021 Freie Universität Berlin
#
# This file is subject to the terms and conditions of the GNU Lesser
# General Public License v2.1. See the file LICENSE in the top level
# directory for more details.
#

config BOARD
    default "nucleo-wl55jc" if BOARD_NUCLEO_WL55JC

config BOARD_NUCLEO_WL55JC
    bool
    default y
    select BOARD_COMMON_NUCLEO64
    select CPU_MODEL_STM32WL55JC

config CLOCK_HSE
    default 32000000

source "$(RIOTBOARD)/common/nucleo64/Kconfig"
```

## boards/nz32-sc151/Kconfig
```kconfig
# SPDX-FileCopyrightText: 2020 Inria
# SPDX-License-Identifier: LGPL-2.1-only

config BOARD
    default "nz32-sc151" if BOARD_NZ32_SC151

config BOARD_NZ32_SC151
    bool
    default y
    select CPU_MODEL_STM32L151RC

source "$(RIOTBOARD)/common/stm32/Kconfig"
```

## boards/olimex-msp430-h1611/Kconfig
```kconfig
# SPDX-FileCopyrightText: 2020 HAW Hamburg
# SPDX-License-Identifier: LGPL-2.1-only

config BOARD
    default "olimex-msp430-h1611" if BOARD_OLIMEX_MSP430_H1611

config BOARD_OLIMEX_MSP430_H1611
    bool
    default y
    select CPU_MODEL_MSP430F1611
```

## boards/olimex-msp430-h2618/Kconfig
```kconfig
# SPDX-FileCopyrightText: 2020 HAW Hamburg
# SPDX-License-Identifier: LGPL-2.1-only

config BOARD
    default "olimex-msp430-h2618" if BOARD_OLIMEX_MSP430_H2618

config BOARD_OLIMEX_MSP430_H2618
    bool
    default y
    select CPU_MODEL_MSP430F2618
```

## boards/olimexino-stm32/Kconfig
```kconfig
# SPDX-FileCopyrightText: 2020 Inria
# SPDX-License-Identifier: LGPL-2.1-only

config BOARD
    default "olimexino-stm32" if BOARD_OLIMEXINO_STM32

config BOARD_OLIMEXINO_STM32
    bool
    default y
    select CPU_MODEL_STM32F103RB

    # Clock configuration
    select BOARD_HAS_HSE
    select BOARD_HAS_LSE

source "$(RIOTBOARD)/common/stm32/Kconfig"
```

## boards/omote/Kconfig
```kconfig
# SPDX-FileCopyrightText: 2020 Oppila Microsystems - http://www.oppila.in
# SPDX-License-Identifier: LGPL-2.1-only

config BOARD
    default "omote" if BOARD_OMOTE

config BOARD_OMOTE
    bool
    default y
    select CPU_MODEL_CC2538SF53
```

## boards/opencm904/Kconfig
```kconfig
# SPDX-FileCopyrightText: 2020 Inria
# SPDX-License-Identifier: LGPL-2.1-only

config BOARD
    default "opencm904" if BOARD_OPENCM904

config BOARD_OPENCM904
    bool
    default y
    select CPU_MODEL_STM32F103CB

    # Clock configuration
    select BOARD_HAS_HSE

source "$(RIOTBOARD)/common/stm32/Kconfig"
```

## boards/openlabs-kw41z-mini-256kib/Kconfig
```kconfig
# SPDX-FileCopyrightText: 2020 HAW Hamburg
# SPDX-License-Identifier: LGPL-2.1-only

config BOARD
    default "openlabs-kw41z-mini-256kib" if BOARD_OPENLABS_KW41Z_MINI_256KIB

config BOARD_OPENLABS_KW41Z_MINI_256KIB
    bool
    default y
    select CPU_MODEL_MKW41Z256VHT4
```

## boards/openlabs-kw41z-mini/Kconfig
```kconfig
# SPDX-FileCopyrightText: 2020 HAW Hamburg
# SPDX-License-Identifier: LGPL-2.1-only

config BOARD
    default "openlabs-kw41z-mini" if BOARD_OPENLABS_KW41Z_MINI

config BOARD_OPENLABS_KW41Z_MINI
    bool
    default y
    select CPU_MODEL_MKW41Z512VHT4
```

## boards/openmote-b/Kconfig
```kconfig
# SPDX-FileCopyrightText: 2020 HAW Hamburg
# SPDX-License-Identifier: LGPL-2.1-only

config BOARD
    default "openmote-b" if BOARD_OPENMOTE_B

config BOARD_OPENMOTE_B
    bool
    default y
    select CPU_MODEL_CC2538SF53
```

## boards/openmote-cc2538/Kconfig
```kconfig
# SPDX-FileCopyrightText: 2020 HAW Hamburg
# SPDX-License-Identifier: LGPL-2.1-only

config BOARD
    default "openmote-cc2538" if BOARD_OPENMOTE_CC2538

config BOARD_OPENMOTE_CC2538
    bool
    default y
    select CPU_MODEL_CC2538SF53
```

## boards/p-l496g-cell02/Kconfig
```kconfig
# SPDX-FileCopyrightText: 2020 Inria
# SPDX-License-Identifier: LGPL-2.1-only

config BOARD
    default "p-l496g-cell02" if BOARD_P_L496G_CELL02

config BOARD_P_L496G_CELL02
    bool
    default y
    select CPU_MODEL_STM32L496AG

    # Clock configuration
    select BOARD_HAS_LSE

source "$(RIOTBOARD)/common/stm32/Kconfig"
```
