## boards/saml10-xpro/Kconfig
```kconfig
# SPDX-FileCopyrightText: 2020 HAW Hamburg
# SPDX-License-Identifier: LGPL-2.1-only

config BOARD
    default "saml10-xpro" if BOARD_SAML10_XPRO

config BOARD_SAML10_XPRO
    bool
    default y
    select BOARD_COMMON_SAML1X
    select CPU_MODEL_SAML10E16A

source "$(RIOTBOARD)/common/saml1x/Kconfig"
```

## boards/saml11-xpro/Kconfig
```kconfig
# SPDX-FileCopyrightText: 2020 HAW Hamburg
# SPDX-License-Identifier: LGPL-2.1-only

config BOARD
    default "saml11-xpro" if BOARD_SAML11_XPRO

config BOARD_SAML11_XPRO
    bool
    default y
    select BOARD_COMMON_SAML1X
    select CPU_MODEL_SAML11E16A

source "$(RIOTBOARD)/common/saml1x/Kconfig"
```

## boards/saml21-xpro/Kconfig
```kconfig
# SPDX-FileCopyrightText: 2020 HAW Hamburg
# SPDX-License-Identifier: LGPL-2.1-only

config BOARD
    default "saml21-xpro" if BOARD_SAML21_XPRO

config BOARD_SAML21_XPRO
    bool
    default y
    select CPU_MODEL_SAML21J18A
```

## boards/samr21-xpro/Kconfig
```kconfig
# SPDX-FileCopyrightText: 2020 HAW Hamburg
# SPDX-License-Identifier: LGPL-2.1-only

config BOARD
    default "samr21-xpro" if BOARD_SAMR21_XPRO

config BOARD_SAMR21_XPRO
    bool
    default y
    select CPU_MODEL_SAMR21G18A
```

## boards/samr30-xpro/Kconfig
```kconfig
# Copyright (c) 2020 HAW Hamburg
#
# This file is subject to the terms and conditions of the GNU Lesser
# General Public License v2.1. See the file LICENSE in the top level
# directory for more details.

config BOARD
    default "samr30-xpro" if BOARD_SAMR30_XPRO

config BOARD_SAMR30_XPRO
    bool
    default y
    select CPU_MODEL_SAMR30G18A
```

## boards/samr34-xpro/Kconfig
```kconfig
# Copyright (c) 2020 HAW Hamburg
#
# This file is subject to the terms and conditions of the GNU Lesser
# General Public License v2.1. See the file LICENSE in the top level
# directory for more details.

config BOARD
    default "samr34-xpro" if BOARD_SAMR34_XPRO

config BOARD_SAMR34_XPRO
    bool
    default y
    select CPU_MODEL_SAMR34J18B
```

## boards/seeedstudio-gd32/Kconfig
```kconfig
# SPDX-FileCopyrightText: 2020 Inria
# SPDX-License-Identifier: LGPL-2.1-only

config BOARD
    default "seeedstudio-gd32" if BOARD_SEEEDSTUDIO_GD32

config BOARD_SEEEDSTUDIO_GD32
    bool
    default y
    select CPU_MODEL_GD32VF103VBT6
    select BOARD_HAS_HXTAL
    select BOARD_HAS_LXTAL

source "$(RIOTBOARD)/common/gd32v/Kconfig"
```

## boards/seeedstudio-sensecap-t1000e/Kconfig
```kconfig
# SPDX-FileCopyrightText: 2026 Baptiste Le Duc <baptiste.leduc@etik.com>
# SPDX-License-Identifier: LGPL-2.1-only

config BOARD
    default "seeedstudio-sensecap-t1000e" if BOARD_SEEEDSTUDIO_T1000E

config BOARD_SEEEDSTUDIO_T1000E
    bool
    default y
    select BOARD_COMMON_NRF52
    select CPU_MODEL_NRF52840XXAA

config T1000E_ENABLE_3V3
    bool "Enable 3.3V rail"
    default y
    help
        Drive the main 3.3V load switch at boot. Required by most
        on-board peripherals. Disable to save power if all peripherals
        are managed at runtime.

config T1000E_ENABLE_SENSOR
    bool "Enable sensor power rail"
    default y
    help
        Drive the sensor load switch at boot, powering the light sensor
        and NTC thermistor. Disable if neither sensor is used.

config T1000E_ENABLE_ACC
    bool "Enable accelerometer power rail"
    default y
    help
        Drive the accelerometer load switch at boot, powering the
        QMA6100P. Disable if the accelerometer is not used.

source "$(RIOTBOARD)/common/nrf52/Kconfig"
```

## boards/seeedstudio-xiao-esp32c3/Kconfig
```kconfig
# SPDX-FileCopyrightText: 2025 David Picard
# SPDX-License-Identifier: LGPL-2.1-only

config BOARD
    default "seeedstudio-xiao-esp32c3" if BOARD_SEEEDSTUDIO_XIAO_ESP32C3

config BOARD_SEEEDSTUDIO_XIAO_ESP32C3
    bool
    default y
    select BOARD_COMMON_ESP32C3
    select CPU_MODEL_ESP32C3_FH4

source "$(RIOTBOARD)/common/esp32c3/Kconfig"
```

## boards/seeedstudio-xiao-esp32s3/Kconfig
```kconfig
# SPDX-FileCopyrightText: 2024 Technische Universität Dresden
# SPDX-FileCopyrightText: 2024 Isikcan 'Jon' Yilmaz
# SPDX-License-Identifier: LGPL-2.1-only

config BOARD
    default "seeedstudio-xiao-esp32s3" if BOARD_SEEEDSTUDIO_XIAO_ESP32S3

config BOARD_SEEEDSTUDIO_XIAO_ESP32S3
    bool
    default y
    select BOARD_COMMON_ESP32S3
    select CPU_MODEL_ESP32S3_WROOM_1X_N8R8

source "$(RIOTBOARD)/common/esp32s3/Kconfig"
```

## boards/seeedstudio-xiao-nrf52840-sense/Kconfig
```kconfig
# SPDX-FileCopyrightText: 2024 TU Dresden
# SPDX-License-Identifier: LGPL-2.1-only

config BOARD
    default "seeedstudio-xiao-nrf52840-sense" if BOARD_SEEEDSTUDIO_XIAO_NRF52840_SENSE

config BOARD_SEEEDSTUDIO_XIAO_NRF52840_SENSE
    bool
    default y
    select BOARD_COMMON_NRF52
    select CPU_MODEL_NRF52840XXAA

source "$(RIOTBOARD)/common/nrf52/Kconfig"
```

## boards/seeedstudio-xiao-nrf52840/Kconfig
```kconfig
# SPDX-FileCopyrightText: 2024 TU Dresden
# SPDX-License-Identifier: LGPL-2.1-only

config BOARD
    default "seeedstudio-xiao-nrf52840" if BOARD_SEEEDSTUDIO_XIAO_NRF52840

config BOARD_SEEEDSTUDIO_XIAO_NRF52840
    bool
    default y
    select BOARD_COMMON_NRF52
    select CPU_MODEL_NRF52840XXAA

source "$(RIOTBOARD)/common/nrf52/Kconfig"
```

## boards/seeeduino_arch-pro/Kconfig
```kconfig
# Copyright (c) 2020 HAW Hamburg
#
# This file is subject to the terms and conditions of the GNU Lesser
# General Public License v2.1. See the file LICENSE in the top level
# directory for more details.

config BOARD
    default "seeeduino_arch-pro" if BOARD_SEEEDUINO_ARCH_PRO

config BOARD_SEEEDUINO_ARCH_PRO
    bool
    default y
    select CPU_MODEL_LPC1768
```

## boards/seeeduino_xiao/Kconfig
```kconfig
# Copyright (c) 2020 HAW Hamburg
#
# This file is subject to the terms and conditions of the GNU Lesser
# General Public License v2.1. See the file LICENSE in the top level
# directory for more details.

config BOARD
    default "seeeduino_xiao" if BOARD_SEEEDUINO_XIAO

config BOARD_SEEEDUINO_XIAO
    bool
    default y
    select CPU_MODEL_SAMD21G18A
```

## boards/sensebox_samd21/Kconfig
```kconfig
# SPDX-FileCopyrightText: 2020 HAW Hamburg
# SPDX-License-Identifier: LGPL-2.1-only

config BOARD
    default "sensebox_samd21" if BOARD_SENSEBOX_SAMD21

config BOARD_SENSEBOX_SAMD21
    bool
    default y
    select CPU_MODEL_SAMD21G18A
```

## boards/serpente/Kconfig
```kconfig
# SPDX-FileCopyrightText: 2020 HAW Hamburg
# SPDX-License-Identifier: LGPL-2.1-only

config BOARD
    default "serpente" if BOARD_SERPENTE

config BOARD_SERPENTE
    bool
    default y
    select CPU_MODEL_SAMD21E18A
```

## boards/sifive_e/Kconfig
```kconfig
# Copyright (c) 2020 Koen Zandberg <koen@bergzand.net>
#
# This file is subject to the terms and conditions of the GNU Lesser
# General Public License v2.1. See the file LICENSE in the top level
# directory for more details.
#

config BOARD
    default "sifive_e" if BOARD_SIFIVE_E

config BOARD_SIFIVE_E
    bool
    default y
    select CPU_MODEL_FE310_G000
    select HAS_PERIPH_TIMER
    select HAS_PERIPH_UART
```

## boards/sipeed-longan-nano-tft/Kconfig
```kconfig
# SPDX-FileCopyrightText: 2023 Gunar Schorcht
# SPDX-License-Identifier: LGPL-2.1-only

config BOARD
    default "sipeed-longan-nano-tft" if BOARD_SIPEED_LONGAN_NANO_TFT

config BOARD_SIPEED_LONGAN_NANO_TFT
    bool
    default y
    select CPU_MODEL_GD32VF103CBT6
    select BOARD_HAS_HXTAL
    select BOARD_HAS_LXTAL

source "$(RIOTBOARD)/common/gd32v/Kconfig"
```

## boards/sipeed-longan-nano/Kconfig
```kconfig
# Copyright (c) 2023 Gunar Schorcht
#
# This file is subject to the terms and conditions of the GNU Lesser
# General Public License v2.1. See the file LICENSE in the top level
# directory for more details.
#

config BOARD
    default "sipeed-longan-nano" if BOARD_SIPEED_LONGAN_NANO

config BOARD_SIPEED_LONGAN_NANO
    bool
    default y
    select CPU_MODEL_GD32VF103CBT6
    select BOARD_HAS_HXTAL
    select BOARD_HAS_LXTAL

source "$(RIOTBOARD)/common/gd32v/Kconfig"
```

## boards/slstk3301a/Kconfig
```kconfig
# SPDX-FileCopyrightText: 2020 HAW Hamburg
# SPDX-License-Identifier: LGPL-2.1-only

config BOARD
    default "slstk3301a" if BOARD_SLSTK3301A

config BOARD_SLSTK3301A
    bool
    default y
    select BOARD_COMMON_SILABS
    select CPU_MODEL_EFM32TG11B520F128GM80

source "$(RIOTBOARD)/common/silabs/Kconfig"
```

## boards/slstk3400a/Kconfig
```kconfig
# SPDX-FileCopyrightText: 2020 HAW Hamburg
# SPDX-License-Identifier: LGPL-2.1-only

config BOARD
    default "slstk3400a" if BOARD_SLSTK3400A

config BOARD_SLSTK3400A
    bool
    default y
    select BOARD_COMMON_SILABS
    select CPU_MODEL_EFM32HG322F64

source "$(RIOTBOARD)/common/silabs/Kconfig"
```

## boards/slstk3401a/Kconfig
```kconfig
# Copyright (c) 2020 HAW Hamburg
#
# This file is subject to the terms and conditions of the GNU Lesser
# General Public License v2.1. See the file LICENSE in the top level
# directory for more details.

config BOARD
    default "slstk3401a" if BOARD_SLSTK3401A

config BOARD_SLSTK3401A
    bool
    default y
    select BOARD_COMMON_SILABS
    select CPU_MODEL_EFM32PG1B200F256GM48

source "$(RIOTBOARD)/common/silabs/Kconfig"
```

## boards/slstk3402a/Kconfig
```kconfig
# Copyright (c) 2020 HAW Hamburg
#
# This file is subject to the terms and conditions of the GNU Lesser
# General Public License v2.1. See the file LICENSE in the top level
# directory for more details.

config BOARD
    default "slstk3402a" if BOARD_SLSTK3402A

config BOARD_SLSTK3402A
    bool
    default y
    select BOARD_COMMON_SILABS
    select CPU_MODEL_EFM32PG12B500F1024GL125

source "$(RIOTBOARD)/common/silabs/Kconfig"
```

## boards/slstk3701a/Kconfig
```kconfig
# SPDX-FileCopyrightText: 2020 HAW Hamburg
# SPDX-License-Identifier: LGPL-2.1-only

config BOARD
    default "slstk3701a" if BOARD_SLSTK3701A

config BOARD_SLSTK3701A
    bool
    default y
    select BOARD_COMMON_SILABS
    select CPU_MODEL_EFM32GG11B820F2048GL192

source "$(RIOTBOARD)/common/silabs/Kconfig"
```

## boards/sltb001a/Kconfig
```kconfig
# SPDX-FileCopyrightText: 2020 HAW Hamburg
# SPDX-License-Identifier: LGPL-2.1-only

config BOARD
    default "sltb001a" if BOARD_SLTB001A

config BOARD_SLTB001A
    bool
    default y
    select BOARD_COMMON_SILABS
    select CPU_MODEL_EFR32MG1P132F256GM48

source "$(RIOTBOARD)/common/silabs/Kconfig"
```
