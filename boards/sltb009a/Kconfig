## boards/sltb009a/Kconfig
```kconfig
# Copyright (c) 2020 HAW Hamburg
#
# This file is subject to the terms and conditions of the GNU Lesser
# General Public License v2.1. See the file LICENSE in the top level
# directory for more details.

config BOARD
    default "sltb009a" if BOARD_SLTB009A

config BOARD_SLTB009A
    bool
    default y
    select BOARD_COMMON_SILABS
    select CPU_MODEL_EFM32GG12B810F1024GM64

source "$(RIOTBOARD)/common/silabs/Kconfig"
```

## boards/slwstk6000b-slwrb4150a/Kconfig
```kconfig
# SPDX-FileCopyrightText: 2020 HAW Hamburg
# SPDX-License-Identifier: LGPL-2.1-only

config BOARD
    default "slwstk6000b-slwrb4150a" if BOARD_SLWSTK6000B_SLWRB4150A

config BOARD_SLWSTK6000B_SLWRB4150A
    bool
    default y
    select CPU_MODEL_EFR32MG1P233F256GM48
    select BOARD_COMMON_SLWSTK6000B

source "$(RIOTBOARD)/common/slwstk6000b/Kconfig"
```

## boards/slwstk6000b-slwrb4162a/Kconfig
```kconfig
# SPDX-FileCopyrightText: 2020 HAW Hamburg
# SPDX-License-Identifier: LGPL-2.1-only

config BOARD
    default "slwstk6000b-slwrb4162a" if BOARD_SLWSTK6000B_SLWRB4162A

config BOARD_SLWSTK6000B_SLWRB4162A
    bool
    default y
    select CPU_MODEL_EFR32MG12P332F1024GL125
    select BOARD_COMMON_SLWSTK6000B

source "$(RIOTBOARD)/common/slwstk6000b/Kconfig"
```

## boards/slwstk6220a/Kconfig
```kconfig
# SPDX-FileCopyrightText: 2020 HAW Hamburg
# SPDX-License-Identifier: LGPL-2.1-only

config BOARD
    default "slwstk6220a" if BOARD_SLWSTK6220A

config BOARD_SLWSTK6220A
    bool
    default y
    select BOARD_COMMON_SILABS
    select CPU_MODEL_EZR32WG330F256R60

source "$(RIOTBOARD)/common/silabs/Kconfig"
```

## boards/sodaq-autonomo/Kconfig
```kconfig
# SPDX-FileCopyrightText: 2020 HAW Hamburg
# SPDX-License-Identifier: LGPL-2.1-only

config BOARD
    default "sodaq-autonomo" if BOARD_SODAQ_AUTONOMO

config BOARD_SODAQ_AUTONOMO
    bool
    default y
    select BOARD_COMMON_SODAQ
    select CPU_MODEL_SAMD21J18A

source "$(RIOTBOARD)/common/sodaq/Kconfig"
```

## boards/sodaq-explorer/Kconfig
```kconfig
# SPDX-FileCopyrightText: 2020 HAW Hamburg
# SPDX-License-Identifier: LGPL-2.1-only

config BOARD
    default "sodaq-explorer" if BOARD_SODAQ_EXPLORER

config BOARD_SODAQ_EXPLORER
    bool
    default y
    select BOARD_COMMON_SODAQ
    select CPU_MODEL_SAMD21J18A

source "$(RIOTBOARD)/common/sodaq/Kconfig"
```

## boards/sodaq-one/Kconfig
```kconfig
# SPDX-FileCopyrightText: 2020 HAW Hamburg
# SPDX-License-Identifier: LGPL-2.1-only

config BOARD
    default "sodaq-one" if BOARD_SODAQ_ONE

config BOARD_SODAQ_ONE
    bool
    default y
    select BOARD_COMMON_SODAQ
    select CPU_MODEL_SAMD21G18A

source "$(RIOTBOARD)/common/sodaq/Kconfig"
```

## boards/sodaq-sara-aff/Kconfig
```kconfig
# Copyright (c) 2020 HAW Hamburg
#
# This file is subject to the terms and conditions of the GNU Lesser
# General Public License v2.1. See the file LICENSE in the top level
# directory for more details.

config BOARD
    default "sodaq-sara-aff" if BOARD_SODAQ_SARA_AFF

config BOARD_SODAQ_SARA_AFF
    bool
    default y
    select BOARD_COMMON_SODAQ
    select CPU_MODEL_SAMD21J18A

source "$(RIOTBOARD)/common/sodaq/Kconfig"
```

## boards/sodaq-sara-sff/Kconfig
```kconfig
# SPDX-FileCopyrightText: 2020 HAW Hamburg
# SPDX-License-Identifier: LGPL-2.1-only

config BOARD
    default "sodaq-sara-sff" if BOARD_SODAQ_SARA_SFF

config BOARD_SODAQ_SARA_SFF
    bool
    default y
    select BOARD_COMMON_SODAQ
    select CPU_MODEL_SAMD21G18A

source "$(RIOTBOARD)/common/sodaq/Kconfig"
```

## boards/spark-core/Kconfig
```kconfig
# SPDX-FileCopyrightText: 2020 Inria
# SPDX-License-Identifier: LGPL-2.1-only

config BOARD
    default "spark-core" if BOARD_SPARK_CORE

config BOARD_SPARK_CORE
    bool
    default y
    select CPU_MODEL_STM32F103CB

source "$(RIOTBOARD)/common/stm32/Kconfig"
```

## boards/stk3200/Kconfig
```kconfig
# SPDX-FileCopyrightText: 2020 HAW Hamburg
# SPDX-License-Identifier: LGPL-2.1-only

config BOARD
    default "stk3200" if BOARD_STK3200

config BOARD_STK3200
    bool
    default y
    select BOARD_COMMON_SILABS
    select CPU_MODEL_EFM32ZG222F32

source "$(RIOTBOARD)/common/silabs/Kconfig"
```

## boards/stk3600/Kconfig
```kconfig
# Copyright (c) 2020 HAW Hamburg
#
# This file is subject to the terms and conditions of the GNU Lesser
# General Public License v2.1. See the file LICENSE in the top level
# directory for more details.

config BOARD
    default "stk3600" if BOARD_STK3600

config BOARD_STK3600
    bool
    default y
    select BOARD_COMMON_SILABS
    select CPU_MODEL_EFM32LG990F256

source "$(RIOTBOARD)/common/silabs/Kconfig"
```

## boards/stk3700/Kconfig
```kconfig
# SPDX-FileCopyrightText: 2020 HAW Hamburg
# SPDX-License-Identifier: LGPL-2.1-only

config BOARD
    default "stk3700" if BOARD_STK3700

config BOARD_STK3700
    bool
    default y
    select BOARD_COMMON_SILABS
    select CPU_MODEL_EFM32GG990F1024

source "$(RIOTBOARD)/common/silabs/Kconfig"
```

## boards/stm32c0116-dk/Kconfig
```kconfig
# SPDX-FileCopyrightText: 2024 BISSELL Homecare, Inc.
# SPDX-License-Identifier: LGPL-2.1-only

config BOARD
    default "stm32c0116-dk" if BOARD_STM32C0116_DK

config  BOARD_STM32C0116_DK
    bool
    default y
    select CPU_MODEL_STM32C011F6
```

## boards/stm32c0316-dk/Kconfig
```kconfig
# SPDX-FileCopyrightText: 2024 BISSELL Homecare, Inc.
# SPDX-License-Identifier: LGPL-2.1-only

config BOARD
    default "stm32c0316-dk" if BOARD_STM32C0316_DK

config  BOARD_STM32C0316_DK
    bool
    default y
    select CPU_MODEL_STM32C031C6
```

## boards/stm32f030f4-demo/Kconfig
```kconfig
# SPDX-FileCopyrightText: 2020 Inria
# SPDX-License-Identifier: LGPL-2.1-only

config BOARD
    default "stm32f030f4-demo" if BOARD_STM32F030F4_DEMO

config BOARD_STM32F030F4_DEMO
    bool
    default y
    select CPU_MODEL_STM32F030F4

    # Clock configuration
    select BOARD_HAS_HSE

source "$(RIOTBOARD)/common/stm32/Kconfig"
```

## boards/stm32f0discovery/Kconfig
```kconfig
# SPDX-FileCopyrightText: 2020 Inria
# SPDX-License-Identifier: LGPL-2.1-only

config BOARD
    default "stm32f0discovery" if BOARD_STM32F0DISCOVERY

config BOARD_STM32F0DISCOVERY
    bool
    default y
    select CPU_MODEL_STM32F051R8

    # Clock configuration
    select BOARD_HAS_HSE

source "$(RIOTBOARD)/common/stm32/Kconfig"
```

## boards/stm32f3discovery/Kconfig
```kconfig
# SPDX-FileCopyrightText: 2020 Inria
# SPDX-License-Identifier: LGPL-2.1-only

config BOARD
    default "stm32f3discovery" if BOARD_STM32F3DISCOVERY

config BOARD_STM32F3DISCOVERY
    bool
    default y
    select CPU_MODEL_STM32F303VC

    # Clock configuration
    select BOARD_HAS_HSE

source "$(RIOTBOARD)/common/stm32/Kconfig"
```

## boards/stm32f429i-disc1/Kconfig
```kconfig
# SPDX-FileCopyrightText: 2020 Inria
# SPDX-License-Identifier: LGPL-2.1-only

config BOARD
    default "stm32f429i-disc1" if BOARD_STM32F429I_DISC1

config BOARD_STM32F429I_DISC1
    bool
    default y
    select CPU_MODEL_STM32F429ZI

    # Clock configuration
    select BOARD_HAS_HSE
    select BOARD_HAS_LSE

source "$(RIOTBOARD)/common/stm32/Kconfig"
```

## boards/stm32f429i-disco/Kconfig
```kconfig
# SPDX-FileCopyrightText: 2020 Inria
# SPDX-License-Identifier: LGPL-2.1-only

config BOARD
    default "stm32f429i-disco" if BOARD_STM32F429I_DISCO

config BOARD_STM32F429I_DISCO
    bool
    default y
    select CPU_MODEL_STM32F429ZI

source "$(RIOTBOARD)/common/stm32/Kconfig"
source "$(RIOTBOARD)/stm32f429i-disc1/Kconfig"
```

## boards/stm32f469i-disco/Kconfig
```kconfig
config BOARD
    default "stm32f469i-disco" if BOARD_STM32F469I_DISCO

config BOARD_STM32F469I_DISCO
    bool
    default y
    select CPU_MODEL_STM32F469NI

    # Clock configuration
    select BOARD_HAS_HSE
    select BOARD_HAS_LSE

config CLOCK_HSE
    default 8000000

source "$(RIOTBOARD)/common/stm32/Kconfig"
```

## boards/stm32f4discovery/Kconfig
```kconfig
# Copyright (c) 2020 Inria
#
# This file is subject to the terms and conditions of the GNU Lesser
# General Public License v2.1. See the file LICENSE in the top level
# directory for more details.
#

config BOARD
    default "stm32f4discovery" if BOARD_STM32F4DISCOVERY

config BOARD_STM32F4DISCOVERY
    bool
    default y
    select CPU_MODEL_STM32F407VG

    # Clock configuration
    select BOARD_HAS_HSE

source "$(RIOTBOARD)/common/stm32/Kconfig"
```

## boards/stm32f723e-disco/Kconfig
```kconfig
# SPDX-FileCopyrightText: 2020 Inria
# SPDX-License-Identifier: LGPL-2.1-only

config BOARD
    default "stm32f723e-disco" if BOARD_STM32F723E_DISCO

config BOARD_STM32F723E_DISCO
    bool
    default y
    select CPU_MODEL_STM32F723IE

    # Clock configuration
    select BOARD_HAS_HSE
    select BOARD_HAS_LSE

config CLOCK_HSE
    default 25000000

source "$(RIOTBOARD)/common/stm32/Kconfig"
```

## boards/stm32f746g-disco/Kconfig
```kconfig
# SPDX-FileCopyrightText: 2021 Inria
# SPDX-License-Identifier: LGPL-2.1-only

config BOARD
    default "stm32f746g-disco" if BOARD_STM32F746G_DISCO

config BOARD_STM32F746G_DISCO
    bool
    default y
    select CPU_MODEL_STM32F746NG

    # Clock configuration
    select BOARD_HAS_HSE
    select BOARD_HAS_LSE

config CLOCK_HSE
    default 25000000


source "$(RIOTBOARD)/common/stm32/Kconfig"
```

## boards/stm32f7508-dk/Kconfig
```kconfig
# SPDX-FileCopyrightText: 2022 Inria
# SPDX-License-Identifier: LGPL-2.1-only

config BOARD
    default "stm32f7508-dk" if BOARD_STM32F7508_DK

config BOARD_STM32F7508_DK
    bool
    default y
    select CPU_MODEL_STM32F750N8

    # Clock configuration
    select BOARD_HAS_HSE
    select BOARD_HAS_LSE

config CLOCK_HSE
    default 25000000

source "$(RIOTBOARD)/common/stm32/Kconfig"
```
