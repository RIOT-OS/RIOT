## boards/arty-a7-noelv/Kconfig
```kconfig
# SPDX-FileCopyrightText: 2026 Matvii Ivashchenko
# SPDX-License-Identifier: LGPL-2.1-only

config BOARD
    default "arty-a7-noelv" if BOARD_ARTY_A7_NOELV

config BOARD_ARTY_A7_NOELV
    bool
    default y
    select CPU_MODEL_NOELV_RV32IMAC
```

## boards/feather-m0/Kconfig.feather-m0-base
```kconfig
# SPDX-FileCopyrightText: 2020 HAW Hamburg
# SPDX-License-Identifier: LGPL-2.1-only

config BOARD_FEATHER_M0_BASE
    bool
    default y
    select CPU_MODEL_SAMD21G18A
```

## boards/particle-argon/Kconfig
```kconfig
# SPDX-FileCopyrightText: 2020 HAW Hamburg
# SPDX-License-Identifier: LGPL-2.1-only

config BOARD
    default "particle-argon" if BOARD_PARTICLE_ARGON

config BOARD_PARTICLE_ARGON
    bool
    default y
    select BOARD_COMMON_PARTICLE_MESH

source "$(RIOTBOARD)/common/particle-mesh/Kconfig"
```

## boards/particle-boron/Kconfig
```kconfig
# SPDX-FileCopyrightText: 2020 HAW Hamburg
# SPDX-License-Identifier: LGPL-2.1-only

config BOARD
    default "particle-boron" if BOARD_PARTICLE_BORON

config BOARD_PARTICLE_BORON
    bool
    default y
    select BOARD_COMMON_PARTICLE_MESH

source "$(RIOTBOARD)/common/particle-mesh/Kconfig"
```

## boards/particle-xenon/Kconfig
```kconfig
# SPDX-FileCopyrightText: 2020 HAW Hamburg
# SPDX-License-Identifier: LGPL-2.1-only

config BOARD
    default "particle-xenon" if BOARD_PARTICLE_XENON

config BOARD_PARTICLE_XENON
    bool
    default y
    select BOARD_COMMON_PARTICLE_MESH

source "$(RIOTBOARD)/common/particle-mesh/Kconfig"
```

## boards/zedboard-noelv/Kconfig
```kconfig
# SPDX-FileCopyrightText: 2026 Matvii Ivashchenko
# SPDX-License-Identifier: LGPL-2.1-only

config BOARD
    default "zedboard-noelv" if BOARD_ZEDBOARD_NOELV

config BOARD_ZEDBOARD_NOELV
    bool
    default y
    select CPU_MODEL_NOELV_RV64IMAC
```

## cpu/noelv/Kconfig
```kconfig
# SPDX-FileCopyrightText: 2026 Matvii Ivashchenko
# SPDX-License-Identifier: LGPL-2.1-only

config CPU_FAM_NOELV
    bool
    select CPU_CORE_RV64IMAC

config CPU_MODEL_NOELV_RV64IMAC
    bool
    select CPU_FAM_NOELV

config CPU_FAM
    default "noelv" if CPU_FAM_NOELV

config CPU_MODEL
    default "noelv_rv64imac" if CPU_MODEL_NOELV_RV64IMAC

config CPU
    default "noelv" if CPU_FAM_NOELV

config CPU_CORE
    default "rv64imac" if CPU_CORE_RV64IMAC

source "$(RIOTCPU)/riscv_common/Kconfig"
```

## drivers/epson_escpos/Kconfig
```kconfig
# SPDX-FileCopyrightText: 2026 Christopher Büchse
# SPDX-License-Identifier: LGPL-2.1-only

menu "Epson ESC/POS receipt printer driver"
    depends on USEMODULE_EPSON_ESCPOS

config EPSON_ESCPOS_BUF_SIZE
    int "Size of the transmit buffer in bytes"
    range 8 65535
    default 64
    help
        Commands are collected in this buffer and sent to the printer when the
        buffer is full or when epson_escpos_flush() is called.

config EPSON_ESCPOS_READ_TIMEOUT_MS
    int "Timeout for reading the printer status in milliseconds"
    default 3000
    help
        Some network interfaces are slow to respond, e.g. a TM-T88III takes
        about 900 ms to answer a status query.

config EPSON_ESCPOS_TCP_PORT
    int "Default TCP port of the printer"
    range 1 65535
    default 9100

config EPSON_ESCPOS_TCP_HOST
    string "Default IPv4 address of the printer for the TCP transport"
    default "192.168.1.100"

config EPSON_ESCPOS_UART_DEV
    int "Default UART device index for the UART transport"
    default 1

config EPSON_ESCPOS_UART_BAUDRATE
    int "Default baud rate for the UART transport"
    default 9600

config EPSON_ESCPOS_UART_RX_BUF_SIZE
    int "Size of the receive buffer of the UART transport in bytes"
    default 16
    help
        Must be a power of two.

endmenu # Epson ESC/POS receipt printer driver
```

## drivers/max1161x/Kconfig
```kconfig
# SPDX-FileCopyrightText: 2026 Mathis LECRIVAIN <lecrivain.mathis@gmail.com>
# SPDX-License-Identifier: LGPL-2.1-only

menuconfig MODULE_MAX1161X
    bool "MAX1161X Analog-to-Digital converter"
    depends on HAS_PERIPH_I2C
    depends on TEST_KCONFIG
    select MODULE_PERIPH_I2C

choice MAX1161X_VARIANT
    bool "Variants"
    depends on MODULE_MAX1161X
    default MODULE_MAX11612 if HAVE_MAX11612
    default MODULE_MAX11613 if HAVE_MAX11613
    default MODULE_MAX11614 if HAVE_MAX11614
    default MODULE_MAX11615 if HAVE_MAX11615
    default MODULE_MAX11616 if HAVE_MAX11616
    default MODULE_MAX11617 if HAVE_MAX11617
    help
        This driver works with max11612, max11613, max11614, max11615, max11616 and max11617
        models. Select one.

config MODULE_MAX11612
    bool "MAX11612"

config MODULE_MAX11613
    bool "MAX11613"

config MODULE_MAX11614
    bool "MAX11614"

config MODULE_MAX11615
    bool "MAX11615"

config MODULE_MAX11616
    bool "MAX11616"

config MODULE_MAX11617
    bool "MAX11617"

endchoice

config HAVE_MAX1161X
    bool
    help
        Indicates that a MAX1161X Analog-to-Digital converter is present.

config HAVE_MAX11612
    bool
    select HAVE_MAX1161X
    help
        Indicates that a MAX11612 Analog-to-Digital converter is present.

config HAVE_MAX11613
    bool
    select HAVE_MAX1161X
    help
        Indicates that a MAX11613 Analog-to-Digital converter is present.

config HAVE_MAX11614
    bool
    select HAVE_MAX1161X
    help
        Indicates that a MAX11614 Analog-to-Digital converter is present.

config HAVE_MAX11615
    bool
    select HAVE_MAX1161X
    help
        Indicates that a MAX11615 Analog-to-Digital converter is present.

config HAVE_MAX11616
    bool
    select HAVE_MAX1161X
    help
        Indicates that a MAX11616 Analog-to-Digital converter is present.

config HAVE_MAX11617
    bool
    select HAVE_MAX1161X
    help
        Indicates that a MAX11617 Analog-to-Digital converter is present.
```

## pkg/Kconfig
```kconfig
# SPDX-FileCopyrightText: 2019 HAW Hamburg
# SPDX-License-Identifier: LGPL-2.1-only


rsource "flashdb/Kconfig"
rsource "libcoap/Kconfig"
rsource "libfixmath/Kconfig"
rsource "libschc/Kconfig"
rsource "littlefs2/Kconfig"
rsource "lvgl/Kconfig"
rsource "mbedtls/Kconfig"
rsource "semtech-loramac/Kconfig"
rsource "tinydtls/Kconfig"
rsource "tinyusb/Kconfig"
rsource "tinyvcdiff/Kconfig"
rsource "wakaama/Kconfig"

endmenu # Packages
```

## pkg/flashdb/Kconfig
```kconfig
# SPDX-FileCopyrightText: 2022 ML!PA Consulting GmbH
# SPDX-License-Identifier: LGPL-2.1-only

menu "FlashDB package"
    depends on USEPKG_FLASHDB

config FLASHDB_MIN_SECTOR_SIZE_DEFAULT_KiB
    int "Minimal virtual sector size in KiB for FlashDB"
    default 4
    help
        By default, KVDB will use 1 times the block size as the sector size, that is, 4096.
        At this time, the KVDB cannot store a KV longer than 4096. If you want to save, for example,
        a KV with a length of 10K, you can use the control function to set the sector size to 12K or
        larger.

endmenu # FlashDB
```

## pkg/libschc/Kconfig
```kconfig
# SPDX-FileCopyrightText: 2022 Freie Universität Berlin
# SPDX-License-Identifier: LGPL-2.1-only

menu "libSCHC"
    depends on USEPKG_LIBSCHC

config LIBSCHC_STATIC_MEMBUF_LEN
    int "Static memory allocation buffer length"
    default 1024
    help
        Length of the static memory buffer for fragment data allocation in reassembly buffer in
        bytes.

config LIBSCHC_MBUF_POOL_SIZE
    int "Maximum number of mbuf pool entries"
    default 64
    help
        Maximum number of entries in the mbuf used for fragment reassembly.

config LIBSCHC_MAX_RX_CONNS
    int "Maximum number of incoming connections"
    default 1

config LIBSCHC_MAX_MTU_LEN
    int "Maximum transfer unit of the underlying technology"
    default 242

config LIBSCHC_DEBUG
    bool "Enable debug output"

endmenu # libSCHC
```

## pkg/lvgl/Kconfig
```kconfig
# SPDX-FileCopyrightText: 2021 Inria
# SPDX-License-Identifier: LGPL-2.1-only

menu "LVGL RIOT configuration"
    depends on USEPKG_LVGL

    config LVGL_INACTIVITY_PERIOD_MS
        int "Inactivity period before blocking the LVGL thread (in ms)"
        default 5000

    config LVGL_TASK_HANDLER_DELAY_US
        int "Delay between calls to the lvgl task handler (in us)"
        default 5000

endmenu

osource "$(PKGDIRBASE)/lvgl/Kconfig"
```

## pkg/semtech-loramac/Kconfig
```kconfig
# SPDX-FileCopyrightText: 2020 Freie Universität Berlin
# SPDX-License-Identifier: LGPL-2.1-only

config USEPKG_SEMTECH_LORAMAC
    bool
```

## pkg/tinydtls/Kconfig
```kconfig
# SPDX-FileCopyrightText: 2019 HAW Hamburg
# SPDX-License-Identifier: LGPL-2.1-only

    depends on USEPKG_TINYDTLS

config DTLS_PSK
    bool "TLS_PSK_WITH_AES_128_CCM_8"

config DTLS_ECC
    bool "TLS_ECDHE_ECDSA_WITH_AES_128_CCM_8"

config DTLS_DEBUG
    bool "Enable debug log"
    help
        Enable debug log output for tinydtls

config DTLS_CONTEXT_MAX
    int "Max DTLS context"
    default 2
    help
        The maximum number of DTLS context at the same time.

config DTLS_PEER_MAX
    int "Max number of peers"
    default 2 if USEMODULE_GCOAP_DTLS
    default 1
    help
        The maximum number of DTLS peers.

config DTLS_HANDSHAKE_MAX
    int "Max concurrent handshake"
    default 1
    help
        The maximum number of concurrent DTLS handshakes.

endmenu # tinydtls
```

## pkg/tinyusb/Kconfig.hid
```kconfig
# SPDX-FileCopyrightText: 2022 Gunar Schorcht
# SPDX-License-Identifier: LGPL-2.1-only

if USEMODULE_TINYUSB_CLASS_HID && USEMODULE_TINYUSB_DEVICE

config TUSBD_HID_NUMOF
    int "Number of HID interfaces"
    default 1
    range 1 2

config TUSBD_HID_EP_SIZE
    int "HID endpoint size [byte]"
    default 64

config TUSBD_HID_0_POLL_INTERVALL
    int "HID0 polling interval [ms]"
    depends on TUSBD_HID_NUMOF > 0
    default 10

config TUSBD_HID_0_STRING
    string "HID0 descriptor string"
    depends on TUSBD_HID_NUMOF > 0
    default "TinyUSB HID0 (Generic In/Out)"

config TUSBD_HID_1_POLL_INTERVALL
    int "HID1 polling interval [ms]"
    depends on TUSBD_HID_NUMOF > 1
    default 10

config TUSBD_HID_1_STRING
    string "HID1 descriptor string"
    depends on TUSBD_HID_NUMOF > 1
    default "TinyUSB HID1 (Generic In/Out)"

endif
```

## pkg/tinyusb/Kconfig.msc
```kconfig
# SPDX-FileCopyrightText: 2022 Gunar Schorcht
# SPDX-License-Identifier: LGPL-2.1-only

if USEMODULE_TINYUSB_CLASS_MSC && USEMODULE_TINYUSB_DEVICE

config TUSBD_MSC_NUMOF
    int
    default 1

config TUSBD_MSC_FS_EP_SIZE
    int "MSC Full-Speed endpoint size [byte]"
    default 64

config TUSBD_MSC_HS_EP_SIZE
    int "MSC High-Speed endpoint size [byte]"
    default 512

config TUSBD_MSC_STRING
    string "MSC descriptor string"
    depends on TUSBD_MSC_NUMOF > 0
    default "TinyUSB MSC"

endif
```

## pkg/tinyusb/Kconfig.net
```kconfig
# SPDX-FileCopyrightText: 2022 Gunar Schorcht
# SPDX-License-Identifier: LGPL-2.1-only

if USEMODULE_TINYUSB_CLASS_NET

config TUSBD_NET_NUMOF
    int
    default 1

if TUSBD_NET_NUMOF > 0

config TUSBD_NET_NOTIF_EP_SIZE
    int "Net Notification endpoint size [byte]"
    default 64

config TUSBD_NET_FS_EP_SIZE
    int "Net Full-Speed endpoint size [byte]"
    default 64

config TUSBD_NET_HS_EP_SIZE
    int "Net High-Speed endpoint size [byte]"
    default 512

config TUSBD_NET_MTU_SIZE
    int "MTU size [byte]"
    default 1514

config TUSBD_NET_DESC_STRING
    string "Class descriptor string"
    default "TinyUSB Net"

config TUSBD_NET_CUSTOM_MAC
    bool "Use custom MAC address string"

config TUSBD_NET_MAC_STRING
    string "MAC address string"
    depends on TUSBD_ECM_CUSTOM_MAC
    default "0123456789ab"

endif # TUSBD_NET_NUMOF > 0
endif # USEMODULE_TINYUSB_CLASS_NET
```

## pkg/tinyusb/dfu/Kconfig.dfu_rt
```kconfig
# SPDX-FileCopyrightText: 2022 Gunar Schorcht
# SPDX-License-Identifier: LGPL-2.1-only

if USEMODULE_TINYUSB_CLASS_DFU_RUNTIME

config TUSBD_DFU_RT_NUMOF
    int
    default 1

config TUSBD_DFU_RT_FS_XFER_SIZE
    int "DFU Full-Speed transfer size [byte]"
    default 64

config TUSBD_DFU_RT_HS_XFER_SIZE
    int "DFU High-Speed transfer size [byte]"
    default 512

config TUSBD_DFU_RT_DETACH_TIMEOUT
    int "DFU detach timeout [ms]"
    default 1000

endif # USEMODULE_TINYUSB_CLASS_DFU_RUNTIME
```

## pkg/tinyvcdiff/Kconfig
```kconfig
# SPDX-FileCopyrightText: 2022 Juergen Fitschen
# SPDX-License-Identifier: LGPL-2.1-only

if USEPKG_TINYVCDIFF

config TINYVCDIFF_BUFFER_SIZE
    int "Buffer size"
    default 128
    help
        For VCDIFF copy and run instruction the library requires a buffer.
        The best performance is achieved for sizes of typical page sizes of
        the underlying MTD or VFS backend. But a size of just 1 byte would
        work, too.

if USEMODULE_TINYVCDIFF_MTD

config TINYVCDIFF_MTD_WRITE_SIZE
    int "Write size"
    default 4
    help
        Alignment and minimum size for MTD write access.

endif # USEMODULE_TINYVCDIFF_MTD

endif # USEPKG_TINYVCDIFF
```

## pkg/wakaama/contrib/objects/Kconfig
```kconfig
# SPDX-FileCopyrightText: 2021 HAW Hamburg
# SPDX-License-Identifier: LGPL-2.1-only

menu "LwM2M objects"

rsource "Kconfig.device"
rsource "Kconfig.security"
rsource "Kconfig.ipso"
rsource "Kconfig.light_control"

endmenu
```

## pkg/wakaama/contrib/objects/Kconfig.device
```kconfig
# SPDX-FileCopyrightText: 2021 HAW Hamburg
# SPDX-License-Identifier: LGPL-2.1-only

menu "Device"

choice
    bool "Device binding and queue mode"
    default LWM2M_DEVICE_BINDING_U

config LWM2M_DEVICE_BINDING_U
    bool "UDP"

config LWM2M_DEVICE_BINDING_UQ
    bool "UDP with Queue mode"

config LWM2M_DEVICE_BINDING_S
    bool "SMS"

config LWM2M_DEVICE_BINDING_SQ
    bool "SMS with Queue mode"

config LWM2M_DEVICE_BINDING_US
    bool "UDP and SMS"

config LWM2M_DEVICE_BINDING_UQS
    bool "UDP with Queue mode and SMS"

endchoice

config LWM2M_DEVICE_NAME
    string "Device name"
    default "testRIOTDevice"
    help
        This is the device name used to register at the LwM2M server.

config LWM2M_DEVICE_MANUFACTURER
    string "Device manufacturer"
    default "A RIOT maker"

config LWM2M_DEVICE_MODEL
    string "Device model"
    default "$(BOARD)"

config LWM2M_DEVICE_TYPE
    string "Device type"
    default "RIOT device"

config LWM2M_DEVICE_SERIAL
    string "Device serial number"
    default "undefined"

config LWM2M_DEVICE_FW_VERSION
    string "Device firmware version"
    default ""

config LWM2M_DEVICE_HW_VERSION
    string "Device hardware version"
    default "$(BOARD)"

config LWM2M_DEVICE_SW_VERSION
    string "Device software version"
    default ""

endmenu # Device
```

## pkg/wakaama/contrib/objects/Kconfig.light_control
```kconfig
# SPDX-FileCopyrightText: 2021 HAW Hamburg
# SPDX-License-Identifier: LGPL-2.1-only

menu "Light Control object"

config LWM2M_LIGHT_INSTANCES_MAX
    int "Maximum number of Light Control object instances"
    default 3

config LWM2M_LIGHT_CONTROL_COLOR_MAX_SIZE
    int "Maximum size of a Light Control color string"
    default 16

config LWM2M_LIGHT_CONTROL_APP_TYPE_MAX_SIZE
    int "Maximum size of a Light Control application type string"
    default 16

endmenu # Light Control object
```

## pkg/wakaama/contrib/objects/Kconfig.security
```kconfig
# SPDX-FileCopyrightText: 2021 HAW Hamburg
# SPDX-License-Identifier: LGPL-2.1-only

menu "Security object"

config LWM2M_OBJ_SECURITY_INSTANCES_MAX
    int "Maximum number of instances of the Security object"
    default 2

config LWM2M_OBJ_SECURITY_PUB_KEY_ID_BUFSIZE
    int "Buffer size of the public key or ID resource"
    default 128

config LWM2M_OBJ_SECURITY_SERVER_PUB_KEY_BUFSIZE
    int "Buffer size of the server public key resource"
    default 128

config LWM2M_OBJ_SECURITY_SEC_KEY_BUFSIZE
    int "Buffer size of the secret key resource"
    default 64

endmenu # Security object
```
