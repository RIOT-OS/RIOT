## boards/cc1312-launchpad/Kconfig
```kconfig
# Copyright (c) 2020 Locha Inc
#
# This file is subject to the terms and conditions of the GNU Lesser
# General Public License v2.1. See the file LICENSE in the top level
# directory for more details.
#

config BOARD
    default "cc1312-launchpad" if BOARD_CC1312_LAUNCHPAD

config BOARD_CC1312_LAUNCHPAD
    bool
    default y
    select CPU_MODEL_CC1312R1F3
```

## boards/cc1350-launchpad/Kconfig
```kconfig
# SPDX-FileCopyrightText: 2020 Locha Inc
# SPDX-License-Identifier: LGPL-2.1-only

config BOARD
    default "cc1350-launchpad" if BOARD_CC1350_LAUNCHPAD

config BOARD_CC1350_LAUNCHPAD
    bool
    default y
    select CPU_MODEL_CC13X0F128
```

## boards/cc1352-launchpad/Kconfig
```kconfig
# Copyright (c) 2020 Locha Inc
#
# This file is subject to the terms and conditions of the GNU Lesser
# General Public License v2.1. See the file LICENSE in the top level
# directory for more details.
#

config BOARD
    default "cc1352-launchpad" if BOARD_CC1352_LAUNCHPAD

config BOARD_CC1352_LAUNCHPAD
    bool
    default y
    select CPU_MODEL_CC1352R1
```

## boards/cc1352p-launchpad/Kconfig
```kconfig
# SPDX-FileCopyrightText: 2020 Locha Inc
# SPDX-License-Identifier: LGPL-2.1-only

config BOARD
    default "cc1352p-launchpad" if BOARD_CC1352P_LAUNCHPAD

config BOARD_CC1352P_LAUNCHPAD
    bool
    default y
    select CPU_MODEL_CC1352P1
```

## boards/cc2538dk/Kconfig
```kconfig
# SPDX-FileCopyrightText: 2020 HAW Hamburg
# SPDX-License-Identifier: LGPL-2.1-only

config BOARD
    default "cc2538dk" if BOARD_CC2538DK

config BOARD_CC2538DK
    bool
    default y
    select CPU_MODEL_CC2538NF53
```

## boards/cc2650-launchpad/Kconfig
```kconfig
# SPDX-FileCopyrightText: 2020 Locha Inc
# SPDX-License-Identifier: LGPL-2.1-only

config BOARD
    default "cc2650-launchpad" if BOARD_CC2650_LAUNCHPAD

config BOARD_CC2650_LAUNCHPAD
    bool
    default y
    select CPU_MODEL_CC26X0F128
```

## boards/cc2650stk/Kconfig
```kconfig
# SPDX-FileCopyrightText: 2020 Locha Inc
# SPDX-License-Identifier: LGPL-2.1-only

config BOARD
    default "cc2650stk" if BOARD_CC2650STK

config BOARD_CC2650STK
    bool
    default y
    select CPU_MODEL_CC26X0F128
```

## boards/chronos/Kconfig
```kconfig
# Copyright (c) 2020 HAW Hamburg
#
# This file is subject to the terms and conditions of the GNU Lesser
# General Public License v2.1. See the file LICENSE in the top level
# directory for more details.

config BOARD
    default "chronos" if BOARD_CHRONOS

config BOARD_CHRONOS
    bool
    default y
    select CPU_MODEL_CC430F6137
    select HAS_PERIPH_TIMER
    select HAS_PERIPH_RTC
```

## boards/common/arduino-atmega/Kconfig
```kconfig
# SPDX-FileCopyrightText: 2020 HAW Hamburg
# SPDX-License-Identifier: LGPL-2.1-only

config BOARD_COMMON_ARDUINO_ATMEGA
    bool
```

## boards/common/arduino-due/Kconfig
```kconfig
# Copyright (c) 2020 HAW Hamburg
#
# This file is subject to the terms and conditions of the GNU Lesser
# General Public License v2.1. See the file LICENSE in the top level
# directory for more details.

config BOARD_COMMON_ARDUINO_DUE
    bool
    select CPU_MODEL_SAM3X8E
```

## boards/common/arduino-mkr/Kconfig
```kconfig
# SPDX-FileCopyrightText: 2020 HAW Hamburg
# SPDX-License-Identifier: LGPL-2.1-only

config BOARD_COMMON_ARDUINO_MKR
    bool
    select CPU_MODEL_SAMD21G18A
```

## boards/common/arduino-zero/Kconfig
```kconfig
# Copyright (c) 2020 HAW Hamburg
#
# This file is subject to the terms and conditions of the GNU Lesser
# General Public License v2.1. See the file LICENSE in the top level
# directory for more details.

config BOARD_COMMON_ARDUINO_ZERO
    bool
    select CPU_MODEL_SAMD21G18A
    select HAS_PERIPH_ADC
    select HAS_PERIPH_I2C
    select HAS_PERIPH_PWM
    select HAS_PERIPH_RTC
    select HAS_PERIPH_RTT
    select HAS_PERIPH_SPI
    select HAS_PERIPH_TIMER
    select HAS_PERIPH_UART
    select HAS_PERIPH_USBDEV
    select HAS_ARDUINO
    select HAS_ARDUINO_PWM

    select HAVE_SAUL_GPIO

config MODULE_BOARDS_COMMON_ARDUINO_ZERO
    bool
    depends on TEST_KCONFIG
    default y
    help
        Common code for arduino-zero type of boards.
```

## boards/common/atmega/Kconfig
```kconfig
# Copyright (c) 2021 HAW Hamburg
#
# This file is subject to the terms and conditions of the GNU Lesser
# General Public License v2.1. See the file LICENSE in the top level
# directory for more details.
#

config MODULE_BOARDS_COMMON_ATMEGA
    bool
    depends on TEST_KCONFIG
    help
        Common code of ATmega boards.
```

## boards/common/atxmega/Kconfig
```kconfig
# Copyright (c) 2021 HAW Hamburg
#
# This file is subject to the terms and conditions of the GNU Lesser
# General Public License v2.1. See the file LICENSE in the top level
# directory for more details.
#

config MODULE_BOARDS_COMMON_ATXMEGA
    bool
    depends on TEST_KCONFIG
    help
        Common ATXmega boards code.
```

## boards/common/blxxxpill/Kconfig
```kconfig
# Copyright (c) 2020 Inria
#
# This file is subject to the terms and conditions of the GNU Lesser
# General Public License v2.1. See the file LICENSE in the top level
# directory for more details.
#

config BOARD_COMMON_BLXXXPILL
    bool

    # Clock configuration
    select BOARD_HAS_HSE
    select BOARD_HAS_LSE


source "$(RIOTBOARD)/common/stm32/Kconfig"
```

## boards/common/e104-bt50xxa-tb/Kconfig
```kconfig
# Copyright (c) 2020 Benjamin Valentin
#
# This file is subject to the terms and conditions of the GNU Lesser
# General Public License v2.1. See the file LICENSE in the top level
# directory for more details.

config BOARD_COMMON_E104_BT50XXA_TB
    bool
    select BOARD_COMMON_NRF52

source "$(RIOTBOARD)/common/nrf52/Kconfig"
```

## boards/common/esp32/Kconfig
```kconfig
# SPDX-FileCopyrightText: 2020 HAW Hamburg
# SPDX-License-Identifier: LGPL-2.1-only

config BOARD_COMMON_ESP32
    bool
    select BOARD_COMMON_ESP32X

source "$(RIOTBOARD)/common/esp32x/Kconfig"
```

## boards/common/esp32c3/Kconfig
```kconfig
# Copyright (c) 2020 HAW Hamburg
#               2022 Gunar Schorcht
#
# This file is subject to the terms and conditions of the GNU Lesser
# General Public License v2.1. See the file LICENSE in the top level
# directory for more details.

config BOARD_COMMON_ESP32C3
    bool
    select BOARD_COMMON_ESP32X

config MODULE_BOARDS_COMMON_ESP32C3
    bool
    depends on TEST_KCONFIG
    depends on BOARD_COMMON_ESP32C3
    depends on HAS_ARCH_ESP32
    default y
    help
      Common ESP32-C3 boards code.

source "$(RIOTBOARD)/common/esp32x/Kconfig"
```

## boards/common/esp32h2/Kconfig
```kconfig
# SPDX-FileCopyrightText: 2025 Gunar Schorcht
# SPDX-License-Identifier: LGPL-2.1-only

config BOARD_COMMON_ESP32H2
    bool
    select BOARD_COMMON_ESP32X

source "$(RIOTBOARD)/common/esp32x/Kconfig"
```

## boards/common/esp32s2/Kconfig
```kconfig
# Copyright (c) 2020 HAW Hamburg
#               2022 Gunar Schorcht
#
# This file is subject to the terms and conditions of the GNU Lesser
# General Public License v2.1. See the file LICENSE in the top level
# directory for more details.

config BOARD_COMMON_ESP32S2
    bool
    select BOARD_COMMON_ESP32X

source "$(RIOTBOARD)/common/esp32x/Kconfig"
```

## boards/common/esp32s3/Kconfig
```kconfig
# SPDX-FileCopyrightText: 2020 HAW Hamburg
# SPDX-FileCopyrightText: 2022 Gunar Schorcht
# SPDX-License-Identifier: LGPL-2.1-only

config BOARD_COMMON_ESP32S3
    bool
    select BOARD_COMMON_ESP32X

source "$(RIOTBOARD)/common/esp32x/Kconfig"
```

## boards/common/esp32x/Kconfig
```kconfig
# SPDX-FileCopyrightText: 2020 HAW Hamburg
# SPDX-License-Identifier: LGPL-2.1-only

config BOARD_COMMON_ESP32X
    bool
```

## boards/common/esp8266/Kconfig
```kconfig
# Copyright (c) 2020 HAW Hamburg
#
# This file is subject to the terms and conditions of the GNU Lesser
# General Public License v2.1. See the file LICENSE in the top level
# directory for more details.

config BOARD_COMMON_ESP8266
    bool
    select HAS_ARDUINO
    select HAS_PERIPH_ADC
    select HAS_PERIPH_I2C
    select HAS_PERIPH_PWM
    select HAS_PERIPH_SPI
    select HAS_PERIPH_UART

    select HAVE_SAUL_GPIO

config MODULE_BOARDS_COMMON_ESP8266
    bool
    depends on TEST_KCONFIG
    depends on HAS_ARCH_ESP8266
    depends on BOARD_COMMON_ESP8266
    default y
    help
      Common ESP8266 boards code.
```

## boards/common/gd32v/Kconfig
```kconfig
# SPDX-FileCopyrightText: 2023 Gunar Schorcht
# SPDX-License-Identifier: LGPL-2.1-only

config BOARD_HAS_HXTAL
    bool
    help
        Indicates that the board is providing an HXTAL oscillator

config BOARD_HAS_LXTAL
    bool
    help
        Indicates that the board is providing an LXTAL oscillator

config CLOCK_HXTAL
    int
    default 8000000
```

## boards/common/iotlab/Kconfig
```kconfig
# Copyright (c) 2020 Inria
#
# This file is subject to the terms and conditions of the GNU Lesser
# General Public License v2.1. See the file LICENSE in the top level
# directory for more details.
#

config BOARD_COMMON_IOTLAB
    bool
    select CPU_MODEL_STM32F103RE

    # Clock configuration
    select BOARD_HAS_HSE
    select BOARD_HAS_LSE

config CLOCK_HSE
    default 16000000

source "$(RIOTBOARD)/common/stm32/Kconfig"
```
