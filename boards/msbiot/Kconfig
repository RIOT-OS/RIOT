## boards/msbiot/Kconfig
```kconfig
# Copyright (c) 2020 Inria
#
# This file is subject to the terms and conditions of the GNU Lesser
# General Public License v2.1. See the file LICENSE in the top level
# directory for more details.
#

config BOARD
    default "msbiot" if BOARD_MSBIOT

config BOARD_MSBIOT
    bool
    default y
    select CPU_MODEL_STM32F415RG

    # Clock configuration
    select BOARD_HAS_HSE
    select BOARD_HAS_LSE

config CLOCK_HSE
    default 16000000

config CLOCK_PLL_M
    default 16

config CLOCK_PLL_N
    default 336 if USEMODULE_PERIPH_USBDEV
    default 360


source "$(RIOTBOARD)/common/stm32/Kconfig"
```

## boards/mulle/Kconfig
```kconfig
# SPDX-FileCopyrightText: 2020 HAW Hamburg
# SPDX-License-Identifier: LGPL-2.1-only

config BOARD
    default "mulle" if BOARD_MULLE

config BOARD_MULLE
    bool
    default y
    select CPU_MODEL_MK60DN512VLL10
```

## boards/native/Kconfig
```kconfig
# Copyright (c) 2020 HAW Hamburg
#
# This file is subject to the terms and conditions of the GNU Lesser
# General Public License v2.1. See the file LICENSE in the top level
# directory for more details.
#

config BOARD
    default "native" if BOARD_NATIVE

config BOARD_NATIVE
    bool
    default y
    select CPU_MODEL_NATIVE

    # Put defined MCU peripherals here (in alphabetical order)
    select HAS_PERIPH_RTC
    select HAS_PERIPH_RTC_MS
    select HAS_PERIPH_TIMER
    select HAS_PERIPH_UART
    select HAS_PERIPH_GPIO
    select HAS_PERIPH_PWM
    select HAS_PERIPH_QDEC

    # Various other features (if any)
    select HAS_ETHERNET
    select HAS_MOTOR_DRIVER
    select HAVE_SDL

    # This will always select littlefs2 but we would prefer to use something
    # that is already selected if possible...
    # Restructuring is needed in order to make that happen without circular
    # dependencies.
    select MODULE_LITTLEFS2 if MODULE_VFS_DEFAULT
    select MODULE_MTD if MODULE_VFS_DEFAULT

rsource "drivers/Kconfig"
```

## boards/native/drivers/Kconfig
```kconfig
# Copyright (c) 2020 HAW Hamburg
#
# This file is subject to the terms and conditions of the GNU Lesser
# General Public License v2.1. See the file LICENSE in the top level
# directory for more details.
#

config MODULE_NATIVE_DRIVERS
    bool
    depends on BOARD_NATIVE
    depends on TEST_KCONFIG
    default y
    help
        Drivers for Native board.
```

## boards/native32/Kconfig
```kconfig
# SPDX-FileCopyrightText: 2020 HAW Hamburg
# SPDX-License-Identifier: LGPL-2.1-only

config BOARD
    default "native32" if BOARD_NATIVE32

config BOARD_NATIVE32
    bool
    default y
    select CPU_MODEL_NATIVE
```

## boards/native64/Kconfig
```kconfig
# SPDX-FileCopyrightText: 2020 HAW Hamburg
# SPDX-License-Identifier: LGPL-2.1-only

config BOARD
    default "native64" if BOARD_NATIVE64

config BOARD_NATIVE64
    bool
    default y
    select CPU_MODEL_NATIVE
```

## boards/nrf51dk/Kconfig
```kconfig
# Copyright (c) 2020 HAW Hamburg
#
# This file is subject to the terms and conditions of the GNU Lesser
# General Public License v2.1. See the file LICENSE in the top level
# directory for more details.

config BOARD
    default "nrf51dk" if BOARD_NRF51DK

config BOARD_NRF51DK
    bool
    default y
    select BOARD_COMMON_NRF51
    select CPU_MODEL_NRF51X22XXAC

source "$(RIOTBOARD)/common/nrf51/Kconfig"
```

## boards/nrf51dongle/Kconfig
```kconfig
# SPDX-FileCopyrightText: 2020 HAW Hamburg
# SPDX-License-Identifier: LGPL-2.1-only

config BOARD
    default "nrf51dongle" if BOARD_NRF51DONGLE

config BOARD_NRF51DONGLE
    bool
    default y
    select BOARD_COMMON_NRF51
    select CPU_MODEL_NRF51X22XXAB

source "$(RIOTBOARD)/common/nrf51/Kconfig"
```

## boards/nrf52832-mdk/Kconfig
```kconfig
# SPDX-FileCopyrightText: 2020 HAW Hamburg
# SPDX-License-Identifier: LGPL-2.1-only

config BOARD
    default "nrf52832-mdk" if BOARD_NRF52832_MDK

config BOARD_NRF52832_MDK
    bool
    default y
    select BOARD_COMMON_NRF52
    select CPU_MODEL_NRF52832XXAA

source "$(RIOTBOARD)/common/nrf52/Kconfig"
```

## boards/nrf52840-mdk-dongle/Kconfig
```kconfig
# SPDX-FileCopyrightText: 2020 HAW Hamburg
# SPDX-License-Identifier: LGPL-2.1-only

config BOARD
    default "nrf52840-mdk-dongle" if BOARD_NRF52840_MDK_DONGLE

config BOARD_NRF52840_MDK_DONGLE
    bool
    default y
    select BOARD_COMMON_NRF52
    select CPU_MODEL_NRF52840XXAA

source "$(RIOTBOARD)/common/nrf52/Kconfig"
```

## boards/nrf52840-mdk/Kconfig
```kconfig
# SPDX-FileCopyrightText: 2020 HAW Hamburg
# SPDX-License-Identifier: LGPL-2.1-only

config BOARD
    default "nrf52840-mdk" if BOARD_NRF52840_MDK

config BOARD_NRF52840_MDK
    bool
    default y
    select CPU_MODEL_NRF52840XXAA
    select BOARD_COMMON_NRF52

source "$(RIOTBOARD)/common/nrf52/Kconfig"
```

## boards/nrf52840dongle/Kconfig
```kconfig
# SPDX-FileCopyrightText: 2020 HAW Hamburg
# SPDX-License-Identifier: LGPL-2.1-only

config BOARD
    default "nrf52840dongle" if BOARD_NRF52840DONGLE

config BOARD_NRF52840DONGLE
    bool
    default y
    select BOARD_COMMON_NRF52
    select CPU_MODEL_NRF52840XXAA

source "$(RIOTBOARD)/common/nrf52/Kconfig"
```

## boards/nrf52dk/Kconfig
```kconfig
# SPDX-FileCopyrightText: 2020 HAW Hamburg
# SPDX-License-Identifier: LGPL-2.1-only

config BOARD
    default "nrf52dk" if BOARD_NRF52DK

config BOARD_NRF52DK
    bool
    default y
    select BOARDS_COMMON_NRF52XXXDK
    select CPU_MODEL_NRF52832XXAA

source "$(RIOTBOARD)/common/nrf52xxxdk/Kconfig"
```

## boards/nrf5340dk-app/Kconfig
```kconfig
# Copyright (c) 2023 Mesotic SAS
#
# This file is subject to the terms and conditions of the GNU Lesser
# General Public License v2.1. See the file LICENSE in the top level
# directory for more details.

config BOARD
    default "nrf5340dk-app" if BOARD_NRF5340DK_APP

config BOARD_NRF5340DK_APP
    bool
    default y
    select CPU_MODEL_NRF5340_APP

    # Put other features for this board (in alphabetical order)
```

## boards/nrf54l15dk/Kconfig
```kconfig
# SPDX-FileCopyrightText: 2026 Inria
# SPDX-License-Identifier: LGPL-2.1-only

config BOARD
    default "nrf54l15dk" if BOARD_NRF54L15DK

config BOARD_NRF54L15DK
    bool
    default y
    select CPU_MODEL_NRF54L15XXAA

    # Put other features for this board (in alphabetical order)
```

## boards/nrf6310/Kconfig
```kconfig
# Copyright (c) 2020 HAW Hamburg
#
# This file is subject to the terms and conditions of the GNU Lesser
# General Public License v2.1. See the file LICENSE in the top level
# directory for more details.

config BOARD
    default "nrf6310" if BOARD_NRF6310

config BOARD_NRF6310
    bool
    default y
    select BOARD_COMMON_NRF51
    select CPU_MODEL_NRF51X22XXAA

source "$(RIOTBOARD)/common/nrf51/Kconfig"
```

## boards/nrf9160dk/Kconfig
```kconfig
# SPDX-FileCopyrightText: 2021 Mesotic SAS
# SPDX-License-Identifier: LGPL-2.1-only

config BOARD
    default "nrf9160dk" if BOARD_NRF9160DK

config BOARD_NRF9160DK
    bool
    default y
    select CPU_MODEL_NRF9160
```

## boards/nucleo-c031c6/Kconfig
```kconfig
# Copyright (C) 2024 BISSELL Homecare, Inc.
#
# This file is subject to the terms and conditions of the GNU Lesser
# General Public License v2.1. See the file LICENSE in the top level
# directory for more details.
#

config BOARD
    default "nucleo-c031c6" if BOARD_NUCLEO_C031C6

config BOARD_NUCLEO_C031C6
    bool
    default y
    select BOARD_COMMON_NUCLEO64
    select CPU_MODEL_STM32C031C6

source "$(RIOTBOARD)/common/nucleo64/Kconfig"
```

## boards/nucleo-c071rb/Kconfig
```kconfig
# SPDX-FileCopyrightText: 2024 BISSELL Homecare, Inc.
# SPDX-License-Identifier: LGPL-2.1-only

config BOARD
    default "nucleo-c071rb" if BOARD_NUCLEO_C071RB

config BOARD_NUCLEO_C071RB
    bool
    default y
    select BOARD_COMMON_NUCLEO64
    select CPU_MODEL_STM32C071RB

source "$(RIOTBOARD)/common/nucleo64/Kconfig"
```

## boards/nucleo-f030r8/Kconfig
```kconfig
# Copyright (c) 2020 Inria
#
# This file is subject to the terms and conditions of the GNU Lesser
# General Public License v2.1. See the file LICENSE in the top level
# directory for more details.
#

config BOARD
    default "nucleo-f030r8" if BOARD_NUCLEO_F030R8

config BOARD_NUCLEO_F030R8
    bool
    default y
    select BOARD_COMMON_NUCLEO64
    select CPU_MODEL_STM32F030R8

source "$(RIOTBOARD)/common/nucleo64/Kconfig"
```

## boards/nucleo-f031k6/Kconfig
```kconfig
# SPDX-FileCopyrightText: 2020 Inria
# SPDX-License-Identifier: LGPL-2.1-only

config BOARD
    default "nucleo-f031k6" if BOARD_NUCLEO_F031K6

config BOARD_NUCLEO_F031K6
    bool
    default y
    select BOARD_COMMON_NUCLEO32
    select CPU_MODEL_STM32F031K6

source "$(RIOTBOARD)/common/nucleo32/Kconfig"
```

## boards/nucleo-f042k6/Kconfig
```kconfig
# Copyright (c) 2020 Inria
#
# This file is subject to the terms and conditions of the GNU Lesser
# General Public License v2.1. See the file LICENSE in the top level
# directory for more details.
#

config BOARD
    default "nucleo-f042k6" if BOARD_NUCLEO_F042K6

config BOARD_NUCLEO_F042K6
    bool
    default y
    select BOARD_COMMON_NUCLEO32
    select CPU_MODEL_STM32F042K6

source "$(RIOTBOARD)/common/nucleo32/Kconfig"
```

## boards/nucleo-f070rb/Kconfig
```kconfig
# SPDX-FileCopyrightText: 2020 Inria
# SPDX-License-Identifier: LGPL-2.1-only

config BOARD
    default "nucleo-f070rb" if BOARD_NUCLEO_F070RB

config BOARD_NUCLEO_F070RB
    bool
    default y
    select BOARD_COMMON_NUCLEO64
    select CPU_MODEL_STM32F070RB

source "$(RIOTBOARD)/common/nucleo64/Kconfig"
```

## boards/nucleo-f072rb/Kconfig
```kconfig
# SPDX-FileCopyrightText: 2020 Inria
# SPDX-License-Identifier: LGPL-2.1-only

config BOARD
    default "nucleo-f072rb" if BOARD_NUCLEO_F072RB

config BOARD_NUCLEO_F072RB
    bool
    default y
    select BOARD_COMMON_NUCLEO64
    select CPU_MODEL_STM32F072RB

source "$(RIOTBOARD)/common/nucleo64/Kconfig"
```

## boards/nucleo-f091rc/Kconfig
```kconfig
# SPDX-FileCopyrightText: 2020 Inria
# SPDX-License-Identifier: LGPL-2.1-only

config BOARD
    default "nucleo-f091rc" if BOARD_NUCLEO_F091RC

config BOARD_NUCLEO_F091RC
    bool
    default y
    select BOARD_COMMON_NUCLEO64
    select CPU_MODEL_STM32F091RC

source "$(RIOTBOARD)/common/nucleo64/Kconfig"
```
