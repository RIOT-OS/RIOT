## boards/arduino-nano/Kconfig
```kconfig
# SPDX-FileCopyrightText: 2020 HAW Hamburg
# SPDX-License-Identifier: LGPL-2.1-only

config BOARD_ARDUINO_NANO
    bool
    default y
    select BOARD_COMMON_ARDUINO_ATMEGA
    select CPU_MODEL_ATMEGA328P

config BOARD
    default "arduino-nano" if BOARD_ARDUINO_NANO

source "$(RIOTBOARD)/common/arduino-atmega/Kconfig"
```

## boards/arduino-uno/Kconfig
```kconfig
# SPDX-FileCopyrightText: 2020 HAW Hamburg
# SPDX-License-Identifier: LGPL-2.1-only

config BOARD_ARDUINO_UNO
    bool
    default y
    select CPU_MODEL_ATMEGA328P
    select BOARD_COMMON_ARDUINO_ATMEGA

config BOARD
    default "arduino-uno" if BOARD_ARDUINO_UNO

source "$(RIOTBOARD)/common/arduino-atmega/Kconfig"
```

## boards/arduino-zero/Kconfig
```kconfig
# SPDX-FileCopyrightText: 2020 HAW Hamburg
# SPDX-License-Identifier: LGPL-2.1-only

config BOARD
    default "arduino-zero" if BOARD_ARDUINO_ZERO

config BOARD_ARDUINO_ZERO
    bool
    default y
    select BOARD_COMMON_ARDUINO_ZERO

source "$(RIOTBOARD)/common/arduino-zero/Kconfig"
```

## boards/atmega1284p/Kconfig
```kconfig
# SPDX-FileCopyrightText: 2020 HAW Hamburg
# SPDX-License-Identifier: LGPL-2.1-only

config BOARD
    default "atmega1284p" if BOARD_ATMEGA1284P

config BOARD_ATMEGA1284P
    bool
    default y
    select CPU_MODEL_ATMEGA1284P
```

## boards/atmega256rfr2-xpro/Kconfig
```kconfig
# SPDX-FileCopyrightText: 2020 HAW Hamburg
# SPDX-License-Identifier: LGPL-2.1-only

config BOARD
    default "atmega256rfr2-xpro" if BOARD_ATMEGA256RFR2_XPRO

config BOARD_ATMEGA256RFR2_XPRO
    bool
    default y
    select CPU_MODEL_ATMEGA256RFR2
```

## boards/atmega328p-xplained-mini/Kconfig
```kconfig
# SPDX-FileCopyrightText: 2020 HAW Hamburg
# SPDX-FileCopyrightText: 2021-2023 Gerson Fernando Budke
# SPDX-License-Identifier: LGPL-2.1-only

config BOARD
    default "atmega328p-xplained-mini" if BOARD_ATMEGA328P_XPLAINED_MINI

config BOARD_ATMEGA328P_XPLAINED_MINI
    bool
    default y
    select CPU_MODEL_ATMEGA328P
```

## boards/atmega328p/Kconfig
```kconfig
# SPDX-FileCopyrightText: 2020 HAW Hamburg
# SPDX-License-Identifier: LGPL-2.1-only

config BOARD
    default "atmega328p" if BOARD_ATMEGA328P

config BOARD_ATMEGA328P
    bool
    default y
    select CPU_MODEL_ATMEGA328P
```

## boards/atmega8/Kconfig
```kconfig
# SPDX-FileCopyrightText: 2020 HAW Hamburg
# SPDX-License-Identifier: LGPL-2.1-only

config BOARD
    default "atmega8" if BOARD_ATMEGA8

config BOARD_ATMEGA8
    bool
    default y
    select CPU_MODEL_ATMEGA8
```

## boards/atxmega-a1-xplained/Kconfig
```kconfig
# SPDX-FileCopyrightText: 2020 HAW Hamburg
# SPDX-FileCopyrightText: 2021 Gerson Fernando Budke
# SPDX-License-Identifier: LGPL-2.1-only

config BOARD
    default "atxmega-a1-xplained" if BOARD_ATXMEGA_A1_XPLAINED

config BOARD_ATXMEGA_A1_XPLAINED
    bool
    default y
    select CPU_MODEL_XMEGA128A1
```

## boards/atxmega-a1u-xpro/Kconfig
```kconfig
# SPDX-FileCopyrightText: 2020 HAW Hamburg
# SPDX-FileCopyrightText: 2021 Gerson Fernando Budke
# SPDX-License-Identifier: LGPL-2.1-only

config BOARD
    default "atxmega-a1u-xpro" if BOARD_ATXMEGA_A1U_XPRO

config BOARD_ATXMEGA_A1U_XPRO
    bool
    default y
    select CPU_MODEL_XMEGA128A1U
```

## boards/atxmega-a3bu-xplained/Kconfig
```kconfig
# Copyright (c) 2020 HAW Hamburg
# Copyright (c) 2021 Gerson Fernando Budle
#
# This file is subject to the terms and conditions of the GNU Lesser
# General Public License v2.1. See the file LICENSE in the top level
# directory for more details.

config BOARD
    default "atxmega-a3bu-xplained" if BOARD_ATXMEGA_A3BU_XPLAINED

config BOARD_ATXMEGA_A3BU_XPLAINED
    bool
    default y
    select CPU_MODEL_XMEGA256A3BU

    select HAS_PERIPH_I2C
    select HAS_PERIPH_SPI
    select HAS_PERIPH_UART

    select HAVE_SAUL_GPIO
```

## boards/avr-rss2/Kconfig
```kconfig
# SPDX-FileCopyrightText: 2020 HAW Hamburg
# SPDX-License-Identifier: LGPL-2.1-only

config BOARD
    default "avr-rss2" if BOARD_AVR_RSS2

config BOARD_AVR_RSS2
    bool
    default y
    select CPU_MODEL_ATMEGA256RFR2
```

## boards/avsextrem/Kconfig
```kconfig
# SPDX-FileCopyrightText: 2020 HAW Hamburg
# SPDX-License-Identifier: LGPL-2.1-only

config BOARD
    default "avsextrem" if BOARD_AVSEXTREM

config BOARD_AVSEXTREM
    bool
    default y
    select CPU_MODEL_LPC2387
```

## boards/b-l072z-lrwan1/Kconfig
```kconfig
# SPDX-FileCopyrightText: 2020 Inria
# SPDX-License-Identifier: LGPL-2.1-only

config BOARD
    default "b-l072z-lrwan1" if BOARD_B_L072Z_LRWAN1

config BOARD_B_L072Z_LRWAN1
    bool
    default y
    select CPU_MODEL_STM32L072CZ

    # Clock configuration
    select BOARD_HAS_LSE

source "$(RIOTBOARD)/common/stm32/Kconfig"
```

## boards/b-l475e-iot01a/Kconfig
```kconfig
# SPDX-FileCopyrightText: 2020 Inria
# SPDX-License-Identifier: LGPL-2.1-only

config BOARD
    default "b-l475e-iot01a" if BOARD_B_L475E_IOT01A

config BOARD_B_L475E_IOT01A
    bool
    default y
    select CPU_MODEL_STM32L475VG

    # Clock configuration
    select BOARD_HAS_LSE

source "$(RIOTBOARD)/common/stm32/Kconfig"
```

## boards/b-u585i-iot02a/Kconfig
```kconfig
# SPDX-FileCopyrightText: 2021 Inria
# SPDX-License-Identifier: LGPL-2.1-only

config BOARD
    default "b-u585i-iot02a" if BOARD_B_U585I_IOT02A

config BOARD_B_U585I_IOT02A
    bool
    default y
    select CPU_MODEL_STM32U585AI

    # Clock configuration
    select BOARD_HAS_LSE

source "$(RIOTBOARD)/common/stm32/Kconfig"
```

## boards/banglejs-2/Kconfig
```kconfig
# Copyright (c) 2022 Nicole Faerber, Siegen, Germany
#
# This file is subject to the terms and conditions of the GNU Lesser
# General Public License v2.1. See the file LICENSE in the top level
# directory for more details.

config BOARD
    default "banglejs2" if BOARD_BANGLEJS2

config BOARD_BANGLEJS2
    bool
    default y
    select BOARD_COMMON_NRF52
    select CPU_MODEL_NRF52840XXAA
    select HAS_PERIPH_I2C
    select HAS_PERIPH_SPI
    select HAS_PERIPH_UART
    select HAS_PERIPH_PWM
    select HAS_VDD_LC_FILTER_REG1
    select HAVE_CST816S
    select HAVE_LPM013M126
    select HAVE_MTD_SPI_NOR
    select HAVE_BMP280_I2C

source "$(RIOTBOARD)/common/nrf52/Kconfig"
```

## boards/bastwan/Kconfig
```kconfig
# Copyright (c) 2020 HAW Hamburg
#
# This file is subject to the terms and conditions of the GNU Lesser
# General Public License v2.1. See the file LICENSE in the top level
# directory for more details.

config BOARD
    default "bastwan" if BOARD_BASTWAN

config BOARD_BASTWAN
    bool
    default y
    select CPU_MODEL_SAMR34J18B
```

## boards/bitcraze-crazyflie21-main/Kconfig
```kconfig
# SPDX-FileCopyrightText: 2025 TU Dresden
# SPDX-License-Identifier: LGPL-2.1-only

config BOARD
    default "bitcraze-crazyflie21-main" if BOARD_BITCRAZE_CRAZYFLIE21_MAIN

config BOARD_BITCRAZE_CRAZYFLIE21_MAIN
    bool
    default y
    select CPU_MODEL_STM32F405RG

    # Clock configuration
    select BOARD_HAS_HSE
    select BOARD_HAS_LSE

config CLOCK_HSE
    default 8000000

config CLOCK_PLL_M
    default 8

config CLOCK_PLL_N
    default 336 if USEMODULE_PERIPH_USBDEV_CLK
    default 360

source "$(RIOTBOARD)/common/stm32/Kconfig"
```

## boards/blackpill-128kib/Kconfig
```kconfig
# Copyright (c) 2020 Inria
#
# This file is subject to the terms and conditions of the GNU Lesser
# General Public License v2.1. See the file LICENSE in the top level
# directory for more details.
#

config BOARD
    default "blackpill-128kib" if BOARD_BLACKPILL_128KIB

config BOARD_BLACKPILL_128KIB
    bool
    default y
    select BOARD_COMMON_BLXXXPILL
    select CPU_MODEL_STM32F103CB
    select MODULE_BOARDS_COMMON_BLXXXPILL if TEST_KCONFIG

    select HAS_HIGHLEVEL_STDIO

# HACK: This is added due to the make resolution
# make will select timer backend, probably due to the USBUS
# and kconfig cannot select if something is already selected like make
choice ZTIMER_MSEC_BACKEND
    default ZTIMER_MSEC_BACKEND_TIMER if MODULE_PERIPH_RTC
endchoice

source "$(RIOTBOARD)/common/blxxxpill/Kconfig"
```

## boards/blackpill-stm32f103cb/Kconfig
```kconfig
# SPDX-FileCopyrightText: 2020 Inria
# SPDX-License-Identifier: LGPL-2.1-only

config BOARD
    default "blackpill-stm32f103cb" if BOARD_BLACKPILL_STM32F103CB

config BOARD_BLACKPILL_STM32F103CB
    bool
    default y
    select BOARD_COMMON_BLXXXPILL
    select CPU_MODEL_STM32F103CB

source "$(RIOTBOARD)/common/blxxxpill/Kconfig"
```

## boards/blackpill/Kconfig
```kconfig
# Copyright (c) 2020 Inria
#
# This file is subject to the terms and conditions of the GNU Lesser
# General Public License v2.1. See the file LICENSE in the top level
# directory for more details.
#

config BOARD
    default "blackpill" if BOARD_BLACKPILL

config BOARD_BLACKPILL
    bool
    default y
    select BOARD_COMMON_BLXXXPILL
    select CPU_MODEL_STM32F103C8
    select MODULE_BOARDS_COMMON_BLXXXPILL if TEST_KCONFIG

source "$(RIOTBOARD)/common/blxxxpill/Kconfig"
```

## boards/bluepill-stm32f030c8/Kconfig
```kconfig
# SPDX-FileCopyrightText: 2020 Benjamin Valentin
# SPDX-License-Identifier: LGPL-2.1-only

config BOARD
    default "bluepill-stm32f030c8" if BOARD_BLUEPILL_STM32F030C8

config BOARD_BLUEPILL_STM32F030C8
    bool
    default y
    select CPU_MODEL_STM32F030C8
```

## boards/bluepill-stm32f103c8/Kconfig
```kconfig
# SPDX-FileCopyrightText: 2020 Inria
# SPDX-License-Identifier: LGPL-2.1-only

config BOARD
    default "bluepill-stm32f103c8" if BOARD_BLUEPILL_STM32F103C8

config BOARD_BLUEPILL_STM32F103C8
    bool
    default y
    select BOARD_COMMON_BLXXXPILL
    select CPU_MODEL_STM32F103C8

source "$(RIOTBOARD)/common/blxxxpill/Kconfig"
```

## boards/calliope-mini/Kconfig
```kconfig
# SPDX-FileCopyrightText: 2020 HAW Hamburg
# SPDX-License-Identifier: LGPL-2.1-only

config BOARD
    default "calliope-mini" if BOARD_CALLIOPE_MINI

config BOARD_CALLIOPE_MINI
    bool
    default y
    select BOARD_COMMON_NRF51
    select CPU_MODEL_NRF51X22XXAB

source "$(RIOTBOARD)/common/nrf51/Kconfig"
```
