## boards/p-nucleo-wb55/Kconfig
```kconfig
# SPDX-FileCopyrightText: 2020 Inria
# SPDX-License-Identifier: LGPL-2.1-only

config BOARD
    default "p-nucleo-wb55" if BOARD_P_NUCLEO_WB55

config BOARD_P_NUCLEO_WB55
    bool
    default y
    select CPU_MODEL_STM32WB55RG

    # Clock configuration
    select BOARD_HAS_HSE
    select BOARD_HAS_LSE

config CLOCK_HSE
    default 32000000

source "$(RIOTBOARD)/common/nucleo/Kconfig"
```

## boards/pba-d-01-kw2x/Kconfig
```kconfig
# SPDX-FileCopyrightText: 2020 HAW Hamburg
# SPDX-License-Identifier: LGPL-2.1-only

config BOARD
    default "pba-d-01-kw2x" if BOARD_PBA_D_01_KW2X

config BOARD_PBA_D_01_KW2X
    bool
    default y
    select CPU_MODEL_MKW21D256VHA5
```

## boards/phynode-kw41z/Kconfig
```kconfig
# Copyright (c) 2020 HAW Hamburg
#
# This file is subject to the terms and conditions of the GNU Lesser
# General Public License v2.1. See the file LICENSE in the top level
# directory for more details.

config BOARD
    default "phynode-kw41z" if BOARD_PHYNODE_KW41Z

config BOARD_PHYNODE_KW41Z
    bool
    default y
    select BOARD_COMMON_KW41Z

source "$(RIOTBOARD)/common/kw41z/Kconfig"
```

## boards/pic32-wifire/Kconfig
```kconfig
# Copyright (c) 2020 HAW Hamburg
#
# This file is subject to the terms and conditions of the GNU Lesser
# General Public License v2.1. See the file LICENSE in the top level
# directory for more details.

config BOARD
    default "pic32-wifire" if BOARD_PIC32_WIFIRE

config BOARD_PIC32_WIFIRE
    bool
    default y
    select CPU_MODEL_P32MZ2048EFG100
    select HAS_PERIPH_TIMER
    select HAS_PERIPH_UART
```

## boards/pinetime/Kconfig
```kconfig
# SPDX-FileCopyrightText: 2020 HAW Hamburg
# SPDX-License-Identifier: LGPL-2.1-only

config BOARD
    default "pinetime" if BOARD_PINETIME

config BOARD_PINETIME
    bool
    default y
    select BOARD_COMMON_NRF52
    select CPU_MODEL_NRF52832XXAA

source "$(RIOTBOARD)/common/nrf52/Kconfig"
```

## boards/pro-micro-nrf52840/Kconfig
```kconfig
# SPDX-FileCopyrightText: 2026 Bas Stottelaar <basstottelaar@gmail.com>
# SPDX-License-Identifier: LGPL-2.1-only

config BOARD
    default "pro-micro-nrf52840" if BOARD_PRO_MICRO_NRF52840

config BOARD_PRO_MICRO_NRF52840
    bool
    default y
    select BOARD_COMMON_NRF52
    select CPU_MODEL_NRF52840XXAA

source "$(RIOTBOARD)/common/nrf52/Kconfig"
```

## boards/pulga/Kconfig
```kconfig
# Copyright (c) 2020 HAW Hamburg
#
# This file is subject to the terms and conditions of the GNU Lesser
# General Public License v2.1. See the file LICENSE in the top level
# directory for more details.

config BOARD
    default "pulga" if BOARD_PULGA

config BOARD_PULGA
    bool
    default y
    select HAS_PERIPH_I2C
    select HAS_PERIPH_PWM
    select HAS_PERIPH_SPI
    select HAS_PERIPH_UART
    select CPU_MODEL_NRF52840XXAA

source "$(RIOTBOARD)/common/nrf52/Kconfig"
```

## boards/pyboard/Kconfig
```kconfig
# Copyright (c) 2020 Inria
#
# This file is subject to the terms and conditions of the GNU Lesser
# General Public License v2.1. See the file LICENSE in the top level
# directory for more details.
#

config BOARD
    default "pyboard" if BOARD_PYBOARD

config BOARD_PYBOARD
    bool
    default y
    select CPU_MODEL_STM32F405RG

    # Clock configuration
    select BOARD_HAS_HSE
    select BOARD_HAS_LSE

config CLOCK_HSE
    default 12000000

config CLOCK_PLL_M
    default 12

config CLOCK_PLL_N
    default 336 if USEMODULE_PERIPH_USBDEV_CLK
    default 360


source "$(RIOTBOARD)/common/stm32/Kconfig"
```

## boards/qn9080dk/Kconfig
```kconfig
# Copyright (c) 2020 iosabi
#
# This file is subject to the terms and conditions of the GNU Lesser
# General Public License v2.1. See the file LICENSE in the top level
# directory for more details.
#

config BOARD
    default "qn9080dk" if BOARD_QN9080DK

config BOARD_QN9080DK
    bool
    default y
    select BOARD_COMMON_QN908X
    select CPU_MODEL_QN9080XHN

    # Put defined MCU peripherals here (in alphabetical order)
    select BOARD_HAS_XTAL32K
    select BOARD_HAS_XTAL_32M

source "$(RIOTBOARD)/common/qn908x/Kconfig"
```

## boards/raspberry-pi-pico/Kconfig
```kconfig
# Copyright (c) 2021 Ishraq Ibne Ashraf
#
# This file is subject to the terms and conditions of the GNU Lesser
# General Public License v2.1. See the file LICENSE in the top level
# directory for more details.

config BOARD
    default "raspberry-pi-pico" if BOARD_RASPBERRY_PI_PICO

config BOARD_RASPBERRY_PI_PICO
    bool
    default y
    select RP2040

    # Put defined MCU peripherals here (in alphabetical order)

    # Put other features for this board (in alphabetical order)
```

## boards/raspberrypi-pico/Kconfig
```kconfig
# Copyright (c) 2021 Ishraq Ibne Ashraf
#
# This file is subject to the terms and conditions of the GNU Lesser
# General Public License v2.1. See the file LICENSE in the top level
# directory for more details.

config BOARD
    default "raspberrypi-pico" if BOARD_RASPBERRYPI_PICO

config BOARD_RASPBERRYPI_PICO
    bool
    default y
    select RP2040

    # Put defined MCU peripherals here (in alphabetical order)

    # Put other features for this board (in alphabetical order)
```

## boards/reel/Kconfig
```kconfig
# SPDX-FileCopyrightText: 2020 HAW Hamburg
# SPDX-License-Identifier: LGPL-2.1-only

config BOARD
    default "reel" if BOARD_REEL

config BOARD_REEL
    bool
    default y
    select BOARD_COMMON_NRF52
    select CPU_MODEL_NRF52840XXAA

source "$(RIOTBOARD)/common/nrf52/Kconfig"
```

## boards/remote-pa/Kconfig
```kconfig
# SPDX-FileCopyrightText: 2020 HAW Hamburg
# SPDX-License-Identifier: LGPL-2.1-only

config BOARD
    default "remote-pa" if BOARD_REMOTE_PA

config BOARD_REMOTE_PA
    bool
    default y
    select BOARD_COMMON_REMOTE

source "$(RIOTBOARD)/common/remote/Kconfig"
```

## boards/remote-reva/Kconfig
```kconfig
# SPDX-FileCopyrightText: 2020 HAW Hamburg
# SPDX-License-Identifier: LGPL-2.1-only

config BOARD
    default "remote-reva" if BOARD_REMOTE_REVA

config BOARD_REMOTE_REVA
    bool
    default y
    select BOARD_COMMON_REMOTE

source "$(RIOTBOARD)/common/remote/Kconfig"
```

## boards/remote-revb/Kconfig
```kconfig
# SPDX-FileCopyrightText: 2020 HAW Hamburg
# SPDX-License-Identifier: LGPL-2.1-only

config BOARD
    default "remote-revb" if BOARD_REMOTE_REVB

config BOARD_REMOTE_REVB
    bool
    default y
    select BOARD_COMMON_REMOTE

source "$(RIOTBOARD)/common/remote/Kconfig"
```

## boards/rpi-pico-2-arm/Kconfig
```kconfig
# SPDX-FileCopyrightText: 2025 Tom Hert <git@annsann.eu>
# SPDX-FileCopyrightText: 2025 HAW Hamburg
# SPDX-License-Identifier: LGPL-2.1-only

config BOARD
    default "rpi-pico-2-arm" if BOARD_RPI_PICO_2_ARM

config BOARD_RPI_PICO_2_ARM
    bool
    default y
    select CPU_MODEL_RP2350_ARM
```

## boards/rpi-pico-2-riscv/Kconfig
```kconfig
# SPDX-FileCopyrightText: 2025 Tom Hert <git@annsann.eu>
# SPDX-FileCopyrightText: 2025 HAW Hamburg
# SPDX-License-Identifier: LGPL-2.1-only

config BOARD
    default "rpi-pico-2-riscv" if BOARD_RPI_PICO_2_RISCV

config BOARD_RPI_PICO_2_RISV
    bool
    default y
    select CPU_MODEL_RP2350_RISCV
```

## boards/rpi-pico-2/Kconfig
```kconfig
# SPDX-FileCopyrightText: 2025 Tom Hert <git@annsann.eu>
# SPDX-FileCopyrightText: 2025 HAW Hamburg
# SPDX-License-Identifier: LGPL-2.1-only

config BOARD
    default "rpi-pico-2" if BOARD_RPI_PICO_2

config BOARD_RPI_PICO_2
    bool
    default y
    select CPU_MODEL_RP2350
```

## boards/rpi-pico-w/Kconfig
```kconfig
# SPDX-FileCopyrightText: 2022 Krzyszyof Cabaj <kcabaj@gmail.com>
# SPDX-FileCopyrightText: 2021 Otto-von-Guericke-Universität Magdeburg
# SPDX-License-Identifier: LGPL-2.1-only

config BOARD
    default "rpi-pico-w" if BOARD_RPI_PICO_W

config BOARD_RPI_PICO_W
    bool
    default y
    select CPU_MODEL_RP2040

source "$(RIOTBOARD)/rpi-pico/Kconfig"
```

## boards/rpi-pico/Kconfig
```kconfig
# SPDX-FileCopyrightText: 2021 Otto-von-Guericke-Universität Magdeburg
# SPDX-License-Identifier: LGPL-2.1-only

config BOARD
    default "rpi-pico" if BOARD_RPI_PICO

config BOARD_RPI_PICO
    bool
    default y
    select CPU_MODEL_RP2040
```

## boards/ruuvitag/Kconfig
```kconfig
# SPDX-FileCopyrightText: 2020 HAW Hamburg
# SPDX-License-Identifier: LGPL-2.1-only

config BOARD
    default "ruuvitag" if BOARD_RUUVITAG

config BOARD_RUUVITAG
    bool
    default y
    select BOARD_COMMON_NRF52
    select CPU_MODEL_NRF52832XXAA

source "$(RIOTBOARD)/common/nrf52xxxdk/Kconfig"
```

## boards/samd10-xmini/Kconfig
```kconfig
# SPDX-FileCopyrightText: 2020 ML!PA Consulting GmbH
# SPDX-License-Identifier: LGPL-2.1-only

config BOARD
    default "samd10-xmini" if BOARD_SAMD10_XMINI

config BOARD_SAMD10_XMINI
    bool
    default y
    select CPU_MODEL_SAMD10D14AU
```

## boards/samd20-xpro/Kconfig
```kconfig
# SPDX-FileCopyrightText: 2020 HAW Hamburg
# SPDX-License-Identifier: LGPL-2.1-only

config BOARD
    default "samd20-xpro" if BOARD_SAMD20_XPRO

config BOARD_SAMD20_XPRO
    bool
    default y
    select CPU_MODEL_SAMD20J18
```

## boards/samd21-xpro/Kconfig
```kconfig
# SPDX-FileCopyrightText: 2020 HAW Hamburg
# SPDX-License-Identifier: LGPL-2.1-only

config BOARD
    default "samd21-xpro" if BOARD_SAMD21_XPRO

config BOARD_SAMD21_XPRO
    bool
    default y
    select CPU_MODEL_SAMD21J18A
```

## boards/same54-xpro/Kconfig
```kconfig
# Copyright (c) 2020 HAW Hamburg
#
# This file is subject to the terms and conditions of the GNU Lesser
# General Public License v2.1. See the file LICENSE in the top level
# directory for more details.

config BOARD
    default "same54-xpro" if BOARD_SAME54_XPRO

config BOARD_SAME54_XPRO
    bool
    default y
    select CPU_MODEL_SAME54P20A
```
