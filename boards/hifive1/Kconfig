## boards/hifive1/Kconfig
```kconfig
# SPDX-FileCopyrightText: 2020 Inria
# SPDX-License-Identifier: LGPL-2.1-only

config BOARD
    default "hifive1" if BOARD_HIFIVE1

config BOARD_HIFIVE1
    bool
    default y
    select CPU_MODEL_FE310_G000
```

## boards/hifive1b/Kconfig
```kconfig
# SPDX-FileCopyrightText: 2020 Inria
# SPDX-License-Identifier: LGPL-2.1-only

config BOARD
    default "hifive1b" if BOARD_HIFIVE1B

config BOARD_HIFIVE1B
    bool
    default y
    select CPU_MODEL_FE310_G002
```

## boards/hip-badge/Kconfig
```kconfig
# Copyright (c) 2023 Benjamin Valentin
#
# This file is subject to the terms and conditions of the GNU Lesser
# General Public License v2.1. See the file LICENSE in the top level
# directory for more details.

config BOARD
    default "hip-badge" if BOARD_HIP_BADGE

config BOARD_HIP_BADGE
    bool
    default y
    select BOARD_COMMON_ESP32C3
    select CPU_MODEL_ESP32C3

source "$(RIOTBOARD)/common/esp32c3/Kconfig"
```

## boards/i-nucleo-lrwan1/Kconfig
```kconfig
# SPDX-FileCopyrightText: 2020 Inria
# SPDX-License-Identifier: LGPL-2.1-only

config BOARD
    default "i-nucleo-lrwan1" if BOARD_I_NUCLEO_LRWAN1

config BOARD_I_NUCLEO_LRWAN1
    bool
    default y
    select CPU_MODEL_STM32L052T8

    # Clock configuration
    select BOARD_HAS_LSE

source "$(RIOTBOARD)/common/stm32/Kconfig"
```

## boards/ikea-tradfri/Kconfig
```kconfig
# SPDX-FileCopyrightText: 2020 HAW Hamburg
# SPDX-License-Identifier: LGPL-2.1-only

config BOARD
    default "ikea-tradfri" if BOARD_IKEA_TRADFRI

config BOARD_IKEA_TRADFRI
    bool
    default y
    select CPU_MODEL_EFR32MG1P132F256GM32
```

## boards/im880b/Kconfig
```kconfig
# SPDX-FileCopyrightText: 2020 Inria
# SPDX-License-Identifier: LGPL-2.1-only

config BOARD
    default "im880b" if BOARD_IM880B

config BOARD_IM880B
    bool
    default y
    select CPU_MODEL_STM32L151CB

    # Clock configuration
    select BOARD_HAS_HSE
    select BOARD_HAS_LSE

config CLOCK_HSE
    default 16000000

source "$(RIOTBOARD)/common/stm32/Kconfig"
```

## boards/imx8mqevk/Kconfig
```kconfig
# Copyright (c) 2020 Mesotic SAS
#
# This file is subject to the terms and conditions of the GNU Lesser
# General Public License v2.1. See the file LICENSE in the top level
# directory for more details.

config BOARD
    default "imx8mqevk" if BOARD_IMX8MQEVK

config BOARD_IMX8MQEVK
    bool
    default y
    select CPU_MODEL_IMX8MQ
    select HAS_PERIPH_TIMER
    select HAS_PERIPH_UART
```

## boards/infineon-cy8ckit-062s2-ai/Kconfig
```kconfig
config BOARD_INFINEON-PSOC-62
    bool
    default y
    select CPU_MODEL_CY8C624ABZI
```

## boards/iotlab-a8-m3/Kconfig
```kconfig
# Copyright (c) 2020 Inria
#
# This file is subject to the terms and conditions of the GNU Lesser
# General Public License v2.1. See the file LICENSE in the top level
# directory for more details.
#

config BOARD
    default "iotlab-a8-m3" if BOARD_IOTLAB_A8_M3

config BOARD_IOTLAB_A8_M3
    bool
    default y
    select BOARD_COMMON_IOTLAB

source "$(RIOTBOARD)/common/iotlab/Kconfig"
```

## boards/iotlab-m3/Kconfig
```kconfig
# SPDX-FileCopyrightText: 2020 Inria
# SPDX-License-Identifier: LGPL-2.1-only

config BOARD
    default "iotlab-m3" if BOARD_IOTLAB_M3

config BOARD_IOTLAB_M3
    bool
    default y
    select BOARD_COMMON_IOTLAB

source "$(RIOTBOARD)/common/iotlab/Kconfig"
```

## boards/limifrog-v1/Kconfig
```kconfig
# SPDX-FileCopyrightText: 2020 Inria
# SPDX-License-Identifier: LGPL-2.1-only

config BOARD
    default "limifrog-v1" if BOARD_LIMIFROG_V1

config BOARD_LIMIFROG_V1
    bool
    default y
    select CPU_MODEL_STM32L151RC

source "$(RIOTBOARD)/common/stm32/Kconfig"
```

## boards/lobaro-lorabox/Kconfig
```kconfig
# Copyright (c) 2020 Inria
#
# This file is subject to the terms and conditions of the GNU Lesser
# General Public License v2.1. See the file LICENSE in the top level
# directory for more details.
#

config BOARD
    default "lobaro-lorabox" if BOARD_LOBARO_LORABOX

config BOARD_LOBARO_LORABOX
    bool
    default y
    select CPU_MODEL_STM32L151CB_A

    # Clock configuration
    select BOARD_HAS_LSE

source "$(RIOTBOARD)/common/stm32/Kconfig"
```

## boards/lora-e5-dev/Kconfig
```kconfig
# Copyright (c) 2021 Inria
#
# This file is subject to the terms and conditions of the GNU Lesser
# General Public License v2.1. See the file LICENSE in the top level
# directory for more details.
#

config BOARD
    default "lora-e5-dev" if BOARD_LORA_E5_DEV

config BOARD_LORA_E5_DEV
    bool
    default y
    select CPU_MODEL_STM32WLE5JC

    # Clock configuration
    select BOARD_HAS_HSE
    select BOARD_HAS_LSE

config CLOCK_HSE
    default 32000000

config LORA_E5_DEV_ENABLE_3P3V
    bool "LoRa-E5 Development Kit - Enable 3.3V output"
    default y

config LORA_E5_DEV_ENABLE_5V
    bool "LoRa-E5 Development Kit - Enable 5V output"
    default y

source "$(RIOTBOARD)/common/stm32/Kconfig"
```

## boards/lsn50/Kconfig
```kconfig
# SPDX-FileCopyrightText: 2020 Inria
# SPDX-License-Identifier: LGPL-2.1-only

config BOARD
    default "lsn50" if BOARD_LSN50

config BOARD_LSN50
    bool
    default y
    select CPU_MODEL_STM32L072CZ

    # Clock configuration
    select BOARD_HAS_LSE

source "$(RIOTBOARD)/common/stm32/Kconfig"
```

## boards/maple-mini/Kconfig
```kconfig
# SPDX-FileCopyrightText: 2020 Inria
# SPDX-License-Identifier: LGPL-2.1-only

config BOARD
    default "maple-mini" if BOARD_MAPLE_MINI

config BOARD_MAPLE_MINI
    bool
    default y
    select CPU_MODEL_STM32F103CB

source "$(RIOTBOARD)/common/stm32/Kconfig"
```

## boards/mbed_lpc1768/Kconfig
```kconfig
# SPDX-FileCopyrightText: 2020 HAW Hamburg
# SPDX-License-Identifier: LGPL-2.1-only

config BOARD
    default "mbed_lpc1768" if BOARD_MBED_LPC1768

config BOARD_MBED_LPC1768
    bool
    default y
    select CPU_MODEL_LPC1768
```

## boards/mcb2388/Kconfig
```kconfig
# SPDX-FileCopyrightText: 2020 HAW Hamburg
# SPDX-License-Identifier: LGPL-2.1-only

config BOARD
    default "mcb2388" if BOARD_MCB2388

config BOARD_MCB2388
    bool
    default y
    select CPU_MODEL_LPC2388
```

## boards/mega-xplained/Kconfig
```kconfig
# SPDX-FileCopyrightText: 2020 HAW Hamburg
# SPDX-License-Identifier: LGPL-2.1-only

config BOARD
    default "mega-xplained" if BOARD_MEGA_XPLAINED

config BOARD_MEGA_XPLAINED
    bool
    default y
    select CPU_MODEL_ATMEGA1284P
```

## boards/microbit-v2/Kconfig
```kconfig
# Copyright (c) 2021 Inria

# This file is subject to the terms and conditions of the GNU Lesser
# General Public License v2.1. See the file LICENSE in the top level
# directory for more details.

config BOARD
    default "microbit-v2" if BOARD_MICROBIT_V2

config BOARD_MICROBIT_V2
    bool
    default y
    select BOARD_COMMON_NRF52
    select CPU_MODEL_NRF52833XXAA
    select HAS_PERIPH_I2C
    select HAS_PERIPH_PWM
    select HAS_PERIPH_SPI
    select HAS_PERIPH_UART

source "$(RIOTBOARD)/common/nrf52/Kconfig"
```

## boards/microbit/Kconfig
```kconfig
# SPDX-FileCopyrightText: 2020 HAW Hamburg
# SPDX-License-Identifier: LGPL-2.1-only

config BOARD
    default "microbit" if BOARD_MICROBIT

config BOARD_MICROBIT
    bool
    default y
    select BOARD_COMMON_NRF51
    select CPU_MODEL_NRF51X22XXAB

source "$(RIOTBOARD)/common/nrf51/Kconfig"
```

## boards/microduino-corerf/Kconfig
```kconfig
# Copyright (c) 2020 HAW Hamburg
#
# This file is subject to the terms and conditions of the GNU Lesser
# General Public License v2.1. See the file LICENSE in the top level
# directory for more details.


config BOARD
    default "microduino-corerf" if BOARD_MICRODUINO_CORERF

config BOARD_MICRODUINO_CORERF
    bool
    default y
    select CPU_MODEL_ATMEGA128RFA1
```

## boards/mpfs-icicle-kit-es/Kconfig
```kconfig
# Copyright (c) 2021 Mesotic SAS
#
# This file is subject to the terms and conditions of the GNU Lesser
# General Public License v2.1. See the file LICENSE in the top level
# directory for more details.

config BOARD
    default "mpfs-icicle-kit-es" if BOARD_MPFS_ICICLE_KIT_ES

config BOARD_MPFS_ICICLE_KIT_ES
    bool
    default y
    select CPU_MODEL_MPFS
```

## boards/msb-430/Kconfig
```kconfig
# Copyright (c) 2020 HAW Hamburg
#
# This file is subject to the terms and conditions of the GNU Lesser
# General Public License v2.1. See the file LICENSE in the top level
# directory for more details.
#

config BOARD
    default "msb-430" if BOARD_MSB_430

config BOARD_MSB_430
    bool
    default y
    select BOARD_COMMON_MSB_430

source "$(RIOTBOARD)/common/msb-430/Kconfig"
```

## boards/msb-430h/Kconfig
```kconfig
# SPDX-FileCopyrightText: 2020 HAW Hamburg
# SPDX-License-Identifier: LGPL-2.1-only

config BOARD
    default "msb-430h" if BOARD_MSB_430H

config BOARD_MSB_430H
    bool
    default y
    select BOARD_COMMON_MSB_430

source "$(RIOTBOARD)/common/msb-430/Kconfig"
```

## boards/msba2/Kconfig
```kconfig
# SPDX-FileCopyrightText: 2020 HAW Hamburg
# SPDX-License-Identifier: LGPL-2.1-only

config BOARD
    default "msba2" if BOARD_MSBA2

config BOARD_MSBA2
    bool
    default y
    select CPU_MODEL_LPC2387
```
