## boards/nucleo-f103rb/Kconfig
```kconfig
# SPDX-FileCopyrightText: 2020 Inria
# SPDX-License-Identifier: LGPL-2.1-only

config BOARD
    default "nucleo-f103rb" if BOARD_NUCLEO_F103RB

config BOARD_NUCLEO_F103RB
    bool
    default y
    select BOARD_COMMON_NUCLEO64
    select CPU_MODEL_STM32F103RB

source "$(RIOTBOARD)/common/nucleo64/Kconfig"
```

## boards/nucleo-f207zg/Kconfig
```kconfig
# SPDX-FileCopyrightText: 2020 Inria
# SPDX-License-Identifier: LGPL-2.1-only

config BOARD
    default "nucleo-f207zg" if BOARD_NUCLEO_F207ZG

config BOARD_NUCLEO_F207ZG
    bool
    default y
    select BOARD_COMMON_NUCLEO144
    select CPU_MODEL_STM32F207ZG

source "$(RIOTBOARD)/common/nucleo144/Kconfig"
```

## boards/nucleo-f302r8/Kconfig
```kconfig
# SPDX-FileCopyrightText: 2020 Inria
# SPDX-License-Identifier: LGPL-2.1-only

config BOARD
    default "nucleo-f302r8" if BOARD_NUCLEO_F302R8

config BOARD_NUCLEO_F302R8
    bool
    default y
    select BOARD_COMMON_NUCLEO64
    select CPU_MODEL_STM32F302R8

source "$(RIOTBOARD)/common/nucleo64/Kconfig"
```

## boards/nucleo-f303k8/Kconfig
```kconfig
# SPDX-FileCopyrightText: 2020 Inria
# SPDX-License-Identifier: LGPL-2.1-only

config BOARD
    default "nucleo-f303k8" if BOARD_NUCLEO_F303K8

config BOARD_NUCLEO_F303K8
    bool
    default y
    select BOARD_COMMON_NUCLEO32
    select CPU_MODEL_STM32F303K8

source "$(RIOTBOARD)/common/nucleo32/Kconfig"
```

## boards/nucleo-f303re/Kconfig
```kconfig
# SPDX-FileCopyrightText: 2020 Inria
# SPDX-License-Identifier: LGPL-2.1-only

config BOARD
    default "nucleo-f303re" if BOARD_NUCLEO_F303RE

config BOARD_NUCLEO_F303RE
    bool
    default y
    select BOARD_COMMON_NUCLEO64
    select CPU_MODEL_STM32F303RE

source "$(RIOTBOARD)/common/nucleo64/Kconfig"
```

## boards/nucleo-f303ze/Kconfig
```kconfig
# SPDX-FileCopyrightText: 2020 Inria
# SPDX-License-Identifier: LGPL-2.1-only

config BOARD
    default "nucleo-f303ze" if BOARD_NUCLEO_F303ZE

config BOARD_NUCLEO_F303ZE
    bool
    default y
    select BOARD_COMMON_NUCLEO144
    select CPU_MODEL_STM32F303ZE

source "$(RIOTBOARD)/common/nucleo144/Kconfig"
```

## boards/nucleo-f334r8/Kconfig
```kconfig
# SPDX-FileCopyrightText: 2020 Inria
# SPDX-License-Identifier: LGPL-2.1-only

config BOARD
    default "nucleo-f334r8" if BOARD_NUCLEO_F334R8

config BOARD_NUCLEO_F334R8
    bool
    default y
    select BOARD_COMMON_NUCLEO64
    select CPU_MODEL_STM32F334R8

source "$(RIOTBOARD)/common/nucleo64/Kconfig"
```

## boards/nucleo-f401re/Kconfig
```kconfig
# SPDX-FileCopyrightText: 2020 Inria
# SPDX-License-Identifier: LGPL-2.1-only

config BOARD
    default "nucleo-f401re" if BOARD_NUCLEO_F401RE

config BOARD_NUCLEO_F401RE
    bool
    default y
    select BOARD_COMMON_NUCLEO64
    select CPU_MODEL_STM32F401RE

source "$(RIOTBOARD)/common/nucleo64/Kconfig"
```

## boards/nucleo-f410rb/Kconfig
```kconfig
# Copyright (c) 2020 Inria
#
# This file is subject to the terms and conditions of the GNU Lesser
# General Public License v2.1. See the file LICENSE in the top level
# directory for more details.
#

config BOARD
    default "nucleo-f410rb" if BOARD_NUCLEO_F410RB

config BOARD_NUCLEO_F410RB
    bool
    default y
    select BOARD_COMMON_NUCLEO64
    select CPU_MODEL_STM32F410RB

source "$(RIOTBOARD)/common/nucleo64/Kconfig"
```

## boards/nucleo-f411re/Kconfig
```kconfig
# SPDX-FileCopyrightText: 2020 Inria
# SPDX-License-Identifier: LGPL-2.1-only

config BOARD
    default "nucleo-f411re" if BOARD_NUCLEO_F411RE

config BOARD_NUCLEO_F411RE
    bool
    default y
    select BOARD_COMMON_NUCLEO64
    select CPU_MODEL_STM32F411RE

source "$(RIOTBOARD)/common/nucleo64/Kconfig"
```

## boards/nucleo-f412zg/Kconfig
```kconfig
# SPDX-FileCopyrightText: 2020 Inria
# SPDX-License-Identifier: LGPL-2.1-only

config BOARD
    default "nucleo-f412zg" if BOARD_NUCLEO_F412ZG

config BOARD_NUCLEO_F412ZG
    bool
    default y
    select BOARD_COMMON_NUCLEO144
    select CPU_MODEL_STM32F412ZG

source "$(RIOTBOARD)/common/nucleo144/Kconfig"
```

## boards/nucleo-f413zh/Kconfig
```kconfig
# SPDX-FileCopyrightText: 2020 Inria
# SPDX-License-Identifier: LGPL-2.1-only

config BOARD
    default "nucleo-f413zh" if BOARD_NUCLEO_F413ZH

config BOARD_NUCLEO_F413ZH
    bool
    default y
    select BOARD_COMMON_NUCLEO144
    select CPU_MODEL_STM32F413ZH

source "$(RIOTBOARD)/common/nucleo144/Kconfig"
```

## boards/nucleo-f429zi/Kconfig
```kconfig
# SPDX-FileCopyrightText: 2020 Inria
# SPDX-License-Identifier: LGPL-2.1-only

config BOARD
    default "nucleo-f429zi" if BOARD_NUCLEO_F429ZI

config BOARD_NUCLEO_F429ZI
    bool
    default y
    select BOARD_COMMON_NUCLEO144
    select CPU_MODEL_STM32F429ZI

source "$(RIOTBOARD)/common/nucleo144/Kconfig"
```

## boards/nucleo-f439zi/Kconfig
```kconfig
# SPDX-FileCopyrightText: 2022 Inria
# SPDX-License-Identifier: LGPL-2.1-only

config BOARD
    default "nucleo-f439zi" if BOARD_NUCLEO_F439ZI

config BOARD_NUCLEO_F439ZI
    bool
    default y
    select BOARD_COMMON_NUCLEO144
    select CPU_MODEL_STM32F439ZI

source "$(RIOTBOARD)/common/nucleo144/Kconfig"
```

## boards/nucleo-f446re/Kconfig
```kconfig
# SPDX-FileCopyrightText: 2020 Inria
# SPDX-License-Identifier: LGPL-2.1-only

config BOARD
    default "nucleo-f446re" if BOARD_NUCLEO_F446RE

config BOARD_NUCLEO_F446RE
    bool
    default y
    select BOARD_COMMON_NUCLEO64
    select CPU_MODEL_STM32F446RE

source "$(RIOTBOARD)/common/nucleo64/Kconfig"
```

## boards/nucleo-f446ze/Kconfig
```kconfig
# Copyright (c) 2020 Inria
#
# This file is subject to the terms and conditions of the GNU Lesser
# General Public License v2.1. See the file LICENSE in the top level
# directory for more details.
#

config BOARD
    default "nucleo-f446ze" if BOARD_NUCLEO_F446ZE

config BOARD_NUCLEO_F446ZE
    bool
    default y
    select BOARD_COMMON_NUCLEO144
    select CPU_MODEL_STM32F446ZE

source "$(RIOTBOARD)/common/nucleo144/Kconfig"
```

## boards/nucleo-f722ze/Kconfig
```kconfig
# SPDX-FileCopyrightText: 2020 Inria
# SPDX-License-Identifier: LGPL-2.1-only

config BOARD
    default "nucleo-f722ze" if BOARD_NUCLEO_F722ZE

config BOARD_NUCLEO_F722ZE
    bool
    default y
    select BOARD_COMMON_NUCLEO144
    select CPU_MODEL_STM32F722ZE

source "$(RIOTBOARD)/common/nucleo144/Kconfig"
```

## boards/nucleo-f746zg/Kconfig
```kconfig
# SPDX-FileCopyrightText: 2020 Inria
# SPDX-License-Identifier: LGPL-2.1-only

config BOARD
    default "nucleo-f746zg" if BOARD_NUCLEO_F746ZG

config BOARD_NUCLEO_F746ZG
    bool
    default y
    select BOARD_COMMON_NUCLEO144
    select CPU_MODEL_STM32F746ZG

source "$(RIOTBOARD)/common/nucleo144/Kconfig"
```

## boards/nucleo-f767zi/Kconfig
```kconfig
# Copyright (c) 2020 Inria
#
# This file is subject to the terms and conditions of the GNU Lesser
# General Public License v2.1. See the file LICENSE in the top level
# directory for more details.
#

config BOARD
    default "nucleo-f767zi" if BOARD_NUCLEO_F767ZI

config BOARD_NUCLEO_F767ZI
    bool
    default y
    select BOARD_COMMON_NUCLEO144
    select CPU_MODEL_STM32F767ZI

source "$(RIOTBOARD)/common/nucleo144/Kconfig"
```

## boards/nucleo-g070rb/Kconfig
```kconfig
# SPDX-FileCopyrightText: 2020 Inria
# SPDX-License-Identifier: LGPL-2.1-only

config BOARD
    default "nucleo-g070rb" if BOARD_NUCLEO_G070RB

config BOARD_NUCLEO_G070RB
    bool
    default y
    select BOARD_COMMON_NUCLEO64
    select CPU_MODEL_STM32G070RB

source "$(RIOTBOARD)/common/nucleo64/Kconfig"
```

## boards/nucleo-g071rb/Kconfig
```kconfig
# Copyright (c) 2020 Inria
#
# This file is subject to the terms and conditions of the GNU Lesser
# General Public License v2.1. See the file LICENSE in the top level
# directory for more details.
#

config BOARD
    default "nucleo-g071rb" if BOARD_NUCLEO_G071RB

config BOARD_NUCLEO_G071RB
    bool
    default y
    select BOARD_COMMON_NUCLEO64
    select CPU_MODEL_STM32G071RB

source "$(RIOTBOARD)/common/nucleo64/Kconfig"
```

## boards/nucleo-g431rb/Kconfig
```kconfig
# Copyright (c) 2020 Inria
#
# This file is subject to the terms and conditions of the GNU Lesser
# General Public License v2.1. See the file LICENSE in the top level
# directory for more details.
#

config BOARD
    default "nucleo-g431rb" if BOARD_NUCLEO_G431RB

config BOARD_NUCLEO_G431RB
    bool
    default y
    select BOARD_COMMON_NUCLEO64
    select CPU_MODEL_STM32G431RB

source "$(RIOTBOARD)/common/nucleo64/Kconfig"
```

## boards/nucleo-g474re/Kconfig
```kconfig
# Copyright (c) 2020 Inria
#
# This file is subject to the terms and conditions of the GNU Lesser
# General Public License v2.1. See the file LICENSE in the top level
# directory for more details.
#

config BOARD
    default "nucleo-g474re" if BOARD_NUCLEO_G474RE

config BOARD_NUCLEO_G474RE
    bool
    default y
    select BOARD_COMMON_NUCLEO64
    select CPU_MODEL_STM32G474RE

source "$(RIOTBOARD)/common/nucleo64/Kconfig"
```

## boards/nucleo-g491re/Kconfig
```kconfig
# SPDX-FileCopyrightText: 2020 Inria
# SPDX-License-Identifier: LGPL-2.1-only

config BOARD
    default "nucleo-g491re" if BOARD_NUCLEO_G491RE

config BOARD_NUCLEO_G491RE
    bool
    default y
    select BOARD_COMMON_NUCLEO64
    select CPU_MODEL_STM32G491RE

source "$(RIOTBOARD)/common/nucleo64/Kconfig"
```

## boards/nucleo-h753zi/Kconfig
```kconfig
# SPDX-FileCopyrightText: 2025 Technische Universität Hamburg
# SPDX-License-Identifier: LGPL-2.1-only

config BOARD
    default "nucleo-h753zi" if BOARD_NUCLEO_H753ZI

config BOARD_NUCLEO_H753ZI
    bool
    default y
    select BOARD_COMMON_NUCLEO144
    select CPU_MODEL_STM32H753ZI

source "$(RIOTBOARD)/common/nucleo144/Kconfig"
```
