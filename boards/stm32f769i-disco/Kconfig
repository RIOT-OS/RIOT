## boards/stm32f769i-disco/Kconfig
```kconfig
# SPDX-FileCopyrightText: 2020 Inria
# SPDX-License-Identifier: LGPL-2.1-only

config BOARD
    default "stm32f769i-disco" if BOARD_STM32F769I_DISCO

config BOARD_STM32F769I_DISCO
    bool
    default y
    select CPU_MODEL_STM32F769NI

    # Clock configuration
    select BOARD_HAS_HSE
    select BOARD_HAS_LSE


config CLOCK_HSE
    default 25000000


source "$(RIOTBOARD)/common/stm32/Kconfig"
```

## boards/stm32g0316-disco/Kconfig
```kconfig
# SPDX-FileCopyrightText: 2021 BISSELL Homecare, Inc.
# SPDX-License-Identifier: LGPL-2.1-only

config BOARD
    default "stm32g0316-disco" if BOARD_STM32G0316_DISCO

config  BOARD_STM32G0316_DISCO
    bool
    default y
    select CPU_MODEL_STM32G031J6
```

## boards/stm32l0538-disco/Kconfig
```kconfig
# SPDX-FileCopyrightText: 2020 Inria
# SPDX-License-Identifier: LGPL-2.1-only

config BOARD
    default "stm32l0538-disco" if BOARD_STM32L0538_DISCO

config BOARD_STM32L0538_DISCO
    bool
    default y
    select CPU_MODEL_STM32L053C8

source "$(RIOTBOARD)/common/stm32/Kconfig"
```

## boards/stm32l476g-disco/Kconfig
```kconfig
# SPDX-FileCopyrightText: 2020 Inria
# SPDX-License-Identifier: LGPL-2.1-only

config BOARD
    default "stm32l476g-disco" if BOARD_STM32L476G_DISCO

config BOARD_STM32L476G_DISCO
    bool
    default y
    select CPU_MODEL_STM32L476VG

    # Clock configuration
    select BOARD_HAS_LSE

source "$(RIOTBOARD)/common/stm32/Kconfig"
```

## boards/stm32l496g-disco/Kconfig
```kconfig
# SPDX-FileCopyrightText: 2020 Inria
# SPDX-License-Identifier: LGPL-2.1-only

config BOARD
    default "stm32l496g-disco" if BOARD_STM32L496G_DISCO

config BOARD_STM32L496G_DISCO
    bool
    default y
    select CPU_MODEL_STM32L496AG

    # Clock configuration
    select BOARD_HAS_LSE

source "$(RIOTBOARD)/common/stm32/Kconfig"
```

## boards/stm32mp157c-dk2/Kconfig
```kconfig
# SPDX-FileCopyrightText: 2020 Savoir-faire Linux
# SPDX-License-Identifier: LGPL-2.1-only

config BOARD
    default "stm32mp157c-dk2" if BOARD_STM32MP157C_DK2

config BOARD_STM32MP157C_DK2
    bool
    default y
    select CPU_MODEL_STM32MP157CAC

    # Clock configuration
    select BOARD_HAS_HSE
    select BOARD_HAS_LSE

source "$(RIOTBOARD)/common/stm32/Kconfig"
```

## boards/teensy31/Kconfig
```kconfig
# Copyright (c) 2020 HAW Hamburg
#
# This file is subject to the terms and conditions of the GNU Lesser
# General Public License v2.1. See the file LICENSE in the top level
# directory for more details.

config BOARD
    default "teensy31" if BOARD_TEENSY31

config BOARD_TEENSY31
    bool
    default y
    select CPU_MODEL_MK20DX256VLH7
```

## boards/telosb/Kconfig
```kconfig
# SPDX-FileCopyrightText: 2020 HAW Hamburg
# SPDX-License-Identifier: LGPL-2.1-only

config BOARD
    default "telosb" if BOARD_TELOSB

config BOARD_TELOSB
    bool
    default y
    select CPU_MODEL_MSP430F1611
```

## boards/thingy52/Kconfig
```kconfig
# SPDX-FileCopyrightText: 2020 HAW Hamburg
# SPDX-License-Identifier: LGPL-2.1-only

config BOARD
    default "thingy52" if BOARD_THINGY52

config BOARD_THINGY52
    bool
    default y
    select BOARD_COMMON_NRF52
    select CPU_MODEL_NRF52832XXAA

source "$(RIOTBOARD)/common/nrf52/Kconfig"
```

## boards/thingy91/Kconfig
```kconfig
# Copyright (c) 2021 HAW-Hamburg
#
# This file is subject to the terms and conditions of the GNU Lesser
# General Public License v2.1. See the file LICENSE in the top level
# directory for more details.

config BOARD
    default "thingy91" if BOARD_THINGY91

config BOARD_THINGY91
    bool
    default y
    select NRF9160

    # Put defined MCU peripherals here (in alphabetical order)
    # Put other features for this board (in alphabetical order)
```

## boards/ublox-c030-u201/Kconfig
```kconfig
# SPDX-FileCopyrightText: 2020 Inria
# SPDX-License-Identifier: LGPL-2.1-only

config BOARD
    default "ublox-c030-u201" if BOARD_UBLOX_C030_U201

config BOARD_UBLOX_C030_U201
    bool
    default y
    select CPU_MODEL_STM32F437VG

    # Clock configuration
    select BOARD_HAS_HSE
    select BOARD_HAS_LSE

config CLOCK_HSE
    default 12000000

source "$(RIOTBOARD)/common/stm32/Kconfig"
```

## boards/udoo/Kconfig
```kconfig
# SPDX-FileCopyrightText: 2020 HAW Hamburg
# SPDX-License-Identifier: LGPL-2.1-only

config BOARD
    default "udoo" if BOARD_UDOO

config BOARD_UDOO
    bool
    default y
    select BOARD_COMMON_ARDUINO_DUE

source "$(RIOTBOARD)/common/arduino-due/Kconfig"
```

## boards/usb-kw41z/Kconfig
```kconfig
# SPDX-FileCopyrightText: 2020 HAW Hamburg
# SPDX-License-Identifier: LGPL-2.1-only

config BOARD
    default "usb-kw41z" if BOARD_USB_KW41Z

config BOARD_USB_KW41Z
    bool
    default y
    select BOARD_COMMON_KW41Z

source "$(RIOTBOARD)/common/kw41z/Kconfig"
```

## boards/waspmote-pro/Kconfig
```kconfig
# Copyright (c) 2020 HAW Hamburg
#
# This file is subject to the terms and conditions of the GNU Lesser
# General Public License v2.1. See the file LICENSE in the top level
# directory for more details.

config BOARD
    default "waspmote-pro" if BOARD_WASPMOTE_PRO

config BOARD_WASPMOTE_PRO
    bool
    default y
    select CPU_MODEL_ATMEGA1281

source "$(RIOTKCONFIG)/Kconfig.ztimer_only"
```

## boards/waveshare-esp32s3-touch-lcd-128/Kconfig
```kconfig
# SPDX-FileCopyrightText: 2026 Technische Universität Hamburg
# SPDX-License-Identifier: LGPL-2.1-only

config BOARD
    default "waveshare-esp32s3-touch-lcd-128" if BOARD_WAVESHARE_ESP32S3_TOUCH_LCD_128

config BOARD_WAVESHARE_ESP32S3_TOUCH_LCD_128
    bool
    default y
    select BOARD_COMMON_ESP32S3
    select CPU_MODEL_ESP32S3_R2

source "$(RIOTBOARD)/common/esp32s3/Kconfig"
```

## boards/waveshare-nrf52840-eval-kit/Kconfig
```kconfig
# SPDX-FileCopyrightText: 2020 HAW Hamburg
# SPDX-License-Identifier: LGPL-2.1-only

config BOARD
    default "waveshare-nrf52840-eval-kit" if BOARD_WAVESHARE_NRF52840_EVAL_KIT

config BOARD_WAVESHARE_NRF52840_EVAL_KIT
    bool
    default y
    select BOARD_COMMON_NRF52
    select CPU_MODEL_NRF52840XXAA

source "$(RIOTBOARD)/common/nrf52/Kconfig"
```

## boards/weact-f401cc/Kconfig
```kconfig
# SPDX-FileCopyrightText: 2020 Benjamin Valentin
# SPDX-License-Identifier: LGPL-2.1-only

config BOARD
    default "weact-f401cc" if BOARD_WEACT_F401CC

config BOARD_WEACT_F401CC
    bool
    default y
    select BOARD_COMMON_WEACT_F4X1CX
    select CPU_MODEL_STM32F401CC

source "$(RIOTBOARD)/common/weact-f4x1cx/Kconfig"
```

## boards/weact-f401ce/Kconfig
```kconfig
# SPDX-FileCopyrightText: 2020 Benjamin Valentin
# SPDX-License-Identifier: LGPL-2.1-only

config BOARD
    default "weact-f401ce" if BOARD_WEACT_F401CE

config BOARD_WEACT_F401CE
    bool
    default y
    select BOARD_COMMON_WEACT_F4X1CX
    select CPU_MODEL_STM32F401CE

source "$(RIOTBOARD)/common/weact-f4x1cx/Kconfig"
```

## boards/weact-f411ce/Kconfig
```kconfig
# SPDX-FileCopyrightText: 2020 Benjamin Valentin
# SPDX-License-Identifier: LGPL-2.1-only

config BOARD
    default "weact-f411ce" if BOARD_WEACT_F411CE

config BOARD_WEACT_F411CE
    bool
    default y
    select BOARD_COMMON_WEACT_F4X1CX
    select CPU_MODEL_STM32F411CE

source "$(RIOTBOARD)/common/weact-f4x1cx/Kconfig"
```

## boards/wemos-zero/Kconfig
```kconfig
# SPDX-FileCopyrightText: 2020 HAW Hamburg
# SPDX-License-Identifier: LGPL-2.1-only

config BOARD
    default "wemos-zero" if BOARD_WEMOS_ZERO

config BOARD_WEMOS_ZERO
    bool
    default y
    select BOARD_COMMON_ARDUINO_ZERO

source "$(RIOTBOARD)/common/arduino-zero/Kconfig"
```

## boards/wsn430-v1_3b/Kconfig
```kconfig
# Copyright (c) 2020 HAW Hamburg
#
# This file is subject to the terms and conditions of the GNU Lesser
# General Public License v2.1. See the file LICENSE in the top level
# directory for more details.

config BOARD
    default "wsn430-v1_3b" if BOARD_WSN430_V1_3B

config BOARD_WSN430_V1_3B
    bool
    default y
    select BOARD_COMMON_WSN430

source "$(RIOTBOARD)/common/wsn430/Kconfig"
```

## boards/wsn430-v1_4/Kconfig
```kconfig
# Copyright (c) 2020 HAW Hamburg
#
# This file is subject to the terms and conditions of the GNU Lesser
# General Public License v2.1. See the file LICENSE in the top level
# directory for more details.

config BOARD
    default "wsn430-v1_4" if BOARD_WSN430_V1_4

config BOARD_WSN430_V1_4
    bool
    default y
    select BOARD_COMMON_WSN430

source "$(RIOTBOARD)/common/wsn430/Kconfig"
```

## boards/xg23-pk6068a/Kconfig
```kconfig
# SPDX-FileCopyrightText: 2022 SSV Software Systems GmbH
# SPDX-License-Identifier: LGPL-2.1-only

config BOARD
    default "xg23-pk6068a" if BOARD_XG23_PK6068A

config BOARD_XG23_PK6068A
    bool
    default y
    select CPU_MODEL_EFR32ZG23A020F512GM48
```

## boards/yarm/Kconfig
```kconfig
# SPDX-FileCopyrightText: 2020 Antonio Galea
# SPDX-License-Identifier: LGPL-2.1-only

config BOARD
    default "yarm" if BOARD_YARM

config BOARD_YARM
    bool
    default y
    select CPU_MODEL_SAML21J18B
```

## boards/yunjia-nrf51822/Kconfig
```kconfig
# SPDX-FileCopyrightText: 2020 HAW Hamburg
# SPDX-License-Identifier: LGPL-2.1-only

config BOARD
    default "yunjia-nrf51822" if BOARD_YUNJIA_NRF51822

config BOARD_YUNJIA_NRF51822
    bool
    default y
    select BOARD_COMMON_NRF51
    select CPU_MODEL_NRF51X22XXAA

source "$(RIOTBOARD)/common/nrf51/Kconfig"
```
